# NAVSS0_TIMERMGR0_CFG_OES register map
Vendor: Texas Instruments
Peripheral module from a debugger description file (folder am65x).
Registers are 32-bit, read-write, reset 0xFFFF unless marked. A register's access mark holds for its fields unless they carry their own. Offsets are as the file gives them; lines under a group give offsets from that group; [hi:lo] are bit positions; {n}, {i} and the like mark numbered series; 'fields as' and 'values as' point back to an identical list; <NAME> marks a mode.

## NAVSS0_TIMERMGR0_CFG_OES
0x00 TIMERMGR_EVENTIDX_y — This programs the event index for a given timer Offset = 0h + (y * 4h); where y = 0h to 3FFh
  [15:0] VAL — The event index for a given timer to be used on the output event interface
