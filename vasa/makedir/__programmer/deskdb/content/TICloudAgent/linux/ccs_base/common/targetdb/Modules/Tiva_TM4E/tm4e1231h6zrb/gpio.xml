# gpio register map
Vendor: Texas Instruments
Peripheral module from a debugger description file (folder tm4e1231h6zrb).
Registers are 32-bit, access not given, no defined reset value unless marked. A register's access mark holds for its fields unless they carry their own. Offsets are as the file gives them; lines under a group give offsets from that group; [hi:lo] are bit positions; {n}, {i} and the like mark numbered series; 'fields as' and 'values as' point back to an identical list; <NAME> marks a mode.

## GPIO_PORTA — GPIO register offsets
0x3FC GPIO_DATA
0x400 GPIO_DIR — GPIO Direction
0x404 GPIO_IS — GPIO Interrupt Sense
0x408 GPIO_IBE — GPIO Interrupt Both Edges
0x40C GPIO_IEV — GPIO Interrupt Event
0x410 GPIO_IM rw — GPIO Interrupt Mask
  [7:0] GPIO_IM_GPIO — GPIO Interrupt Mask Enable
0x414 GPIO_RIS ro — GPIO Raw Interrupt Status
  [7:0] GPIO_RIS_GPIO — GPIO Interrupt Raw Status
0x418 GPIO_MIS ro — GPIO Masked Interrupt Status
  [7:0] GPIO_MIS_GPIO
0x41C GPIO_ICR wo — GPIO Interrupt Clear
  [7:0] GPIO_ICR_GPIO
0x420 GPIO_AFSEL — GPIO Alternate Function Select
0x500 GPIO_DR2R — GPIO 2-mA Drive Select
0x504 GPIO_DR4R — GPIO 4-mA Drive Select
0x508 GPIO_DR8R — GPIO 8-mA Drive Select
0x50C GPIO_ODR — GPIO Open Drain Select
0x510 GPIO_PUR — GPIO Pull-Up Select
0x514 GPIO_PDR — GPIO Pull-Down Select
0x518 GPIO_SLR — GPIO Slew Rate Control Select
0x51C GPIO_DEN — GPIO Digital Enable
0x520 GPIO_LOCK rw
  [31:0] GPIO_LOCK
    0=GPIO_LOCK_UNLOCKED (The GPIOCR register is unlocked and may be modified); 1=GPIO_LOCK_LOCKED (The GPIOCR register is locked and may not be modified); 0x4C4F434B=GPIO_LOCK_KEY (Unlocks the GPIO_CR register)
0x524 GPIO_CR — GPIO Commit
0x528 GPIO_AMSEL — GPIO Analog Mode Select
0x52C GPIO_PCTL — GPIO Port Control
0x530 GPIO_ADCCTL — GPIO ADC Control
0x534 GPIO_DMACTL — GPIO DMA Control
0x538 GPIO_SI rw — GPIO Select Interrupt
  [0] GPIO_SI_SUM — Summary Interrupt
