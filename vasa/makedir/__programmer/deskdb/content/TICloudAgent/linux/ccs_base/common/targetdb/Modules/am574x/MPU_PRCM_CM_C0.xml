# MPU_PRCM_CM_C0 register map
Vendor: Texas Instruments
Peripheral module from a debugger description file (folder am574x).
Registers are 32-bit, access per field, reset 0x0 unless marked. A register's access mark holds for its fields unless they carry their own. Offsets are as the file gives them; lines under a group give offsets from that group; [hi:lo] are bit positions; {n}, {i} and the like mark numbered series; 'fields as' and 'values as' point back to an identical list; <NAME> marks a mode.

## MPU_PRCM_CM_C0
0x00 CM_CPU0_CLKSTCTRL — This register enables the CPU domain power state transition. It controls the HW supervised domain power state transition between ON-ACTIVE and ON-INACTIVE states. It also holds 1 status bit per clock input of the domain.
  [1:0] CLKTRCTRL rw — Controls the full domain transition of the CPU domain.
    0=NO_SLEEP (NO_SLEEP: Sleep transition cannot be initiated. Wakeup transition may, however, occur.); 2=SW_WKUP (SW_WKUP: Start a software forced wakeup transition on the domain.0x1: Reserved); 3=HW_AUTO (HW_AUTO: Automatic transition is enabled. Sleep and wakeup transition are based upon hardware conditions.)
0x20 CM_CPU0_CPU0_CLKCTRL ro reset 0x1 — This register manages the CPU clocks.
  [0] STBYST — Module standby status. [warm reset insensitive]
    0=FUNC (Module is functional (not in standby).); 1=STANDBY (Module is in standby.)
