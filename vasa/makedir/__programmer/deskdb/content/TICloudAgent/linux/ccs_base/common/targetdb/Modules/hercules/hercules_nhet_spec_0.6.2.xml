# hercules_nhet_spec_0.6.2 register map
Vendor: Texas Instruments
Peripheral module from a debugger description file (folder hercules).
Registers are 32-bit, access not given, no defined reset value unless marked. A register's access mark holds for its fields unless they carry their own. Offsets are as the file gives them; lines under a group give offsets from that group; [hi:lo] are bit positions; {n}, {i} and the like mark numbered series; 'fields as' and 'values as' point back to an identical list; <NAME> marks a mode.

## NHET — Platform High End Timer
0x00 GlbCtrl — global control register
0x04 Pfr — prescaler factor register
0x08 Addr — Current Address Register
0x0C Offst1 — Offset Level 1 Register
0x10 Offst2 — Offset Level 2 Register
0x14 IntEnaSet — Interrupt Enable Set Register
0x18 IntEnaClr — Interrupt Enable Clear Register
0x1C Exc1 — Exception Control Register 1
0x20 Exc2 — Exception Control Register 2
0x24 IntPrio — Interrupt Priority Register
0x28 IntFlg — Interrupt Flag Register
0x34 HrSh — HR Share Control Register
0x38 Xor — HR Xor control register
0x3C ReqEnaSet — Request Enable Set Register
0x40 ReqEnaClr — Request Enable Clear Register
0x44 ReqDst — Request Destination Select Register
0x4C Dir — Direction Register
0x50 DIn — Input Data Register
0x54 DOut — Output Data Register
0x58 DSet — Set Data Register
0x5C DClr — Clear Data Register
0x60 PDr — Open Drain Register
0x64 PDis — Pull Disable Register
0x68 PSel — Pull Select Register
0x74 ParCtrl — Parity Control Register
0x78 ParAddr — Parity Address Register
0x7C ParPinReg — Parity Pin Register
0x80 SfPrld — Suppresion Filter Preload Register
0x84 SfEna — Suppresion Filter Enable Register
0x8C LbPairSel — Loop Back Pair Select Register
0x90 LbPairDir — Loop Back Pair Direction Register
0x94 PinDis — Pin Disable Register

## Notices in the file
(c) Texas Instruments 2003-2012, All rights reserved.
