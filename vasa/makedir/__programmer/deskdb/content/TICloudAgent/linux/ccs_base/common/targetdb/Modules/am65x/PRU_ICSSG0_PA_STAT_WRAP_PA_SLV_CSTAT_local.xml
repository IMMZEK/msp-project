# PRU_ICSSG0_PA_STAT_WRAP_PA_SLV_CSTAT_local register map
Vendor: Texas Instruments
Peripheral module from a debugger description file (folder am65x).
Registers are 32-bit, read-write, reset 0x0 unless marked. A register's access mark holds for its fields unless they carry their own. Offsets are as the file gives them; lines under a group give offsets from that group; [hi:lo] are bit positions; {n}, {i} and the like mark numbered series; 'fields as' and 'values as' point back to an identical list; <NAME> marks a mode.

## PRU_ICSSG0_PA_STAT_WRAP_PA_SLV_CSTAT
0x00 ICSSG_PA_STAT_CRAM_n — Return to the . Collect mode RAM. Reading directly to a particular statistics memory address returns the current statistics values. In collect mode, the stats are reset to 0 after the read completes. To accommodate debug, setting a counter value in the stats memory via the register write is also allowed. However, if there is a stat bump and a register write on the same stat that occur simultaneously, the value in the register write may be ignored. 'n' is the number of 32-bit stats that are supported in the module. Offset = 0h + (n * 4h); where n = 0h to 3FFh
  [31:0] VALUE — Collect statistic. 32-bit statistic value at counter 'n'.
