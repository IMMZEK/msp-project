# C2000_M3_I2CSLAVE_Type0_Registers register map
Vendor: Texas Instruments
Peripheral module from a debugger description file (folder C2000).
Address unit: 16 bits
Registers are 32-bit, access not given, no defined reset value unless marked. A register's access mark holds for its fields unless they carry their own. Offsets are as the file gives them; lines under a group give offsets from that group; [hi:lo] are bit positions; {n}, {i} and the like mark numbered series; 'fields as' and 'values as' point back to an identical list; <NAME> marks a mode.

## I2C_SLAVE_REGS — I2C SLAVE REGS Registers
0x00 I2CSOAR — I2C Slave Own Address
0x04 I2CSCSR — I2C Slave Control/Status
0x08 I2CSDR — I2C Slave Data
0x0C I2CSIMR — I2C Slave Interrupt Mask
0x10 I2CSRIS — I2C Slave Raw Interrupt Status
0x14 I2CSMIS — I2C Slave Masked Interrupt Status
0x18 I2CSICR — I2C Slave Interrupt Clear
