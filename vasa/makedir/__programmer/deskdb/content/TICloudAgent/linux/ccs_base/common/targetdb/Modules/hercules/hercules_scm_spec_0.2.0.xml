# hercules_scm_spec_0.2.0 register map
Vendor: Texas Instruments
Peripheral module from a debugger description file (folder hercules).
Registers are 32-bit, access not given, no defined reset value unless marked. A register's access mark holds for its fields unless they carry their own. Offsets are as the file gives them; lines under a group give offsets from that group; [hi:lo] are bit positions; {n}, {i} and the like mark numbered series; 'fields as' and 'values as' point back to an identical list; <NAME> marks a mode.

## SCM — SCR Control Module
0x00 ScmRevID
0x04 ScmCntrl — SCM Control Register
0x08 ScmThreshold — SCM Compare Threshold Counter Register
0x10 ScmIaErr0Stat — SCM Inittiator Error0 Status Register
0x14 ScmIaErr1Stat — SCM Initiator Error1 Status Register
0x18 ScmIaStat — SCM Initiator Active Status Register
0x20 ScmTaStat — SCM Target Active Status Register

## Notices in the file
(c) Texas Instruments 2003-2012, All rights reserved.
