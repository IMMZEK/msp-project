# hercules_mcrc_spec_1.1.0 register map
Vendor: Texas Instruments
Peripheral module from a debugger description file (folder hercules).
Registers are 32-bit, access not given, no defined reset value unless marked. A register's access mark holds for its fields unless they carry their own. Offsets are as the file gives them; lines under a group give offsets from that group; [hi:lo] are bit positions; {n}, {i} and the like mark numbered series; 'fields as' and 'values as' point back to an identical list; <NAME> marks a mode.

## Crc — Cyclic Redundancy Check
{0x0+8i} Ctrl{i} (i=0..2) — CRC Global Control Register {i}
0x18 IntSet — Write one to a bit to enable a interrupt
0x20 IntClr — Write one to a bit to disable a interrupt
0x28 IntStat — CRC Interrupt Status Register
0x30 IntOffst — CRC Interrupt Offset Register
0x38 Busy — CRC Busy Register
0x40 PCount1 — CRC Pattern Counter Preload Register 1
0x44 SCount1 — CRC Sector Counter Preload Register 1
0x48 CurSec1 — CRC Current Sector Register 1
{0xC+0x40*i} WdToPld{i} (i=1..4) — Watchdog Timeout Preload Register
0x50 BcToPld1 — CRC Channel 1 Block Complete Timeout Preload Register
{0x20+0x40*i} PsaSigL{i} (i=1..4) — Channel {i} PSA signature low register
{0x24+0x40*i} PsaSigH{i} (i=1..4) — Channel {i} PSA signature high register
{0x28+0x40*i} CrcValL{i} (i=1..4) — Channel {i} CRC value low register
{0x2C+0x40*i} CrcValH{i} (i=1..4) — Channel {i} CRC value high register
{0x30+0x40*i} PsaSecSigL{i} (i=1..4) — PSA Sector Signature Low Register {i}
{0x34+0x40*i} PsaSecSigH{i} (i=1..4) — PSA Sector Signature High Register {i}
{0x38+0x40*i} RawDataL{i} (i=1..4) — Raw Data Low Register {i}
{0x3C+0x40*i} RawDataH{i} (i=1..4) — Raw Data High Register {i}
0x80 PCount2 — CRC Pattern Counter Preload Register 1
0x84 SCount2 — CRC Sector Counter Preload Register 1
0x88 CurSec2 — CRC Current Sector Register 1
0x90 BcToPld2 — CRC Channel 1 Block Complete Timeout Preload Register
0xC0 PCount3 — CRC Pattern Counter Preload Register 3
0xC4 SCount3 — CRC Sector Counter Preload Register 3
0xC8 CurSec3 — CRC Current Sector Register 3
0xD0 BcToPld3 — CRC Channel 3 Block Complete Timeout Preload Register
0x100 PCount4 — CRC Pattern Counter Preload Register 4
0x104 SCount4 — CRC Sector Counter Preload Register 4
0x108 CurSec4 — CRC Current Sector Register 4
0x110 BcToPld4 — CRC Channel 4 Block Complete Timeout Preload Register
0x140 MbusSel — Data bus tracing selection

## Notices in the file
(c) Texas Instruments 2003-2012, All rights reserved.
