# AHBAP register map
Vendor: Texas Instruments
Peripheral module from a debugger description file (folder AP).
Registers are 32-bit, access not given, no defined reset value unless marked. A register's access mark holds for its fields unless they carry their own. Offsets are as the file gives them; lines under a group give offsets from that group; [hi:lo] are bit positions; {n}, {i} and the like mark numbered series; 'fields as' and 'values as' point back to an identical list; <NAME> marks a mode.

## Hidden
0x00 CSW
0x04 TAR
0x0C DRW
{0x10+4i} BD{i} (i=0..3)
0xF8 ROM
0xFC IDR
