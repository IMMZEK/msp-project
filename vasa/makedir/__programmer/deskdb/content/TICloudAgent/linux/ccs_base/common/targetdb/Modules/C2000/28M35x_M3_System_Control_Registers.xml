# 28M35x_M3_System_Control_Registers register map
Vendor: Texas Instruments
Peripheral module from a debugger description file (folder C2000).
Address unit: 16 bits
Registers are 32-bit, access not given, no defined reset value unless marked. A register's access mark holds for its fields unless they carry their own. Offsets are as the file gives them; lines under a group give offsets from that group; [hi:lo] are bit positions; {n}, {i} and the like mark numbered series; 'fields as' and 'values as' point back to an identical list; <NAME> marks a mode.

## SYSCTL_REGS — SYSCTL REGS Registers
0x00 SYSPLLCTL — System PLL Configuration Register
0x04 SYSPLLMULT — System PLL Multiplier
0x08 SYSPLLSTS — System PLL lock status
0x0C SYSDIVSEL — System clock divider
0x10 M3SSDIVSEL — M3 Sub system clock divider
0x20 UPLLCTL — USB PLL config register
0x24 UPLLMULT — USB PLL Multiplier
0x28 UPLLSTS — USB PLL lock status
0x30 MCLKSTS — Missing clock status register
0x34 MCLKCTL — Missing clock configuration register
0x38 MCLKFRCCLR — Missing clock force register
0x3C MCLKEN — Missing clock enable register
0x40 MREFCLKLIM — Missing clock reference limit registers
0x50 XPLLCLKCFG — XPLL clkout control register
0x60 CCLKOFF — C28 clock disable register
0x70 CAN0BCLKSEL — Bit clock source selection for CAN0
0x74 CAN1BCLKSEL — Bit clock source selection for CAN1
0x80 CLPMSTAT — C28 Low Power Mode Status
0xC0 CRESCNF — C28 Reset Configuration
0xC4 CRESSTS — C28 Reset Status
0xC8 FUSEERR — Efuse Error Status
0xCC MWIR — WIR Decode Latch Register
0x100 MCNF — M3 Sub System Configuration
0x108 SERPLOOP — Serial Port Loop Back Control
0x10C MCIBSTATUS — Analog System Status Register
{0x110+4i} CCNF{i} (i=0..4) — C28 Peripheral Configuration {i}
0x130 MEMCNF — M3 Memory Configuration
0x180 MWRALLOW — M3 Configuration Write Allow
0x184 MLOCK — M3 Configuration Lock Register
0x2800 DID0 — Device ID 0
0x2804 DID1 — Device ID 1
0x2810 DC1 — Device Capabilities 1
0x2814 DC2 — Device Capabilities 2
0x281C DC4 — Device Capabilities 4
0x2824 DC6 — Device Capabilities 6
0x2828 DC7 — Device Capabilities 7
{0x2840+4i} SRCR{i} (i=0..3) — Software Reset Control {i}
0x285C RESC — M3 Reset Cause
0x2860 RCC — Run Mode Clock
0x286C GPIOHBCTL — GPIO High Performance Bus Control
{0x2900+4i} RCGC{i} (i=0..3) — Run Mode Clock Gating Control - Register {i}
{0x2910+4i} SCGC{i} (i=0..3) — Sleep Mode Clock Gating Control - Register {i}
{0x2920+4i} DCGC{i} (i=0..3) — Deep Sleep Mode Clock Gating Control - Register {i}
0x2944 DSLPCLKCFG — Deep Sleep Clock Configuration
0x2994 DC10 — Device Configuration 10
0x29A0 NVMSTAT — Non-Volatile Memory Status
