# hercules_sciblin_spec_1.43.2 register map
Vendor: Texas Instruments
Peripheral module from a debugger description file (folder hercules).
Registers are 32-bit, access not given, no defined reset value unless marked. A register's access mark holds for its fields unless they carry their own. Offsets are as the file gives them; lines under a group give offsets from that group; [hi:lo] are bit positions; {n}, {i} and the like mark numbered series; 'fields as' and 'values as' point back to an identical list; <NAME> marks a mode.

## Lin — Serial Communications Interface
{0x0+4i} GlbCtrl{i} (i=0..2) — global control register
0x0C SetInt — Set Interrupt Register
0x10 ClearInt — Clear Interrupt Register
0x14 SetIntLVL — Set Interrupt Level Register
0x18 ClearIntLVL — Clear Interrupt Level Register
0x1C Flr — Flags Register
0x20 IntVect0 — Interrupt Vector Offset 0
0x24 IntVect1 — Interrupt Vector Offset 1
0x28 Format — Format Control Register
0x2C Brsr — Baud Rate Selection Register
0x30 Ed — SCI Data Buffer
0x34 Rd — SCI Data Buffer
0x38 Td — SCI Data Buffer
0x3C Fun — Pin Control 0
0x40 Dir — Pin Control 1
0x44 DIn — Pin Control 2
0x48 DOut — Pin Control 3
0x4C DSet — Pin Control 4
0x50 DClr — Pin Control 5
0x54 PDr — Pin Control 6
0x58 PDis — Pin Control 7
0x5C PSel — Pin Control 8
0x60 LinComp — BLinCompARE Register
0x64 LinRd0
0x68 LinRd1
0x6C LinMask
0x70 LinId
0x74 LinTd0
0x78 LinTd1
0x7C MBrsr — Maximum Baud Rate Selection Register
0x80 SrSel — Slew Rate Control Register
0x90 IoDftCtrl — IODFT for BLin moduler

## Notices in the file
(c) Texas Instruments 2003-2012, All rights reserved.
