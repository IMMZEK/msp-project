# GTC0_GTC_CFG0 register map
Vendor: Texas Instruments
Peripheral module from a debugger description file (folder am65x).
Registers are 32-bit, read-only, reset values left out (the file's numbers can be read two ways) unless marked. A register's access mark holds for its fields unless they carry their own. Offsets are as the file gives them; lines under a group give offsets from that group; [hi:lo] are bit positions; {n}, {i} and the like mark numbered series; 'fields as' and 'values as' point back to an identical list; <NAME> marks a mode.

## GTC0_GTC_CFG0
0x00 GTC_PID — This is the standard platform IP revision register which contains the ID and revision information of the MMR generator.
  [31:0] REV — TI internal data. Identifies revision of peripheral.
0x04 GTC_GTC_PID — This is the standard platform IP revision register which contains the ID and revision information of the GTC peripheral.
  [31:0] REV — TI internal data. Identifies revision of peripheral.
0x08 GTC_PUSHEVT access per field — Selects which bit of the count value to output as a push event for global timesync.
  [5:0] EXPBIT_SEL rw — This field controls the mux that selects which bit [63:0] of the system counter value is exported on the0h = Select CNTR[0]1h = Select CNTR[1]...3Fh = Select CNTR]63]
