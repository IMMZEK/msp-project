# pga970_csr register map
Vendor: Texas Instruments
Peripheral module from a debugger description file (folder PGA970).
Registers are 8-bit, access not given, no defined reset value unless marked. A register's access mark holds for its fields unless they carry their own. Offsets are as the file gives them; lines under a group give offsets from that group; [hi:lo] are bit positions; {n}, {i} and the like mark numbered series; 'fields as' and 'values as' point back to an identical list; <NAME> marks a mode.

## CSR — Control and Status Register
0x89 PIN_MUX
0x220 REMAP — REMAP Configuration Register
0x230 GPIO_INPUT
0x231 GPIO_OUTPUT
0x232 GPIO_DIR — GPIO Direction Configuration Register
0x233 GPIO_OTYPE
0x400 REVISION_ID1 — Device Revision ID
0x401 REVISION_ID2 — Digital Logic Revision ID
0x404 COM_MCU_TO_DIF_B1 — COMBUF Microcontroller to Digital Interface Data1 Register
0x405 COM_MCU_TO_DIF_B2 — COMBUF Microcontroller to Digital Interface Data2 Register
0x406 COM_TX_STATUS — COMBUF Transmit Status Register
0x408 COM_DIF_TO_MCU_B1 — COMBUF Digital Interface to Microcontroller Data1 Register
0x409 COM_DIF_TO_MCU_B2 — COMBUF Digital Interface to Microcontroller Data2 Register
0x40A COM_RX_STATUS — COMBUF Receive Status Register
0x40B COM_RX_INT_ENABLE — COMBUF Rx Interrupt Enable Register
0x40C MICRO_INTERFACE_CONTROL — Microcontroller Interface Register
0x40D SECLOCK — Security Lock Enable Register
{0x40F+i} DEMOD1_DATA{i} (i=1..4)
{0x413+i} DEMOD2_DATA{i} (i=1..4)
{0x41B+i} ADC3_VI_DATA{i} (i=1..4)
{0x427+i} ADC3_PTAT_DATA{i} (i=1..4)
0x42C DEMOD1_PH1_DATA1
0x42D DEMOD1_PH1_DATA2 — DDEMOD1_PH1_DATA2 Register
0x42E DEMOD1_PH1_DATA3
0x42F DEMOD1_PH1_DATA4
{0x42F+i} DEMOD1_PH2_DATA{i} (i=1..4)
0x434 DEMOD2_PH1_DATA1
0x435 DEMOD2_PH1_DATA2 — DDEMOD2_PH1_DATA2 Register
0x436 DEMOD2_PH1_DATA3
0x437 DEMOD2_PH1_DATA4
{0x437+i} DEMOD2_PH2_DATA{i} (i=1..4)
{0x43B+i} ADC3_COIL3_DATA{i} (i=1..4)
0x502 RAMBIST_CONTROL — RAM Memory Built-In Self-Test Control Register
0x503 RAMBIST_STATUS — RAM Memory Built-In Self-Test Status Register
0x504 CLK_CTRL_STATUS — M0 Frequency Control Register
0x505 FRAM_STATUS — FRAM Parity check status Register
0x506 DIG_IF_CTRL — Digital Interface Control Register
0x508 OWI_ERROR_STATUS_LO — OWI Error Status Low Register
0x509 OWI_ERROR_STATUS_HI — OWI Error Status High Register
0x50A OWI_INTERRUPT — OWI Interrupt Status Register
0x50B OWI_INTERRUPT_ENABLE — OWI Interrupt Control Register
0x518 FRAM_PAGE_ADDR — FRAM Page Address Register
0x519 DATA_WAVE_PAGE_ADDR — Data Waveform Page Address Register
0x51A DEVRAM_PAGE_ADDR — Development RAM Page Address Register
0x51C WDOG_CTRL_STAT — Watchdog Control and Status Register
0x51D WDOG_TRIG_HIGH — Watchdog High Trigger Register
0x51E WDOG_TRIG_LOW — Watchdog Low Trigger Register
0x520 DEMOD1_CONFIG — DEMOD1 Configuration Register
0x521 DEMOD2_CONFIG — DEMOD2 Configuration Register
0x522 ADC3_CONFIG — ADC3 Configuration Register
0x524 S1_S2_DEMOD_CFG_1 — S1 S2 DEMOD Configuration Register
0x526 S3_ADC_CFG_1 — S3 ADC Configuration Register
0x527 S1_CFG — S1 Configuration Register
0x528 S2_CFG — S2 Configuration Register
0x529 S1_S2_CFG — S1 S2 Configuration Register
0x52A S3_CFG — S3 Configuration Register
0x52B S3_CFG_1 — S3 Configuration Register_1
0x530 DAC_REG0_1 — DAC Register0_1
0x531 DAC_REG0_2 — DAC Register0_2
0x538 DAC_CTRL_STATUS — DAC Control and Status Register
0x539 DAC_CONFIG — DAC Configuration Register
0x53A DAC_LPBK_CTRL — DAC Loopback Control Register
0x53B OP_STAGE_CTRL — DAC Output Stage Control Register
0x53C LVDT_OP_CTRL — LVDT Configuration Register
0x53D LVDT_LPBK_CTRL — LVDT Loopback Configuration Register
0x53E CCS_CTRL — Constant Current Source Configuration Register
0x545 AFEDIAG_CFG — AFEDIAG Configuration Register
0x550 ALPWR
0x554 DLPWR
0x558 PSMON1 — PSMON1 Fault Detect Register
0x559 PSMON2 — PSMON2 Fault Detect Register
0x55B AFEDIAG
0x55C AFEDIAG1
0x55E AFEDIAG3
0x55F AFEDIAG4
0x560 TOPDIG_MUX_SEL — TOPDIG Multiplexer Register
0x564 AMUX_ACT — Analog Multiplexer Activate Register
0x565 AMUX_TIN_MUX_CTRL — TIN Analog Multiplexer Register
0x566 AMUX_TOUT_MUX_CTRL — TOUT Analog Multiplexer Register
0x567 AMUX_CTRL — Analog Multiplexer Register
0x578 WAVEFORM_GEN_CTRL — Waveform Generation Control and Status Register
0x57A WAVEFORM_TABLE_LEN — Waveform Table Length Register
0x57C WAVEFORM_DAC_OFFSET_0 — Waveform DAC Offset Register_0
0x57D WAVEFORM_DAC_OFFSET_1 — Waveform DAC Offset Register_1
{0x57F+i} FAST_DIV_NUMERATOR_{i} (i=1..4)
{0x583+i} FAST_DIV_DENOMINATOR_{i} (i=1..4)
0x588 FAST_DIV_CTRL — FAST_DIV Control Register
0x58A FAST_DIV_STAT — FAST_DIV Status Register
{0x58B+i} FAST_DIV_QUOTIENT_{i} (i=1..4)
{0x58F+i} FAST_DIV_REMAINDER_{i} (i=1..4)
{0x597+i} DEMOD1_BPF_B1_{i} (i=1..3)
{0x59B+i} DEMOD1_BPF_A2_{i} (i=1..3)
{0x59F+i} DEMOD1_BPF_A3_{i} (i=1..3)
0x5A4 DEMOD1_LPF_B1_1
0x5A5 DEMOD1_LPF_B1_2
0x5A8 DEMOD1_LPF_A2_1
0x5A9 DEMOD1_LPF_A2_2
{0x5B3+i} DEMOD2_BPF_B1_{i} (i=1..3)
{0x5B7+i} DEMOD2_BPF_A2_{i} (i=1..3)
{0x5BB+i} DEMOD2_BPF_A3_{i} (i=1..3)
0x5C0 DEMOD2_LPF_B1_1
0x5C1 DEMOD2_LPF_B1_2
0x5C4 DEMOD2_LPF_A2_1
0x5C5 DEMOD2_LPF_A2_2
0x5CC ADC3_VI_LPF_B1_1
0x5CD ADC3_VI_LPF_B1_2
0x5CE ADC3_VI_LPF_A2_1
0x5CF ADC3_VI_LPF_A2_2
0x5E0 ADC3_PTAT_LPF_B1_1
0x5E1 ADC3_PTAT_LPF_B1_2
0x5E2 ADC3_PTAT_LPF_A2_1
0x5E3 ADC3_PTAT_LPF_A2_2
0x5E4 DAC_SIN_NDS1_1
0x5E5 DAC_SIN_NDS1_2
0x5E6 DAC_SIN_NDS2_1
0x5E7 DAC_SIN_NDS2_2
