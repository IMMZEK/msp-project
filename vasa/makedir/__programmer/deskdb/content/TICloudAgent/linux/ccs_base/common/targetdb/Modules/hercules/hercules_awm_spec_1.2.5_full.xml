# hercules_awm_spec_1.2.5_full register map
Vendor: Texas Instruments
Peripheral module from a debugger description file (folder hercules).
Registers are 32-bit, access not given, no defined reset value unless marked. A register's access mark holds for its fields unless they carry their own. Offsets are as the file gives them; lines under a group give offsets from that group; [hi:lo] are bit positions; {n}, {i} and the like mark numbered series; 'fields as' and 'values as' point back to an identical list; <NAME> marks a mode.

## Adm — Analog to Digital Module
0x00 RstCtrl — Reset Control Register
0x04 OpModeCtrl — Operation Mode Control Register
0x08 ClckCtrl — Clock Prescaler
0x0C CalCtrl — Calibration Control Register
0x10 EvModeCtrl — Ev Mode Control Register
0x14 G1ModeCtrl — G1 Mode Control Register
0x18 G2ModeCtrl — G2 Mode Control Register
0x1C EvSrc — Event Group Trigger Source Select
0x20 G1Src — Group 1 Trigger Source Select
0x24 G2Src — Group 2 Trigger Source Select
0x28 EvIntEna — Event Group Interrupt Enable
0x2C G1IntEna — Group 1 Interrupt Enable
0x30 G2IntEna — Group 2 Interrupt Enable
0x34 EvIntFlg — Event Group Interrupt Flg
0x38 G1IntFlg — Group 1 Interrupt Flg
0x3C G2IntFlg — Group 2 Interrupt Flg
0x40 EvIntCtrl — Event Group Interrupt Threshold Counter
0x44 G1IntCtrl — Group 1 Interrupt Threshold Counter
0x48 G2IntCtrl — Group 2 Interrupt Threshold Counter
0x4C EvDmaCtrl — Event Group Dma Control Register
0x50 G1DmaCtrl — Group 1 Dma Control Register
0x54 G2DmaCtrl — Group 2 Dma Control Register
0x58 BndCtrl — Buffer Boundary Control Register
0x5C BndEnd — Buffer End Boundary
0x60 EvSamp — Event Group Sample Window
0x64 G1Samp — Group 1 Sample Window
0x68 G2Samp — Group 2 Sample Window
0x6C EvSr — Event Group Status Register
0x70 G1Sr — Group 1 Status Register
0x74 G2Sr — Group 2 Status Register
0x78 EvSel — Event Group select register
0x7C G1Sel — Group 1 select register
0x80 G2Sel — Group 2 select register
0x84 CalR — Calibration Register
0x88 SmState — State Macine Current State
0x8C LastConv — Last Conversion
{0x8C+4i} EvBuffer{i} (i=1..8) — Event Group Buffer
{0xAC+4i} G1Buffer{i} (i=1..8) — Group 1 Buffer
{0xCC+4i} G2Buffer{i} (i=1..8) — Group 2 Buffer
0xF0 EvEmuBuffer — Event Group Emu Buffer
0xF4 G1EmuBuffer — Group 1 Emu Buffer
0xF8 G2EmuBuffer — Group 2 Emu Buffer
0xFC EvDir — Event Group pin direction selection
0x100 EvDOut — Event Group pin data output
0x104 EvDIn — Event Group pin input value
0x108 EvDSet — Event Group pin set
0x10C EvDClr — Event Group pin clear
0x110 EvPDr — Event Group pin open-drain enable
0x114 EvPDis — Event Group pin pull control enable
0x118 EvPSel — Event Group pull select
0x11C EvSampDisEn — Event Group Discharge Control
0x120 G1SampDisEn — Group 1 Discharge Control
0x124 G2SampDisEn — Group 2 Discharge Control
{0x120+8i} MagIntCtrl{i} (i=1..6) — Magnitude Interrupt Control
{0x124+8i} MagInt{i}Msk (i=1..6) — Magnitude Interrupt Mask
0x158 MagThrIntEnaSet — Magnitude Interrupt Enable Set
0x15C MagThrIntEnaClr — Magnitude Interrupt Enable Clear
0x160 MagThrIntFlg — Magnitude Interrupt Enable Flag
0x164 MagThrIntOffst — Magnitude Interrupt Offset
0x168 EvFifoRstCtrl — Event Group FIFO Reset Control
0x16C G1FifoRstCtrl — Group 1 FIFO Reset Control
0x170 G2FifoRstCtrl — Group 2 FIFO Reset Control
0x174 EvRamAddr — Event Group RAM Pointer
0x178 G1RamAddr — Group 1 RAM Pointer
0x17C G2RamAddr — Group 2 RAM Pointer
0x180 ParCtrl — Parity Control
0x184 ParAddr — Parity Address
0x188 PwrupDlyCtrl — Power up DLY Control
0x190 EvChnSelModeCtrl — Event Group Channel Selection Mode Control
0x194 G1ChnSelModeCtrl — Group1 Channel Selection Mode Control
0x198 G2ChnSelModeCtrl — Group2 Channel Selection Mode Control
0x19C EvCurrCount — Event Group Current Count
0x1A0 G1CurrCount — Group 1 Current Count
0x1A4 G2CurrCount — Group 2 Current Count
0x1A8 EvMaxCount — Event Group Max Count
0x1AC G1MaxCount — Group 1 Max Count
0x1B0 G2MaxCount — Group 2 Max Count

## Notices in the file
(c) Texas Instruments, All rights reserved.
