# SI register map
Vendor: Texas Instruments
Peripheral module from a debugger description file (folder omap34xx).
Registers are 64-bit, read-only, reset 0x0 unless marked. A register's access mark holds for its fields unless they carry their own. Offsets are as the file gives them; lines under a group give offsets from that group; [hi:lo] are bit positions; {n}, {i} and the like mark numbered series; 'fields as' and 'values as' point back to an identical list; <NAME> marks a mode.

## SI
0x20 L3_SI_CONTROL access per field — Control of register and sideband interconnect
  [56] CLOCK_GATE_DISABLE rw — Overrides fine grained hardware clock gating in register and sideband interconnect0x0: Normal clock gating0x1: Clock gating disabled
0x110 L3_SI_FLAG_STATUS_0 — They are used to observe the individual bits that make up a composite interconnect flag.
  [63:0] STATUS — Status of sideband signals making up composite interconnect flag for application. See
0x130 L3_SI_FLAG_STATUS_1 — They are used to observe the individual bits that make up a composite interconnect flag.
  [63:0] STATUS — Status of sideband signals making up composite interconnect flag for debug. See.
