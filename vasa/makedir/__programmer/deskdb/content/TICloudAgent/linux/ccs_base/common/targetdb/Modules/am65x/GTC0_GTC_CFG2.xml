# GTC0_GTC_CFG2 register map
Vendor: Texas Instruments
Peripheral module from a debugger description file (folder am65x).
Registers are 32-bit, read-only, reset 0x0 unless marked. A register's access mark holds for its fields unless they carry their own. Offsets are as the file gives them; lines under a group give offsets from that group; [hi:lo] are bit positions; {n}, {i} and the like mark numbered series; 'fields as' and 'values as' point back to an identical list; <NAME> marks a mode.

## GTC0_GTC_CFG2
0x00 GTC_CNTCVS_LO — Indicates the current system counter count value. It reflects the same value as the CNTCV_LO register.
  [31:0] COUNTVALUE — Indicates bits [31:0] of the system counter value.
0x04 GTC_CNTCVS_HI — Indicates the current system counter count value. It reflects the same value as the CNTCV_HI register.
  [31:0] COUNTVALUE — Indicates bits [63:32] of the system counter value.
