# IPU_RW_TABLE register map
Vendor: Texas Instruments
Peripheral module from a debugger description file (folder omap5430_ES2_PUBLIC).
Registers are 32-bit, read-write, reset 0x0 unless marked. A register's access mark holds for its fields unless they carry their own. Offsets are as the file gives them; lines under a group give offsets from that group; [hi:lo] are bit positions; {n}, {i} and the like mark numbered series; 'fields as' and 'values as' point back to an identical list; <NAME> marks a mode.

## IPU_RW_TABLE
0x00 CORTEXM4_RW_PID1 — Peripheral Identification register– allows the user software to differentiate between the two ARM Cortex-M4 processors (two CPUs). The same piece of code running on the two CPUs can result in different execution (for example, branch to different location) depending on the address stored in the register. The address is stored by the BIOS code. The register cannot be accessed when the BIOS code is running (used).
  [31:0] BASEADD1 — ROM_IPU memory address
0x04 CORTEXM4_RW_PID2 — Peripheral Identification register – allows the user software to differentiate between the two ARM Cortex-M4 processors (two CPUs). The same piece of code running on the two CPUs can result in different execution (for example, branch to different location) depending on the address stored in the register. The address is stored by the BIOS code. The register cannot be accessed when the BIOS code is running (used).
  [31:0] BASEADD2 — ROM_IPU memory address
