# hercules_het_spec_2.0.0 register map
Vendor: Texas Instruments
Peripheral module from a debugger description file (folder hercules).
Registers are 32-bit, access not given, no defined reset value unless marked. A register's access mark holds for its fields unless they carry their own. Offsets are as the file gives them; lines under a group give offsets from that group; [hi:lo] are bit positions; {n}, {i} and the like mark numbered series; 'fields as' and 'values as' point back to an identical list; <NAME> marks a mode.

## HET — Platform High End Timer
0x00 GlbCtrl — global control register
0x04 Pfr — prescaler factor register
0x08 Addr — Current Address Register
0x0C Offst1 — Offset Level 1 Register
0x10 Offst2 — Offset Level 2 Register
0x14 Exc1 — Exception Control Register 1
0x18 Exc2 — Exception Control Register 2
0x1C IntPrio — Interrupt Priority Register
0x20 IntFlg — Interrupt Flag Register
0x2C HrSh — HR Share Control Register
0x30 Xor — HR Xor control register
0x34 Dir — Direction Register
0x38 DIn — Input Data Register
0x3C DOut — Output Data Register
0x40 DSet — Set Data Register
0x44 DClr — Clear Data Register
0x48 PDr — Open Drain Register
0x4C PDis — Pull Disable Register
0x50 PSel — Pull Select Register
0x54 Srs — Slew Rate Select Register
0x60 LbPairSel — Loop Back Pair Select Register
0x64 LbPairDir — Loop Back Pair Direction Register
0x68 ParCtrl — Parity Control Register
0x6C ParIntEna — Parity Interrupt Enable Register
0x70 ParIntFlg — Parity Interrupt Flag Register
0x74 ParAddr — Parity Address Register

## Notices in the file
(c) Texas Instruments 2003-2012, All rights reserved.
