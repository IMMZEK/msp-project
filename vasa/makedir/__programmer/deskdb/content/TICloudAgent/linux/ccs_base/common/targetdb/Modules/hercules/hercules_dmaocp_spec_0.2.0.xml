# hercules_dmaocp_spec_0.2.0 register map
Vendor: Texas Instruments
Peripheral module from a debugger description file (folder hercules).
Registers are 32-bit, access not given, no defined reset value unless marked. A register's access mark holds for its fields unless they carry their own. Offsets are as the file gives them; lines under a group give offsets from that group; [hi:lo] are bit positions; {n}, {i} and the like mark numbered series; 'fields as' and 'values as' point back to an identical list; <NAME> marks a mode.

## DMAOCP — Direct Memory Access
0x00 GlbCtrl — Global Control Register
0x04 ChnPnd — Channel Pending Register
0x0C Stat — Status Register
0x14 HWChnEnaSet — H/W Channel Enable Set and Status Register
0x1C HWChnEnaRst — H/W Channel Enable Reset and Status Register
0x24 SWChnEnaSet — S/W Channel Enable Set and Status Register
0x2C SWChnEnaRst — S/W Channel Enable Reset and Status Register
0x34 ChnPrioSet — Channel Priority Set Register
0x3C ChnPrioRst — Channel Priority Reset
0x44 GlbChnIntEnaSet — Global Channel Interrupt Enable Set
0x4C GlbChnIntEnaRst — Global Channel Interrupt Enable Reset
{0x54+4i} ReqAssg{i} (i=0..7) — Request Assignment Register {i}
{0x94+4i} PrtAssg{i} (i=0..3) — Port Assignment Register {i}
0xB4 FTCMap — FTC Interrupt Mapping Register
0xBC LFSMap — LFS Interrupt Mapping Register
0xC4 HBCMap — HBC Interrupt Mapping Register
0xCC BTCMap — BTC Interrupt Mapping Register
0xD4 BERMap — BER Interrupt Mapping Register
0xDC FTCIntEnaSet — FTC Interrupt Enable Set
0xE4 FTCIntEnaRst — FTC Interrupt Enable Reset
0xEC LFSIntEnaSet — LFS Interrupt Enable Set
0xF4 LFSIntEnaRst — LFS Interrupt Enable Reset
0xFC HBCIntEnaSet — HBC Interrupt Enable Set
0x104 HBCIntEnaRst — HBC Interrupt Enable Reset
0x10C BTCIntEnaSet — BTC Interrupt Enable Set
0x114 BTCIntEnaRst — BTC Interrupt Enable Reset
0x11C GlbIntFlg — Global Interrupt Flg Register
0x124 FTCIntFlg — FTC Interrupt Flag Register
0x12C LFSIntFlg — LFS Interrupt Flag Register
0x134 HBCIntFlg — HBC Interrupt Flag Register
0x13C BTCIntFlg — BER Interrupt Flag Register
0x144 BERIntFlg — BER Interrupt Flag Register
0x14C FTCAOffst — FTCA Interrupt Channel Offset Register
0x150 LFSAOffst — LFSA Interrupt Channel Offset Register
0x154 HBCAOffst — HBCA Interrupt Channel Offset Register
0x158 BTCAOffst — BTCA Interrupt Channel Offset Register
0x15C BERAOffst — BERA Interrupt Channel Offset Register
0x160 FTCBOffst — FTCB Interrupt Channel Offset Register
0x164 LSFBOffst — LFSB Interrupt Channel Offset Register
0x168 HBCBOffst — HBCB Interrupt Channel Offset Register
0x16C BTCBOffst — BTCB Interrupt Channel Offset Register
0x170 BERBOffst — BERB Interrupt Channel Offset Register
0x178 PrtCtrl — Port Control Register
0x17C RamTstCtrl — RAM TEST Control
0x180 DbgCtrl — Debug Control
0x184 WpReg — Watchpoint Register
0x188 WpMsk — Watchpoint Mask Register
0x18C PrtAChnSrcAddr — Port A Active Channel Source Address Register
0x190 PrtAChnDstAddr — Port A Active Channel Destination Address Register
0x194 PrtAChnTrCnt — Port A Active Channel Transfer Count Register
0x198 PrtBChnSrcAddr — Port B Active Channel Source Address Register
0x19C PrtBChnDestAddr — Port B Active Channel Destination Address Register
0x1A0 PrtBChnTrCnt — Port B Active Channel Transfer Count Register
0x1A8 ParCtrl — Parity Control Register
0x1AC ParErrAddr — Parity Error Address Register
0x1B0 MpCtrl — Memory Protection Control Register
0x1B4 MpStat — Memory Protection Status Register
0x1B8 Pr0Strt — Start Address of region 0
{0x1BC+8i} Pr{i}End (i=0..3) — End Address of region {i}
0x1C0 Pr1Strt — Start Address of region 0
0x1C8 Pr2Strt — Start Address of region 2
0x1D0 Pr3Strt — Start Address of region 3
0x1D8 MpCtrl2 — Memory Protection Control Register2
0x1DC MpStat2 — Memory Protection Status Register2
{0x1C0+8i} Pr{i}Strt (i=4..7) — Start Address of region {i}
{0x1C4+8i} Pr{i}End (i=4..7) — End Address of region {i}
0x200 PFCtrl — Pattern Fill Control Register
0x204 UPFReg — Upper Pattern Fill Register
0x208 LPFReg — Lower Pattern Fill Register
0x210 PMCtrl — Pattern Mask Control Register
0x214 UPMReg — Upper Pattern Mask Register
0x218 LPMReg — Lower Pattern Mask Register
0x220 CullConReg — Cull Configuration Register
0x228 SEccCtrl — Single Bit ECC Control Register
0x230 SEccAddr — Single Bit ECC Error Address Register
0x240 FifoAStat — Fifo A Status Register
0x244 FifoBStat — Fifo B Status Register
0x254 FTCMap0 — FTC Interrupt Mapping Register 0
0x258 FTCMap1 — FTC Interrupt Mapping Register 1
0x25C LFSMap0 — LFS Interrupt Mapping Register 0
0x260 LFSMap1 — LFS Interrupt Mapping Register 1
0x264 HBCMap0 — HBC Interrupt Mapping Register 0
0x268 HBCMap1 — HBC Interrupt Mapping Register 1
0x26C BTCMap0 — BTC Interrupt Mapping Register 0
0x270 BTCMap1 — BTC Interrupt Mapping Register 1
0x274 BERMap0 — BER Interrupt Mapping Register 0
0x278 BERMap1 — BER Interrupt Mapping Register 1
0x2FC FTCCOffSet — FTC Interrupt Channel Offset Register for CPU3
0x300 LFSCOffSet — LFS Interrupt Channel Offset Register for CPU3
0x304 HBCCOffSet — HBC Interrupt Channel Offset Register for CPU3
0x308 BTCCOffSet — BTC Interrupt Channel Offset Register for CPU3
0x30C BERCOffSet — BER Interrupt Channel Offset Register for CPU3
0x310 FTCDOffSet — FTC Interrupt Channel Offset Register for CPU4
0x314 LFSDOffSet — LFS Interrupt Channel Offset Register for CPU4
0x318 HBCDOffSet — HBC Interrupt Channel Offset Register for CPU4
0x31C BTCDOffSet — BTC Interrupt Channel Offset Register for CPU4
0x320 BERDOffSet — BER Interrupt Channel Offset Register for CPU4
0x330 ReqPolSel1 — Request Polarity Select Register1
0x334 ReqPolSel0 — Request Polarity Select Register0
0x340 TEREvtCtrl — TER Event Control Register
0x344 TEREvtFlag — TER Event Flag Register
0x348 TEREvtOffset — TER Event Offset Register

## Notices in the file
(c) Texas Instruments 2003-2012, All rights reserved.
