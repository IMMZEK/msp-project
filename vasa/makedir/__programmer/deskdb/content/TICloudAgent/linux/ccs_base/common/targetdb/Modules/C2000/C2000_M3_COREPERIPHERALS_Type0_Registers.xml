# C2000_M3_COREPERIPHERALS_Type0_Registers register map
Vendor: Texas Instruments
Peripheral module from a debugger description file (folder C2000).
Address unit: 16 bits
Registers are 32-bit, access not given, no defined reset value unless marked. A register's access mark holds for its fields unless they carry their own. Offsets are as the file gives them; lines under a group give offsets from that group; [hi:lo] are bit positions; {n}, {i} and the like mark numbered series; 'fields as' and 'values as' point back to an identical list; <NAME> marks a mode.

## M3_CORE_PERIPHERALS — M3 CORE PERIPHERALS Registers
0x04 NVIC_INT_TYPE — Interrupt Controller Type Reg
0x10 SYSTICK_ST_CTRL — SysTick Control and Status Reg
0x14 SYSTICK_ST_RELOAD — SysTick Reload Value Register
0x18 SYSTICK_ST_CURRENT — SysTick Current Value Register
0x1C SYSTICK_ST_CAL — SysTick Calibration Value Reg
{0x100+4i} NVIC_EN{i} (i=0..3) — IRQ {32i} to {32i+31} Set Enable Register
0x110 NVIC_EN4 — IRQ 128 to 133 Set Enable Register
{0x180+4i} NVIC_DIS{i} (i=0..3) — IRQ {32i} to {32i+31} Clear Enable Reg
0x190 NVIC_DIS4 — IRQ 128 to 133 Clear Enable Reg
0x200 NVIC_PEND0 — IRQ 0 to 31 Set Pending Register
{0x200+4i} NVIC_PEND{i} (i=1..3) — IRQ {32i} to {32i+31} Set Pending Reg
0x210 NVIC_PEND4 — IRQ 128 to 133 Set Pending Reg
{0x280+4i} NVIC_UNPEND{i} (i=0..3) — IRQ {32i} to {32i+31} Clear Pending Reg
0x290 NVIC_UNPEND4 — IRQ 128 to 133 Clear Pending Reg
{0x300+4i} NVIC_ACTIVE{i} (i=0..3) — IRQ {32i} to {32i+31} Active Register
0x310 NVIC_ACTIVE4 — IRQ 128 to 133 Active Register
{0x400+4i} NVIC_PRI{i} (i=0..33) — IRQ {4i} to {4i+3} Priority Register
0xD00 SCB_CPUID — CPUID Base Register
0xD04 SCB_INT_CTRL — Interrupt Control State Register
0xD08 SCB_VTABLE — Vector Table Offset Register
0xD0C SCB_APINT — App. Int & Reset Control Reg
0xD10 SCB_SYS_CTRL — System Control Register
0xD14 SCB_CFG_CTRL — Configuration Control Register
{0xD14+4i} SCB_SYS_PRI{i} (i=1..3) — Sys. Handlers {4i} to {4i+3} Priority
0xD24 SCB_SYS_HND_CTRL — System Handler Control and State
0xD28 SCB_FAULT_STAT — Configurable Fault Status Reg
0xD2C SCB_HFAULT_STAT — Hard Fault Status Register
0xD30 DEBUG_STAT — Debug Status Register
0xD34 SCB_MM_ADDR — Mem Manage Address Register
0xD38 SCB_FAULT_ADDR — Bus Fault Address Register
0xD90 MPU_TYPE
0xD94 MPU_CTRL — MPU Control Register
0xD98 MPU_NUMBER — MPU Region Number Register
0xD9C MPU_BASE — MPU Region Base Address Register
0xDA0 MPU_ATTR — MPU Region Attribute & Size Reg
0xDF0 DEBUG_DBG_CTRL — Debug Control and Status Reg
0xDF4 DEBUG_DBG_XFER — Debug Core Reg. Transfer Select
0xDF8 DEBUG_DBG_DATA — Debug Core Register Data
0xDFC DEBUG_DBG_INT — Debug Reset Interrupt Control
0xF00 NVIC_SW_TRIG — Software Trigger Interrupt Reg
