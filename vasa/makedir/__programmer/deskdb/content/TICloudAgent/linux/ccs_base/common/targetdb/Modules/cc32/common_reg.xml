# common_reg register map
Vendor: Texas Instruments
Peripheral module from a debugger description file (folder cc32).
Registers are 32-bit, access not given, no defined reset value unless marked. A register's access mark holds for its fields unless they carry their own. Offsets are as the file gives them; lines under a group give offsets from that group; [hi:lo] are bit positions; {n}, {i} and the like mark numbered series; 'fields as' and 'values as' point back to an identical list; <NAME> marks a mode.

## common_reg
0x00 I2C_PROPERTIES_REGISTER rw
  [1:0] COMMON_REG_I2C_Properties_Register_I2C_Properties_Register — Each semaphore register is of 2 bit. When this register is set to 2b01 Apps have access and when set to 2b10 NW have access. Ideally both the master can modify any of this 2 bit, but assumption apps will write only 2b01 or 2b00 to this register and nw will write only 2b10 or 2b00. Implementation is when any of the bit of this register is set, only next write allowedvis 2b00 Again assumption is one master will not write 2b00 if other is already holding the semaphore.
0x04 SPI_PROPERTIES_REGISTER rw
  [1:0] COMMON_REG_SPI_Properties_Register_SPI_Properties_Register — Each semaphore register is of 2 bit. When this register is set to 2b01 Apps have access and when set to 2b10 NW have access. Ideally both the master can modify any of this 2 bit, but assumption apps will write only 2b01 or 2b00 to this register and nw will write only 2b10 or 2b00. Implementation is when any of the bit of this register is set, only next write allowedvis 2b00 Again assumption is one master will not write 2b00 if other is already holding the semaphore.
0x0C APPS_SH_RESOURCE_INTERRUPT_ENABLE rw
  [3:0] COMMON_REG_APPS_sh_resource_Interrupt_enable_APPS_sh_resource_Interrupt_enable — Interrupt enable APPS bit 0 -> when '1' enable I2C interrupt bit 1 -> when '1' enable SPI interrupt bit 3 -> when '1' enable GPIO interrupt
0x10 APPS_SH_RESOURCE_INTERRUPT_STATUS rw
  [3:0] COMMON_REG_APPS_sh_resource_Interrupt_status_APPS_sh_resource_Interrupt_status — Interrupt enable APPS bit 0 -> when '1' enable I2C interrupt bit 1 -> when '1' enable SPI interrupt bit 3 -> when '1' enable GPIO interrupt
0x14 NWP_SH_RESOURCE_INTERRUPT_ENABLE rw
  [3:0] COMMON_REG_NWP_sh_resource_Interrupt_enable_NWP_sh_resource_Interrupt_enable — Interrupt enable NWP bit 0 -> when '1' enable I2C interrupt bit 1 -> when '1' enable SPI interrupt bit 3 -> when '1' enable GPIO interrupt
0x18 NWP_SH_RESOURCE_INTERRUPT_STATUS rw
  [3:0] COMMON_REG_NWP_sh_resource_Interrupt_status_NWP_sh_resource_Interrupt_status — Interrupt enable NWP bit 0 -> when '1' enable I2C interrupt bit 1 -> when '1' enable SPI interrupt bit 3 -> when '1' enable GPIO interrupt
0x1C FLASH_CTRL_REG rw
  [1:0] COMMON_REG_Flash_ctrl_reg_Flash_ctrl_reg — Each semaphore register is of 2 bit. When this register is set to 2b01 Apps have access and when set to 2b10 NW have access. Ideally both the master can modify any of this 2 bit, but assumption apps will write only 2b01 or 2b00 to this register and nw will write only 2b10 or 2b00. Implementation is when any of the bit of this register is set, only next write allowedvis 2b00 Again assumption is one master will not write 2b00 if other is already holding the semaphore.
{0x24+4i} BUS_MATRIX_M{i}_SEGMENT_ACCESS_CONFIG rw (i=0..5)
  [17:0] COMMON_REG_Bus_matrix_M{i}_segment_access_config_Bus_matrix_M{i}_segment_access_config — Master {i} control word matrix to each segment. Tieoff. Bit value 1 indicates segment is accesable.
0x3C GPIO_PROPERTIES_REGISTER rw
  [9:0] COMMON_REG_GPIO_properties_register_GPIO_properties_register — Shared GPIO configuration register. Bit [1:0] to configure GPIO0 Bit [3:2] to configure GPIO1 Bit [5:4] to configure GPIO2 Bit [7:6] to configure GPIO3 Bit [9:8] to configure GPIO4 each GPIO can be individully selected. When 00? GPIO is free resource. When 01? GPIO is APPS resource. When 10? GPIO is NWP resource. Writing 11 doesnt have any affect, i.e. If one write only relevant gpio semaphore and other bits are 1s, it'll not disturb the other semaphore bits. For example : Say If NW wants to take control of gpio-1, one should write 10'b11_1111_1011 and if one wants to release it write 10'b11_1111_0011.
{0x3C+4i} APPS_NW_SEMAPHORE{i} (i=1..12)
0x70 APPS_SEMAPPHORE_PEND
0x74 NW_SEMAPPHORE_PEND
0x78 SEMAPHORE_STATUS
0x7C IDMEM_TIM_UPDATE
0x80 FPGA_ROM_WR_EN
0x84 NW_INT_MASK
0x88 NW_INT_MASK_SET
0x8C NW_INT_MASK_CLR
0x90 NW_INT_STS_CLR
0x94 NW_INT_ACK
0x98 NW_INT_TRIG
0x9C NW_INT_STS_MASKED
0xA0 NW_INT_STS_RAW
0xA4 APPS_INT_MASK
0xA8 APPS_INT_MASK_SET
0xAC APPS_INT_MASK_CLR
0xB0 APPS_INT_STS_CLR
0xB4 APPS_INT_ACK
0xB8 APPS_INT_TRIG
0xBC APPS_INT_STS_MASKED
0xC0 APPS_INT_STS_RAW
0xC4 IDMEM_TIM_UPDATED
0xC8 APPS_GPIO_TRIG_EN rw
  [4:0] APPS_GPIO_TRIG_EN — APPS GPIO Trigger EN control. Bit 0: when '1' enable GPIO 0 trigger. This bit enables trigger for all GPIO 0 pins (GPIO 0 to GPIO7). Bit 1: when '1' enable GPIO 1 trigger. This bit enables trigger for all GPIO 1 pins ( GPIO8 to GPIO15). Bit 2: when '1' enable GPIO 2 trigger. This bit enables trigger for all GPIO 2 pins (GPIO16 to GPIO23). Bit 3: when '1' enable GPIO 3 trigger. This bit enables trigger for all GPIO 3 pins (GPIO24 to GPIO31). Bit 4: when '1' enable GPIO 4 trigger. This bit enables trigger for all GPIO 4 pins.(GPIO32 to GPIO39)
0xCC EMU_DEBUG_REG
0xD0 SEMAPHORE_STATUS2 rw
  [23:0] SEMPAPHORE_STATUS2 — SEMAPHORE STATUS 23:22 :semaphore status of apps_nw_semaphore11 21:20 :semaphore status of apps_nw_semaphore11 19:18 :semaphore status of apps_nw_semaphore10 17:16 :semaphore status of apps_nw_semaphore9 15:14 :semaphore status of apps_nw_semaphore8 13:12 :semaphore status of apps_nw_semaphore7 11:10 :semaphore status of apps_nw_semaphore6 9:8 :semaphore status of apps_nw_semaphore5 7:6 :semaphore status of apps_nw_semaphore4 5:4 :semaphore status of apps_nw_semaphore3 3:2 :semaphore status of apps_nw_semaphore2 1:0 :semaphore status of apps_nw_semaphore1
0xD4 SEMAPHORE_PREV_OWNER1 rw
  [17:0] SEMAPHORE_PREV_OWNER1 — 1:0 : prvious owner of i2c_properties_reg[1:0] 3:2 : prvious owner of spi_properties_reg[1:0] 5:4 : prvious owner of gpio_properties_reg[1:0] 9:8 : prvious owner of gpio_properties_reg[3:2] 11:10 : prvious owner of gpio_properties_reg[5:4] 13:12 : prvious owner of gpio_properties_reg[7:6] 15:14 : prvious owner of gpio_properties_reg[9:8] 17:16 : prvious owner of flash_control_reg[1:0]
0xD8 SEMAPHORE_PREV_OWNER2 rw
  [23:0] SEMAPHORE_PREV_OWNER2 — 1:0 : previous owner of apps_nw_semaphore1_reg[1:0] 3:2 : previous owner of apps_nw_semaphore2_reg[1:0] 5:4 : previous owner of apps_nw_semaphore3_reg[1:0] 7:6 : previous owner of apps_nw_semaphore4_reg[1:0] 9:8 : previous owner of apps_nw_semaphore5_reg[1:0] 11:10 : previous owner of apps_nw_semaphore6_reg[1:0] 13:12 : previous owner of apps_nw_semaphore7_reg[1:0] 15:14 : previous owner of apps_nw_semaphore8_reg[1:0] 17:16 : previous owner of apps_nw_semaphore9_reg[1:0] 19:18 : previous owner of apps_nw_semaphore10_reg[1:0] 21:20 : previous owner of apps_nw_semaphore11_reg[1:0] 23:22 : previous owner of apps_nw_semaphore12_reg[1:0]
