# CKGEN_PRM register map
Vendor: Texas Instruments
Peripheral module from a debugger description file (folder omap5430_ES2_PUBLIC).
Registers are 32-bit, access per field, reset 0x0 unless marked. A register's access mark holds for its fields unless they carry their own. Offsets are as the file gives them; lines under a group give offsets from that group; [hi:lo] are bit positions; {n}, {i} and the like mark numbered series; 'fields as' and 'values as' point back to an identical list; <NAME> marks a mode.

## CKGEN_PRM
0x00 CM_CLKSEL_ABE_DSS_SYS — Select the SYS_CLK for ABE and DSS subsystems. [warm reset insensitive]
  [0] CLKSEL rw — Selects the divider value
    0=SYSCLK_DIV_1 (Select SYS_CLK divided by 1); 1=SYSCLK_DIV_2 (Select SYS_CLK divided by 2. Must be used for SYS_CLK > 26MHz)
0x08 CM_CLKSEL_WKUPAON — Control the functional clock source of the WKUPAON, PRM and Smart Reflex functional clock.
  [0] CLKSEL rw — Select the clock source for WKUPAON_ICLK and for ABE_DPLL_BYPASS_CLK clocks.
    0=SEL_SYS_CLK (Selects SYS_CLK for WKUPAON_ICLK Selects SYS_CLK for ABE_DPLL_BYPASS_CLK); 1=SEL_ABE_X1_LP_CLK (Selects ABE_LP_CLK for WKUPAON_ICLK Selects FUNC_32K_CLK for ABE_DPLL_BYPASS_CLK)
0x0C CM_CLKSEL_ABE_PLL_REF reset 0x1 — Control the source of the reference clock for DPLL_ABE
  [0] CLKSEL rw — Select the source for the DPLL_ABE reference clock.
    0=SEL_SYS_CLK (Selects SYS_CLK); 1=SEL_SYS_32K (Selects SYS_32K)
0x10 CM_CLKSEL_SYS — Software sets the SYS_CLK configuration corresponding to the frequency of SYS_CLK. [warm reset insensitive]
  [2:0] SYS_CLKSEL rw — System clock input selection.
    0=UNSET (Uninitialized); 1=12_MHz (Input clock is 12 MHz); 3=16_8_Mhz (Input clock is 16.8 MHz); 4=19_2_MHz (Input clock is 19.2 MHz); 5=26_MHz (Input clock is 26 MHz); 7=38_4_MHz (Input clock is 38.4 MHz)
