# MCASP0_DMA register map
Vendor: Texas Instruments
Peripheral module from a debugger description file (folder am65x).
Registers are 32-bit, read-only, reset 0x0 unless marked. A register's access mark holds for its fields unless they carry their own. Offsets are as the file gives them; lines under a group give offsets from that group; [hi:lo] are bit positions; {n}, {i} and the like mark numbered series; 'fields as' and 'values as' point back to an identical list; <NAME> marks a mode.

## MCASP0_DMA
0x8000 MCASP_RXBUF — Through the DATA port , the Host can service all serializers through a single address and the MCASP automatically cycles through the appropriate serializers. For receive operations through the DATA port, the Host should read from the same MCASP_RBUF DATA port address to service all of the active receive serializers upon each receive data ready event. To enable accesses from the Host to the MCASP_RXBUFn registers through the DATA port, one must clear the RBUSEL bits to 0 in the respective registers.
  [31:0] RXBUF — Rx buffer data.
0x8000 MCASP_TXBUF wo — Through the DATA port, the Host can service all serializers through a single address and the MCASP automatically cycles through the appropriate serializers. For transmit operations through the DATA port, the Host should write to the same DATA port address to service all of the active transmit serializers upon each transmit data ready event. To enable accesses from the Host to the MCASP_TXBUFn registers through the DATA port, one must clear the XBUSEL bits to 0 in the respective registers.
  [31:0] TXBUF — Tx buffer data.
