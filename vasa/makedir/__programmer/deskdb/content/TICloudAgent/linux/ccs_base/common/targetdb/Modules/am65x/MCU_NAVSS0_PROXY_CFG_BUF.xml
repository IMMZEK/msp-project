# MCU_NAVSS0_PROXY_CFG_BUF register map
Vendor: Texas Instruments
Peripheral module from a debugger description file (folder am65x).
Registers are 32-bit, read-write, reset 0x0 unless marked. A register's access mark holds for its fields unless they carry their own. Offsets are as the file gives them; lines under a group give offsets from that group; [hi:lo] are bit positions; {n}, {i} and the like mark numbered series; 'fields as' and 'values as' point back to an identical list; <NAME> marks a mode.

## MCU_NAVSS0_PROXY_CFG_BUF
0x00 PROXY_DATA_y — The Proxy Buffer for the proxy Offset = 0h + (y * 4h); where y = 0h to FFFh
  [31:0] VAL — Proxy Buffer Data
