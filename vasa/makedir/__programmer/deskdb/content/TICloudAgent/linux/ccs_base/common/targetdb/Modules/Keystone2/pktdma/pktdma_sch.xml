# pktdma_sch register map
Vendor: Texas Instruments
Peripheral module from a debugger description file (folder pktdma).
Registers are 32-bit, read-write, no defined reset value unless marked. A register's access mark holds for its fields unless they carry their own. Offsets are as the file gives them; lines under a group give offsets from that group; [hi:lo] are bit positions; {n}, {i} and the like mark numbered series; 'fields as' and 'values as' point back to an identical list; <NAME> marks a mode.

## SRIO_PKTDMA_TX_SCH
0x00 TX_CHANNEL_SCHEDULER_CONFIG_REG — (1 of 129, stride 4)
  [1:0] priority — Tx scheduling priority: 0=high, 1=medium-high, 2=medium-low, 3=low
