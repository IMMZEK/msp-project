# EFUSE0 register map
Vendor: Texas Instruments
Peripheral module from a debugger description file (folder am62x).
Registers are 32-bit, read-write, reset 0x0 unless marked. A register's access mark holds for its fields unless they carry their own. Offsets are as the file gives them; lines under a group give offsets from that group; [hi:lo] are bit positions; {n}, {i} and the like mark numbered series; 'fields as' and 'values as' point back to an identical list; <NAME> marks a mode.

## EFUSE0
0x00 MEM_SYS_STATUS — efuse system_status
  [31:0] STATUS — efuse system status
0x04 MEM_OCP_CTRL_LOWER — OCP control
  [31:0] OCP_CONTROL_LOWER
0x08 MEM_OCP_CTRL_UPPER — OCP control
  [31:0] OCP_CONTROL_UPPER
0x10 MEM_SYS_CONFIG — System config
  [31:0] SYS_CONFIG — efuse system config
