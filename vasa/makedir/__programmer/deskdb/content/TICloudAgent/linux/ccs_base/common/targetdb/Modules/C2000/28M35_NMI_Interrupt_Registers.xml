# 28M35_NMI_Interrupt_Registers register map
Vendor: Texas Instruments
Peripheral module from a debugger description file (folder C2000).
Address unit: 16 bits
Registers are 16-bit, access not given, no defined reset value unless marked. A register's access mark holds for its fields unless they carry their own. Offsets are as the file gives them; lines under a group give offsets from that group; [hi:lo] are bit positions; {n}, {i} and the like mark numbered series; 'fields as' and 'values as' point back to an identical list; <NAME> marks a mode.

## NMI_INTRUPT_REGS — NMI INTRUPT REGS Registers
0x00 NMICFG — C28 NMI Configuration Register
0x01 NMIFLG — C28 NMI Flag Register
0x02 NMIFLGCLR — C28 NMI Flag Clear Register
0x03 NMIFLGFRC — C28 NMI Flag Force Register
0x04 NMIWDCNT — C28 NMI Watchdog Counter Register
0x05 NMIWDPRD — C28 NMI Watchdog Period Register
