# hercules_mibspip_spec_3.9.1 register map
Vendor: Texas Instruments
Peripheral module from a debugger description file (folder hercules).
Registers are 32-bit, access not given, no defined reset value unless marked. A register's access mark holds for its fields unless they carry their own. Offsets are as the file gives them; lines under a group give offsets from that group; [hi:lo] are bit positions; {n}, {i} and the like mark numbered series; 'fields as' and 'values as' point back to an identical list; <NAME> marks a mode.

## MibSpi — Multibuffered Serial Peripheral Interface
0x00 GlbCtrl0 — Global control register 0
0x04 GlbCtrl1 — Global control register 1
0x08 Int0 — Interrupt Register
0x0C IntLvl — Interrupt Level Register
0x10 IntFlg — Flag Register
0x14 Fun — Pin Control 0
0x18 Dir — Pin Control 1
0x1C DIn — Pin Control 2
0x20 DOut — Pin Control 3
0x24 DSet — Pin Control 4
0x28 DClr — Pin Control 5
0x2C PDr — Pin Control 6
0x30 PDis — Pin Control 7
0x34 PSel — Pin Control 8
0x38 TxDat0 — Transmit Data Register 0
0x3C TxDat1 — Transmit Data Register 1
0x40 RxBuf — Receive Buffer Register
0x44 Emu — Emulation Register
0x48 Delay
0x4C DefCs — Default Chip select Register
{0x50+4i} DatFmt{i} (i=0..3) — Data Format Register {i}
0x60 TgIntVec0 — Transfer Group Interrupt Vector Register 0
0x64 TgIntVec1 — Transfer Group Interrupt Vector Register 1
0x68 SrSel — Pin Control Register 9
0x6C PmCtrl — Parallel/Modulo Mode Control Register
0x70 MibSpiEna — MibSPI Enable Register
0x74 TgIntEnaSet — MibSPI Transfer Group Interrupt Enable Set Register
0x78 TgIntEnaClr — MibSPI Transfer Group Interrupt Enable Clear Register
0x7C TgIntLvlSet — MibSPI Transfer Group Interrupt Level Set Register
0x80 TgIntLvlClr — MibSPI Transfer Group Interrupt Level Clear Register
0x84 TgIntFlg — Transfer Group Interrupt Flag Register
0x90 TickCnt
0x94 LTgPend — Last Transfer Group End Pointer
{0x98+4i} Tg{i}Ctrl (i=0..15) — MibSPI Transfer Group Control Register {i}
{0xD8+4i} Dma{i}Ctrl (i=0..7) — MibSPI Dma Channel Control Register {i}
{0xF8+4i} Dma{i}Cnt (i=0..7) — ICnt Register {i}
0x118 DmaCntLen — Dma LARGE Cnt register
0x120 UErrCtrl — Uncorrectable Parity Error Control Register
0x124 UErrStat — Uncorrectable Parity Error Status Register
0x128 UErrAddr1 — Uncorrectable Parity Error Address Register
0x12C UErrAddr0 — Uncorrectable Parity Error Address Register
0x130 RxOvrNBufAddr — Receive RAM Overrun Buffer Address Register
0x134 IoLpbkTstCtrl — IO Loopback Test Control Register
0x138 EXTENDED_PRESCALE1 — Extended Prescale Register 1
0x13C EXTENDED_PRESCALE2 — Extended Prescale Register 2
0x140 ECCDIAG_CTRL — ECC Control register
0x144 ECCDIAG_STAT — ECC Diagnostic Status register
0x148 SBitErrAddr1 — Single Bit Error Address for RXRAM
0x14C SBitErrAddr0 — Single Bit Error Address for TXRAM
0x1FC SPIREV — Revision ID Register

## Notices in the file
(c) Texas Instruments 2003-2012, All rights reserved.
