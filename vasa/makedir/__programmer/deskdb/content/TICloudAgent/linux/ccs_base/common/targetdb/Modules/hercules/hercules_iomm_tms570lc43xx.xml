# hercules_iomm_tms570lc43xx register map
Vendor: Texas Instruments
Peripheral module from a debugger description file (folder hercules).
Registers are 32-bit, access not given, no defined reset value unless marked. A register's access mark holds for its fields unless they carry their own. Offsets are as the file gives them; lines under a group give offsets from that group; [hi:lo] are bit positions; {n}, {i} and the like mark numbered series; 'fields as' and 'values as' point back to an identical list; <NAME> marks a mode.

## IOMM — IOMM Multiplexing Control Module for TMS570LC44xx
0x00 Rev — Module Revision Register
{0x8+4i} DieId{i} (i=0..3) — Die Id Register {i}
0x18 DevId0 — Device Id Register 0
0x1C DevId1 — Device Id Register 1
0x20 BootConfig0 — Boot Config Register 0
0x38 Kick0 — Kicker Register 0
0x3C Kick1 — Kicker Register 1
0xE0 ErrRawStatSet — Error Raw Status/Set Register
0xE4 ErrEnaStatClr — Error Enabled Status/Clear Register
0xE8 ErrEna — Error Enable Register
0xEC ErrEnaClr — Error Enable Clear Register
0xF4 Fault_Addr — Fault Address Register
0xF8 Fault_Stat — Fault Status Register
0xFC Fault_Clr — Fault Clear Register
{0x110+4i} PINMMR{i} (i=0..37) — Pin Multiplexing Control Register {i}
{0x110+4i} PINMMR{i} (i=80..99) — Pin Multiplexing Control Register {i}
{0x110+4i} PINMMR{i} (i=160..171) — Pin Multiplexing Control Register {i}
{0x120+4i} PINMMR{i} (i=172..179) — Pin Multiplexing Control Register {i}

## Notices in the file
(c) Texas Instruments 2003-2012, All rights reserved.
