# f28p65x_uid_regs register map
Vendor: Texas Instruments
Peripheral module from a debugger description file (folder C2000).
Address unit: 16 bits
Registers are 32-bit, read-only, no defined reset value unless marked. A register's access mark holds for its fields unless they carry their own. Offsets are as the file gives them; lines under a group give offsets from that group; [hi:lo] are bit positions; {n}, {i} and the like mark numbered series; 'fields as' and 'values as' point back to an identical list; <NAME> marks a mode.

## UID_REGS — UID Registers
{0x0+2i} UID_PSRAND{i} (i=0..4) — UID Psuedo-random 160 bit number
  [31:0] RandomID — Random Identifier
0x0A UID_UNIQUE0 — UID Unique 64 bit number
  [31:0] UniqueID — Unique Identifier
0x0C UID_UNIQUE1 — UID Unique 64 bit number
  [31:0] UniqueID — Unique Identifier
0x0E UID_CHECKSUM
