# hercules_htu_spec_1.1.1d register map
Vendor: Texas Instruments
Peripheral module from a debugger description file (folder hercules).
Registers are 32-bit, access not given, no defined reset value unless marked. A register's access mark holds for its fields unless they carry their own. Offsets are as the file gives them; lines under a group give offsets from that group; [hi:lo] are bit positions; {n}, {i} and the like mark numbered series; 'fields as' and 'values as' point back to an identical list; <NAME> marks a mode.

## HTU — HET Transfer Unit
0x00 GlbCtrl — Global Control Register
0x04 CPEna — Control Packet Enable Register
{0x8+4i} Busy{i} (i=0..3) — Control Packet (CP) Busy Register {i}
0x18 ACp — Active Control Packet Register
0x20 RLBECtrl — Request Lost and Bus Error Control Register
0x24 BFIntSet — Buffer Full Interrupt Enable Set Register
0x28 BFIntClr — Buffer Full Interrupt Enable Clear Register
0x2C IntMap — Interrupt Mapping Register
0x34 IntOffst0 — Interrupt Offset Register 0
0x38 IntOffst1 — Interrupt Offset Register 1
0x3C BIm — Buffer Initialization Mode Register
0x40 RLostFlg — Request Lost Flag Register
0x44 BFIntFlg — Buffer Full Interrupt Flag Register
0x48 BerIntFlg — BER Interrupt Flag Register
0x4C Mp1Strt — Memory Protection 1 Start Address
0x50 Mp1End — Memory Protection 1 End Address
0x54 DbgCtrl — Debug Control Register
0x58 WpReg — Watch Point Register
0x5C WpMsk — Watch Mask Register
0x60 Id — Module Identification Register
0x64 ParCtrl — Parity Control Register
0x68 ParAddr — Parity Address Register
0x70 MpCtrlStat — Memory Protection Control and Status Register
0x74 Mp0Strt — Memory Protection Start Address Register
0x78 Mp0End — Memory Protection End Address Register

## Notices in the file
(c) Texas Instruments 2003-2012, All rights reserved.
