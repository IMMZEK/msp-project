# f28p65x_aes_ss_regs register map
Vendor: Texas Instruments
Peripheral module from a debugger description file (folder C2000).
Address unit: 16 bits
Registers are 32-bit, read-only, no defined reset value unless marked. A register's access mark holds for its fields unless they carry their own. Offsets are as the file gives them; lines under a group give offsets from that group; [hi:lo] are bit positions; {n}, {i} and the like mark numbered series; 'fields as' and 'values as' point back to an identical list; <NAME> marks a mode.

## AES_SS_REGS — AES SS Registers
0x02 AES_GLB_INT_FLG — AES Global Interrupt Flag Register
  [0] INT_FLG — Global Interrupt Flag for AES Interrupt
0x04 AES_GLB_INT_CLR rw — AES Global Interrupt Clear Register
  [0] INT_FLG_CLR — Global Interrupt flag clear for AES Interrupt
