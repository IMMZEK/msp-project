# 28M36x_Device_Emulation_Registers register map
Vendor: Texas Instruments
Peripheral module from a debugger description file (folder C2000).
Address unit: 16 bits
Registers are 32-bit, access not given, no defined reset value unless marked. A register's access mark holds for its fields unless they carry their own. Offsets are as the file gives them; lines under a group give offsets from that group; [hi:lo] are bit positions; {n}, {i} and the like mark numbered series; 'fields as' and 'values as' point back to an identical list; <NAME> marks a mode.

## DEV_EMU_REGS — DEV EMU REGS Registers
0x00 DEVICECNF — Device Configuration Register
0x02 PARTID 16-bit — Device ID Register
0x03 REVID 16-bit — Revision Register
{0x6+2i} CCNF{i} (i=0..4) — C28 Peripheral Configuration {i}
0x46 MEMCNF — M3 Memory Configuartion Register
