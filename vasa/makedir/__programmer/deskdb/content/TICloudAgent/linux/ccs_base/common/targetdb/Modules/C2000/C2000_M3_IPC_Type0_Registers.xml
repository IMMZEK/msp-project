# C2000_M3_IPC_Type0_Registers register map
Vendor: Texas Instruments
Peripheral module from a debugger description file (folder C2000).
Address unit: 16 bits
Registers are 32-bit, access not given, no defined reset value unless marked. A register's access mark holds for its fields unless they carry their own. Offsets are as the file gives them; lines under a group give offsets from that group; [hi:lo] are bit positions; {n}, {i} and the like mark numbered series; 'fields as' and 'values as' point back to an identical list; <NAME> marks a mode.

## IPC_REGS — IPC REGS Registers
0x00 CTOMIPCACK — C28 to M3 Interrupt Request Clear
0x04 CTOMIPCSTS — C28 to M3 Interrupt Status
0x08 MTOCIPCSET — M3 to C28 Interrupt Request Set
0x0C MTOCIPCCLR — M3 to C28 Interrupt Request Clear
0x10 MTOCIPCFLG — M3 to C28 Interrupt Status Flag
0x18 MIPCCOUNTERL — IPC Counter Low Register
0x1C MIPCCOUNTERH — IPC Counter High Register
0x20 CTOMIPCCOM — C28 to M3 Command
0x24 CTOMIPCADDR — C28 to M3 Address
0x28 CTOMIPCDATAW — C28 to M3 Data Write
0x2C CTOMIPCDATAR — C28 to M3 Data Read
0x30 MTOCIPCCOM — M3 to C28 Command Register
0x34 MTOCIPCADDR — M3 to C28 Address
0x38 MTOCIPCDATAW — M3 to C28 Data Write
0x3C MTOCIPCDATAR — M3 to C28 Data Read
0x40 CTOMIPCBOOTSTS — IPC Boot Status
0x44 MTOCIPCBOOTMODE — IPC Boot Mode
0x48 MPUMPREQUEST — Flash Programming Semaphore Pump Request
0x4C MCLKREQUEST — Clock Configuratioin Semaphore M3 Request
