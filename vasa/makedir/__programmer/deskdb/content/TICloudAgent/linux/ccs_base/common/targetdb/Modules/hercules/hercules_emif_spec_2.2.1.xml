# hercules_emif_spec_2.2.1 register map
Vendor: Texas Instruments
Peripheral module from a debugger description file (folder hercules).
Registers are 32-bit, access not given, no defined reset value unless marked. A register's access mark holds for its fields unless they carry their own. Offsets are as the file gives them; lines under a group give offsets from that group; [hi:lo] are bit positions; {n}, {i} and the like mark numbered series; 'fields as' and 'values as' point back to an identical list; <NAME> marks a mode.

## Emif — External Memory Interface
0x00 RevCdStat — Revision Code and Status Register
{0xC+4i} Async{i}Cfg (i=1..4) — Asynchronous {i} Configuration Register (CS{i-1} space)

## Notices in the file
(c) Texas Instruments 2003-2012, All rights reserved.
