# C2000_M3_WDT_Type0_Registers register map
Vendor: Texas Instruments
Peripheral module from a debugger description file (folder C2000).
Address unit: 16 bits
Registers are 32-bit, access not given, no defined reset value unless marked. A register's access mark holds for its fields unless they carry their own. Offsets are as the file gives them; lines under a group give offsets from that group; [hi:lo] are bit positions; {n}, {i} and the like mark numbered series; 'fields as' and 'values as' point back to an identical list; <NAME> marks a mode.

## WDT_REGS — WDT REGS Registers
0x00 WDTLOAD — Watchdog Load
0x04 WDTVALUE — Watchdog Value
0x08 WDTCTL — Watchdog Control
0x0C WDTICR — Watchdog Interrupt Clear
0x10 WDTRIS — Watchdog Raw Interrupt Status
0x14 WDTMIS — Watchdog Masked Interrupt Status
0x418 WDTTEST — Watchdog Test
0xC00 WDTLOCK — Watchdog Lock
{0xFC0+4i} WDTPERIPHID{i} (i=4..7) — Watchdog Peripheral Identification {i}
{0xFE0+4i} WDTPERIPHID{i} (i=0..3) — Watchdog Peripheral Identification {i}
{0xFF0+4i} WDTPCELLID{i} (i=0..3) — Watchdog PrimeCell Identification {i}
