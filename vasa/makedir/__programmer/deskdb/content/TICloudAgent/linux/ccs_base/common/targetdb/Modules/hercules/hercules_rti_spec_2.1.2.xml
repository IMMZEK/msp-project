# hercules_rti_spec_2.1.2 register map
Vendor: Texas Instruments
Peripheral module from a debugger description file (folder hercules).
Registers are 32-bit, access not given, no defined reset value unless marked. A register's access mark holds for its fields unless they carry their own. Offsets are as the file gives them; lines under a group give offsets from that group; [hi:lo] are bit positions; {n}, {i} and the like mark numbered series; 'fields as' and 'values as' point back to an identical list; <NAME> marks a mode.

## Rti — Real Time Interrupt
0x00 GlbCtrl — global control register
0x04 TbCtrl — timebase control register
0x08 CapCtrl — capture control register
0x0C CompCtrl — compare control register
0x10 Frc0 — free running counter 0 register
0x14 Uc0 — up counter 0 register
0x18 CpUc0 — compare up counter 0 register
0x20 CaFrc0 — capture free running counter 0 register
0x24 CaUc0 — capture up counter 0 register
0x30 Frc1 — free running counter 1 register
0x34 Uc1 — up counter 1 register
0x38 CpUc1 — up counter 1 register
0x40 CaFrc1 — Capture Free Running Counter 1 Register
0x44 CaUc1 — Capture Up Counter 1 Register
{0x50+8i} Comp{i} (i=0..3) — Compare {i} Register
{0x54+8i} UdCp{i} (i=0..3) — Update Compare {i} Register
0x70 TbLComp — External Clock Timebase Low Compare Register
0x74 TbHComp — External Clock Timebase High Compare Register
0x80 SetInt — Set/Status Interrupt Register
0x84 ClearInt — Clear/Status Interrupt Register
0x88 IntFlag — Interrupt Flag Register
0x90 DwdCtrl — Digital Watchdog Control Register
0x94 DwdPrld — Digital Watchdog Preload Register
0x98 WdStatus — Watchdog Status Register
0x9C WdKey — Watchdog Key Register
0xA0 WdCntr — Digital Watchdog Down Counter

## Notices in the file
(c) Texas Instruments 2003-2012, All rights reserved.
