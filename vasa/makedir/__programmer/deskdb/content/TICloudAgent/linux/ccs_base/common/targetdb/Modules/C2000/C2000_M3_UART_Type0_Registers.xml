# C2000_M3_UART_Type0_Registers register map
Vendor: Texas Instruments
Peripheral module from a debugger description file (folder C2000).
Address unit: 16 bits
Registers are 32-bit, access not given, no defined reset value unless marked. A register's access mark holds for its fields unless they carry their own. Offsets are as the file gives them; lines under a group give offsets from that group; [hi:lo] are bit positions; {n}, {i} and the like mark numbered series; 'fields as' and 'values as' point back to an identical list; <NAME> marks a mode.

## UART_REGS — UART REGS Registers
0x00 UARTDR — UART Data
0x04 UARTRSR_TECR — UART Receive Status / Error Clear
0x18 UARTFR — UART Flag
0x20 UARTILPR — UART IrDA Low-Power Register
0x24 UARTIBRD — UART Integer Baud-Rate Divisor
0x28 UARTFBRD — UART Fractional Baud-Rate Divisor
0x2C UARTLCRH — UART Line Control
0x30 UARTCTL — UART Control
0x34 UARTIFLS — UART Interrupt FIFO Level Select
0x38 UARTIM — UART Interrupt Mask
0x3C UARTRIS — UART Raw Interrupt Status
0x40 UARTMIS — UART Masked Interrupt Status
0x44 UARTICR — UART Interrupt Clear
0x48 UARTDMACTL — UART DMA Control
0x90 UARTLCTL — UART LIN Control
0x94 UARTLSS — UART LIN Snap Shot
0x98 UARTLTIM — UART LIN Timer
{0xFC0+4i} UARTPERIPHID{i} (i=4..7) — UART Peripheral Identification {i}
{0xFE0+4i} UARTPERIPHID{i} (i=0..3) — UART Peripheral Identification {i}
{0xFF0+4i} UARTPCELLID{i} (i=0..3) — UART PrimeCell Identification {i}
