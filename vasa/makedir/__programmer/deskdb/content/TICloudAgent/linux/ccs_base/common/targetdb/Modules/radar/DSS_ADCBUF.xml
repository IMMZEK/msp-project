# DSS_ADCBUF register map
Vendor: Texas Instruments
Peripheral module from a debugger description file (folder radar).
Registers are 32-bit, read-write, no defined reset value unless marked. A register's access mark holds for its fields unless they carry their own. Offsets are as the file gives them; lines under a group give offsets from that group; [hi:lo] are bit positions; {n}, {i} and the like mark numbered series; 'fields as' and 'values as' point back to an identical list; <NAME> marks a mode.

## DSS_ADCBUF
0x00 START
  [31:0] start — Memory start address
0x7FFC END
  [31:0] end — Memory end address
