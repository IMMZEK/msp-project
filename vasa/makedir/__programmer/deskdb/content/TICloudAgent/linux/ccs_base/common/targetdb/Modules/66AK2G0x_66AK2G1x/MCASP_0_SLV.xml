# MCASP_0_SLV register map
Vendor: Texas Instruments
Peripheral module from a debugger description file (folder 66AK2G0x_66AK2G1x).
Registers are 32-bit, read-only, reset 0x0 unless marked. A register's access mark holds for its fields unless they carry their own. Offsets are as the file gives them; lines under a group give offsets from that group; [hi:lo] are bit positions; {n}, {i} and the like mark numbered series; 'fields as' and 'values as' point back to an identical list; <NAME> marks a mode.

## MCASP_0_SLV
0x00 MCASP_RBUF
  [31:0] RBUF — Rx buffer data.
0x00 MCASP_XBUF wo
  [31:0] XBUF — Tx buffer data.
