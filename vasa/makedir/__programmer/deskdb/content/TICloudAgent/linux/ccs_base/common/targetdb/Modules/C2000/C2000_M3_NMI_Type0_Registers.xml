# C2000_M3_NMI_Type0_Registers register map
Vendor: Texas Instruments
Peripheral module from a debugger description file (folder C2000).
Address unit: 16 bits
Registers are 32-bit, access not given, no defined reset value unless marked. A register's access mark holds for its fields unless they carry their own. Offsets are as the file gives them; lines under a group give offsets from that group; [hi:lo] are bit positions; {n}, {i} and the like mark numbered series; 'fields as' and 'values as' point back to an identical list; <NAME> marks a mode.

## NMI_REGS — NMI REGS Registers
0x00 NMI_CFG — M3 NMI Configuration Register
0x04 NMI_FLG — M3 NMI Flag Register
0x08 NMI_FLGCLR — M3 NMI Flag Clear Register
0x0C NMI_FLGFRC — M3 NMI Flag Force Register
0x10 NMI_WDCNT — M3 NMI Watchdog Counter Register
0x14 NMI_WDPRD — M3 NMI Watchdog Period Register
