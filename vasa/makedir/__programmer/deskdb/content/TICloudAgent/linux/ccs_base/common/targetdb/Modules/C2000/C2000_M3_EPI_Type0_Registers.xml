# C2000_M3_EPI_Type0_Registers register map
Vendor: Texas Instruments
Peripheral module from a debugger description file (folder C2000).
Address unit: 16 bits
Registers are 32-bit, access not given, no defined reset value unless marked. A register's access mark holds for its fields unless they carry their own. Offsets are as the file gives them; lines under a group give offsets from that group; [hi:lo] are bit positions; {n}, {i} and the like mark numbered series; 'fields as' and 'values as' point back to an identical list; <NAME> marks a mode.

## EPI_REGS — EPI REGS Registers
0x00 EPICFG — EPI Configuration
0x04 EPIBAUD — EPI Main Baud Rate
0x08 EPIBAUD2 — EPI Baud Rate 2
0x10 HB16CFG — EPI Host-Bus 16 Configuration
0x10 SDRAMCFG — EPI SDRAM Configuration
0x10 HB8CFG — EPI Host-Bus 8 Configuration
0x10 GPCFG — EPI General Purpose Configuration
0x14 HB16CFG2 — EPI Host-Bus 16 Configuration 2
0x14 HB8CFG2 — EPI Host-Bus 8 Configuration 2
0x14 GPCFG2 — EPI General Purpose Configuration 2
0x1C EPIADDRMAP — EPI Address Map
0x20 EPIRSIZE0 — EPI Read Size 0
0x24 EPIRADDR0 — EPI Read Address 0
0x28 EPIRPSTD0 — EPI Non-Blocking Read Data 0
0x30 EPIRSIZE1 — EPI Read Size 1
0x34 EPIRADDR1 — EPI Read Address 1
0x38 EPIRPSTD1 — EPI Non-Blocking Read Data 1
0x60 EPISTAT — EPI Status
0x6C EPIRFIFOCNT — EPI Read FIFO Count
0x70 EPIREADFIFO
{0x70+4i} EPIREADFIFO{i} (i=1..7) — EPI Read FIFO Alias {i}
0x200 EPIFIFOLVL — EPI FIFO Level Selects
0x204 EPIWFIFOCNT — EPI Write FIFO Count
0x208 EPIDMATXCNT — EPI DMA Transmit Count
0x210 EPIIM — EPI Interrupt Mask
0x214 EPIRIS — EPI Raw Interrupt Status
0x218 EPIMIS — EPI Masked Interrupt Status
0x21C EPIEISC — EPI Error Interrupt Status and Clear
0x308 HB16CFG3 — EPI Host-Bus 16 Configuration 3
0x308 HB8CFG3 — EPI Host-Bus 8 Configuration 3
0x30C HB16CFG4 — EPI Host-Bus 16 Configuration 4
0x30C HB8CFG4 — EPI Host-Bus 8 Configuration 4
0x310 HB8TIME — EPI Host-Bus 8 Timing Extension
0x310 HB16TIME — EPI Host-Bus 16 Timing Extension
{0x30C+4i} HB8TIME{i} (i=2..4) — EPI Host-Bus 8 Timing Extension {i}
{0x30C+4i} HB16TIME{i} (i=2..4) — EPI Host-Bus 16 Timing Extension {i}
