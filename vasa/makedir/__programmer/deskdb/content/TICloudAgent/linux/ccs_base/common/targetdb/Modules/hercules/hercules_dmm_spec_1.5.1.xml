# hercules_dmm_spec_1.5.1 register map
Vendor: Texas Instruments
Peripheral module from a debugger description file (folder hercules).
Registers are 32-bit, access not given, no defined reset value unless marked. A register's access mark holds for its fields unless they carry their own. Offsets are as the file gives them; lines under a group give offsets from that group; [hi:lo] are bit positions; {n}, {i} and the like mark numbered series; 'fields as' and 'values as' point back to an identical list; <NAME> marks a mode.

## Dmm — Data Modification Module
0x00 GlbCtrl — Global Control Register
0x04 IntSet — Interrupt Set Register
0x08 IntClr — Interrupt Clear Register
0x0C IntLvl — Interrupt Level Register
0x10 IntFlg — Interrupt Flag Register
0x14 IntOffst1 — Interrupt Offset 1 Register
0x18 IntOffst2 — Interrupt Offset 2 Register
0x1C DdmDst — Direct Data Mode Destination Register
0x20 DdmBlkSz — Direct Data Mode Blocksize Register
0x24 DdmPtr — Direct Data Mode Pointer Register
0x28 DdmIntPtr — Direct Data Mode Interrupt Pointer Register
{0x2C+0x10*i} Dst{i}Rgn1 (i=0..3) — Destination {i} Region 1
{0x30+0x10*i} Dst{i}BlkSz1 (i=0..3) — Destination {i} Blocksize 1
{0x34+0x10*i} Dst{i}Rgn2 (i=0..3) — Destination {i} Region 2
{0x38+0x10*i} Dst{i}BlkSz2 (i=0..3) — Destination {i} Blocksize 2
0x6C Fun — Pin Control 0
0x70 Dir — Pin Control 1
0x74 DIn — Pin Control 2
0x78 DOut — Pin Control 3
0x7C DSet — Pin Control 4
0x80 DClr — Pin Control 5
0x84 PDr — Pin Control 6
0x88 PDis — Pin Control 7
0x8C PSel — Pin Control 8

## Notices in the file
(c) Texas Instruments 2003-2012, All rights reserved.
