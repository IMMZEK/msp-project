# hercules_fwm_spec_2.2.2 register map
Vendor: Texas Instruments
Peripheral module from a debugger description file (folder hercules).
Registers are 32-bit, access not given, no defined reset value unless marked. A register's access mark holds for its fields unless they carry their own. Offsets are as the file gives them; lines under a group give offsets from that group; [hi:lo] are bit positions; {n}, {i} and the like mark numbered series; 'fields as' and 'values as' point back to an identical list; <NAME> marks a mode.

## Fwm — Flash Wrapper Module
0x00 FRdCntl — Read Control Register
0x04 FSpRd — Special Read Control Register
0x08 FEdacCtrl1 — Error Correction Control Register1
0x0C FEdacCtrl2 — Error Correction Control Register2
0x10 FCorErrCnt — Error Correction Counter Register
0x14 FCorErrAddr — Correctable Error Address
0x18 FCorErrPos — Correctable Error Position Register
0x1C FEdacStat — Error Status Register
0x20 FUncErrAddr — Un-correctable Error Address
0x24 FEdacSDis — Error Detection Sector Disable
0x28 FPprimAddrTag — Primary Address Tag Register
0x2C FReduAddrTag — Redundant Address Tag Register
0x30 FBnkProt — Bank Protection Register
0x34 FBnkSec — Bank Sector Enable Register
0x38 FBusy — Bank Busy Register
0x3C FBnkAcc — Bank Access Control Register
0x40 FBnkFallback — Bank Fallback Power Register
0x44 FBnkPmpRdy — Bank/Pump Ready Register
0x48 FPmpAcc1 — Pump Access Control Register 1
0x4C FPmpAcc2 — Pump Access Control Register 2
0x50 FMdlAcc — Module Access Control Register
0x54 FMdlStat — Module Status Register
0x58 FEmuDatMsw — EEPROM Emulation Data MSW Register
0x5C FEmuDatLsw — EEPROM Emulation Data LSW Register
0x60 FEmuEcc — EEPROM Emulation ECC Register
0x64 FLock — Flash Lock Register
0x68 FEmuAddr — EEPROM Emulation Address
0x6C FDiagCtrl — Diagnostic Control Register
0x70 FRawDataH — Uncorrected Raw Data High
0x74 FRawDataL — Uncorrected Raw Data Low
0x78 FRawEcc — Uncorrected Raw ECC
0x7C FParOvr — Parity Override
0x80 FVReadCtrl — Voltage Read Control Register
0x84 FVHvCtrl1 — High Voltage Control Register
0x88 FVHvCtrl2 — High Voltage Control Register
0x8C FVNvCtrl — Negativ Voltage Control Register
0x90 FVPmpCtrl — High Current Control Register
0x94 FVWlCtrl — Wordline Voltage Control Register
0x98 FEfuse — Test Register
0x100 FBnkStrobes — Bank Signal Strobe Register
0x104 FPmpStrobes — Pump Signal Strobe Register
0x108 FBnkMode — Bank Mode Register
0x10C FTcr — TCR Register
0x110 FBnkAddr — Bank Addr Register
0x114 FBnkWrite — Bank Write Data Register
0x118 FCBitSel — Check Bit Select Register
0x11C FTstCtrl — Test Control Register
{0x120+4i} FWPwrite{i} (i=0..4) — Flash Wide Programming Write Data Register {i}
0x204 FsmState — Fsm State status
0x208 FsmStat — Fsm status
0x20C FsmCommand
0x210 FsmPEOsu — Fsm Program/Erase Operation Setup
0x214 FsmCOsu — Fsm Compact Operation Setup
0x218 FsmPEVsu — Fsm Program/Erase Verify Setup
0x21C FsmCmpVsu — Fsm Compare Verify setup
0x220 FsmExVal — Fsm EXECUTEZ to Valid Data
0x224 FsmRdH — Fsm Read Mode Hold
0x228 FsmPCOh — Fsm Program/Compact Operation Hold
0x22C FsmEraOh — Fsm Erase Operation Hold
0x230 FsmSavPpul — Fsm Saved Program Pulses
0x234 FsmPEVh — Fsm Program/Erase Verify Hold
0x238 FsmVwlStep — Fsm Word Line Voltage Stepping control
0x23C FsmSwitchPnt — Fsm switch point
0x240 FsmPrgPw — Fsm Program Pulse Width
0x244 FsmEraPw — Fsm Erase Pulse Width
0x248 FsmCmpPw — Fsm Compact Pulse Width
0x24C FsmCmpSecSu — Fsm Compact Sector Set up Time
0x250 FsmSavCod — Fsm Cod general Storage
0x254 FsmSavEraPul — Fsm Saved Erased Pulses
0x258 FsmTimer
0x25C FsmMode
0x260 FsmPgm — Fsm Program bits register
0x264 FsmEra — Fsm Erase bits register
0x268 FsmPrgPul — Fsm Maximum Programming Pulses
0x26C FsmEraPul — Fsm Maximum Erase Pulses
0x270 FsmCmpPul — Fsm Maximum Compact Pulses
0x274 FsmPulCntr — Fsm Pulse Counter
0x278 FsmSavPgmDat — Fsm Saved Program Data
0x27C FsmStMachine — Fsm State machine
0x280 FsmCmdTst — Fsm Command Test
0x284 FsmRdData — Fsm Read Data
0x288 FsmWrENA — Fsm Test Control
0x28C FsmAccPP — Fsm Accumulate Program Pulses
0x290 FsmAccEP — Fsm Accumulate Erase Pulses
0x294 FsmAccCP — Fsm Accumulate Compact Pulses
0x2A0 FsmAddr — Fsm Address
0x2A4 FsmSector
0x2A8 FwmRevId — FWM Revision Identification

## Notices in the file
(c) Texas Instruments 2003-2012, All rights reserved.
