# hercules_epc_spec_0.0.12 register map
Vendor: Texas Instruments
Peripheral module from a debugger description file (folder hercules).
Registers are 32-bit, access not given, no defined reset value unless marked. A register's access mark holds for its fields unless they carry their own. Offsets are as the file gives them; lines under a group give offsets from that group; [hi:lo] are bit positions; {n}, {i} and the like mark numbered series; 'fields as' and 'values as' point back to an identical list; <NAME> marks a mode.

## EPC — Error Profiling Controller
0x00 EpcRevID
0x04 EpcCntrl — EPC Control Register
0x08 UerrStat — Uncorrectable Error Status Register
0x0C EpcErrStat — H/W Channel Enable Set and Status Register
0x10 FifoFullStat — FIFO Full Status Register
0x14 OvrFlwStat — IP Interface FIFO Overflow Status Register
0x18 CamAvailStat — CAM Index Available Status Register
{0x20+4i} UerrAddr{i} (i=0..15) — Uncorrectable Error Address Register {i}
{0xA0+4i} CAM_Content{i} (i=0..31) — CAM Content Update Register{i}
{0x200+4i} CAM_Index{i} (i=0..7) — CAM Index Register{i}

## Notices in the file
(c) Texas Instruments 2003-2012, All rights reserved.
