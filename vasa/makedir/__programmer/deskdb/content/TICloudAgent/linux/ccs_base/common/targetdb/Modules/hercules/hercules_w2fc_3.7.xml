# hercules_w2fc_3.7 register map
Vendor: Texas Instruments
Peripheral module from a debugger description file (folder hercules).
Registers are 16-bit, access not given, no defined reset value unless marked. A register's access mark holds for its fields unless they carry their own. Offsets are as the file gives them; lines under a group give offsets from that group; [hi:lo] are bit positions; {n}, {i} and the like mark numbered series; 'fields as' and 'values as' point back to an identical list; <NAME> marks a mode.

## W2FC — USB W2FC Module
0x00 REV — Revision register
0x02 EPNUM — Endpoint Selection Register
0x04 DATA
0x06 CTRL — Control Register
0x08 STATFLG — Status Flag Register
0x0A RXFSTAT — Receive FIFO Status Register
0x0C SYSCON1 — System Configuration Register 1
0x0E SYSCON2 — System Configuration Register 2
0x10 DEVSTAT — Device Status Register
0x12 SOF — Start Of Frame Register
0x14 IRQEN — Interrupt Enable Register
0x16 DMAIRQEN — DMA Interrupt Enable Register
0x16 IRQSRC — Interrupt Source Register
0x1A EPNSTAT — Non-ISO Endpoint Interrupt Status Register
0x1C DMANSTAT — Non-ISO DMA Interrupt Status Register
0x20 RXDMACFG — DMA Receive Channels Configuration Register
0x22 TXDMACFG — DMA Transmit Channels Configuration Register
0x24 DATADMA — DMA FIFO Data Register
{0x28+2i} TXDMA{i} (i=0..2) — Transmit DMA Control Register
{0x30+2i} RXDMA{i} (i=0..2) — Receive DMA Control Register
0x3C USBTEST1 — USB Test Register 1
0x3E USBTEST2 — USB Test Register 2
0x40 EP0 — Endpoint 0 Configuration Register
{0x42+2i} EPRX{i} (i=0..14) — Receive Endpoint n Configuration Register
{0x62+2i} EPTX{i} (i=0..14) — Transmit Endpoint n Configuration Register

## Notices in the file
(c) Texas Instruments 2003-2012, All rights reserved.
