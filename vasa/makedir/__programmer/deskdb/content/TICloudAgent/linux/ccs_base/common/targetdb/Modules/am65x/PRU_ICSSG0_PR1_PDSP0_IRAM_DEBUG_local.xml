# PRU_ICSSG0_PR1_PDSP0_IRAM_DEBUG_local register map
Vendor: Texas Instruments
Peripheral module from a debugger description file (folder am65x).
Registers are 32-bit, read-write, reset 0x0 unless marked. A register's access mark holds for its fields unless they carry their own. Offsets are as the file gives them; lines under a group give offsets from that group; [hi:lo] are bit positions; {n}, {i} and the like mark numbered series; 'fields as' and 'values as' point back to an identical list; <NAME> marks a mode.

## PRU_ICSSG0_PR1_PDSP0_IRAM_DEBUG
0x00 ICSSG_DBG_GPREG_y — DEBUG PRU General Purpose Registers 0 to 31. This register allows an external agent to debug the PRU while it is disabled. Reading or writing to these registers will have the same effect as a read or write to these registers from an internal instruction in the PRU. For R30, this includes generation of the pulse outputs whenever the register is written. Offset = 0h + (y * 4); where y = 0 to 31
  [31:0] GP_REGy — PRU Internal GP Register y: Reading / writing this field directly inspects/modifies the corresponding internal register in the PRU internal register file.
0x80 ICSSG_DBG_CT_REG_y — DEBUG PRU Constant Table Entry Registers 0 to 31. This register allows an external agent to debug/or configure the PRU while it is disabled. Since some of the constants table entries may actually depend on system inputs / and or the internal state of the PRU, these registers are provided to allow an external agent to easily determine the state of the constants table. Offset = 80h + (y * 4); where y = 0 to 31
  [31:0] CT_REGy — PRU Internal Constants Table Entry y (where y = 0 to 31): Reading this field directly inspects the corresponding entry in the PRU internal constants table. Note: For each register y where y is less than the ctreg_cnt configuration parameter, the PRU internal Constants Table Entry Register will be writable and these registers are to be used to set the value for these constants. As for reads, the PRU must be disabled in order to access these registers.
