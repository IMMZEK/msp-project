# MCU_NAVSS0_UDMASS_INTA0_CFG_GCNTCFG register map
Vendor: Texas Instruments
Peripheral module from a debugger description file (folder am65x).
Registers are 64-bit, read-write, reset 0xFFFF unless marked. A register's access mark holds for its fields unless they carry their own. Offsets are as the file gives them; lines under a group give offsets from that group; [hi:lo] are bit positions; {n}, {i} and the like mark numbered series; 'fields as' and 'values as' point back to an identical list; <NAME> marks a mode.

## MCU_NAVSS0_UDMASS_INTA0_CFG_GCNTCFG
0x00 UDMA_INTA_MAP_j — The Global Event Mapping register controls the egress global event index for this event count. Offset =0h + (j * 20h); where j = 0h to 1FFh for NAVSS0_UDMASS_INTA0_CFG_GCNTCFG j = 0h to FFh for MCU_NAVSS0_UDMASS_INTA0_CFG_GCNTCFG
  [15:0] GEVIDX — Global event index. This field specifies the index of the outgoing global event. Set to 0xFFFF to disable.
