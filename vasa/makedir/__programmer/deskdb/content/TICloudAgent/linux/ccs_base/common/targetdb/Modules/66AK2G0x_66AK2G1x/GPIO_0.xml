# GPIO_0 register map
Vendor: Texas Instruments
Peripheral module from a debugger description file (folder 66AK2G0x_66AK2G1x).
Registers are 32-bit, read-write, reset 0x0 unless marked. A register's access mark holds for its fields unless they carry their own. Offsets are as the file gives them; lines under a group give offsets from that group; [hi:lo] are bit positions; {n}, {i} and the like mark numbered series; 'fields as' and 'values as' point back to an identical list; <NAME> marks a mode.

## GPIO_0
0x00 GPIO_PID ro reset 0x44831105
  [31:0] REV — TI internal data. Identifies revision of peripheral.
0x08 GPIO_BINTEN access per field
  [8:0] EN rw — Enables GPIO pins in each bank as interrupt sources to the CPU.
0x10 GPIO_DIR01 reset 0xFFFFFFFF
  [31:0] DIR — Controls the direction of the GPIOj pin, j = 0 to 31. Bits 0-15 correspond to GPIO0-15 of BANK0 and bits 16-31 correspond to GPIO0-15 of BANK1.
0x14 GPIO_OUT_DATA01
  [31:0] OUT — Controls the drive state of the corresponding GPIOj pin, j = 0 to 31. These bits do not affect the state of the pin when the pin is configured as an input. Reading these bits returns the value of this register, not the state of the pin. Bits 0-15 correspond to GPIO0-15 of BANK0 and bits 16-31 correspond to GPIO0-15 of BANK1.
0x18 GPIO_SET_DATA01
  [31:0] SET — Writing 1 sets the corresponding bit in the Output Data 0 and 1 register. Reading this register returns the contents of the Output Data 0 and 1 register. Writing a 0 has no effect. Bits 0-15 correspond to GPIO0-15 of BANK0 and bits 16-31 correspond to GPIO0-15 of BANK1.
0x1C GPIO_CLR_DATA01
  [31:0] CLR — Writing 1 clears the corresponding bit in the Output Data 0 and 1 register. Reading this register returns the contents of the Output Data 0 and 1 register. Writing a 0 has no effect. Bits 0-15 correspond to GPIO0-15 of BANK0 and bits 16-31 correspond to GPIO0-15 of BANK1.
0x20 GPIO_IN_DATA01 ro
  [31:0] IN — Returns the status of the corresponding GPIOj pin, j = 0 to 31. Bits 0-15 correspond to GPIO0-15 of BANK0 and bits 16-31 correspond to GPIO0-15 of BANK1.
0x24 GPIO_SET_RIS_TRIG01
  [31:0] SETRIS — Writing a 1 enables the rising edge detection for the corresponding GPIOj pin, j = 0 to 31. Reading this register returns the state of the RIS_TRIG01 register. Bits 0-15 correspond to GPIO0-15 of BANK0 and bits 16-31 correspond to GPIO0-15 of BANK1.
0x28 GPIO_CLR_RIS_TRIG01
  [31:0] CLRRIS — Writing a 1 disables the rising edge detection for the corresponding GPIOj pin, j = 0 to 31. Reading this register returns the state of the RIS_TRIG01 register. Bits 0-15 correspond to GPIO0-15 of BANK0 and bits 16-31 correspond to GPIO0-15 of BANK1.
0x2C GPIO_SET_FAL_TRIG01
  [31:0] SETFAL — Writing a 1 enables the falling edge detection for the corresponding GPIOj pin, j = 0 to 31. Reading this register returns the state of the FAL_TRIG01 register. Bits 0-15 correspond to GPIO0-15 of BANK0 and bits 16-31 correspond to GPIO0-15 of BANK1.
0x30 GPIO_CLR_FAL_TRIG01
  [31:0] CLRFAL — Writing a 1 disables the falling edge detection for the corresponding GPIOj pin, j = 0 to 31. Reading this register returns the state of the FAL_TRIG01 register. Bits 0-15 correspond to GPIO0-15 of BANK0 and bits 16-31 correspond to GPIO0-15 of BANK1.
0x34 GPIO_INTSTAT01
  [31:0] STAT — Status of GPIO bank 0 and 1 interrupts. Bits 0-15 correspond to GPIO0-15 of BANK0 and bits 16-31 correspond to GPIO0-15 of BANK1.
0x38 GPIO_DIR23 reset 0xFFFFFFFF
  [31:0] DIR — Controls the direction of the GPIOj pins, j = 32 to 64. Bits 0-15 correspond to GPIO0-15 of BANK2 and bits 16-31 correspond to GPIO0-15 of BANK3.
0x3C GPIO_OUT_DATA23
  [31:0] OUT — Controls the drive state of the corresponding GPIOj pin, j = 32 to 64. These bits do not affect the state of the pin when the pin is configured as an input. Reading these bits returns the value of this register, not the state of the pin. Bits 0-15 correspond to GPIO0-15 of BANK2 and bits 16-31 correspond to GPIO0-15 of BANK3.
0x40 GPIO_SET_DATA23
  [31:0] SET — Writing 1 sets the corresponding bit in the Output Data 2 and 3 register. Reading this register returns the contents of the Output Data 2 and 3 register. Writing a 0 has no effect. Bits 0-15 correspond to GPIO0-15 of BANK2 and bits 16-31 correspond to GPIO0-15 of BANK3.
0x44 GPIO_CLR_DATA23
  [31:0] CLR — Writing 1 clears the corresponding bit in the Output Data 2 and 3 register. Reading this register returns the contents of the Output Data 2 and 3 register. Writing a 0 has no effect. Bits 0-15 correspond to GPIO0-15 of BANK2 and bits 16-31 correspond to GPIO0-15 of BANK3.
0x48 GPIO_IN_DATA23 ro
  [31:0] IN — Returns the status of the corresponding GPIOj pin, j = 32 to 64. Bits 0-15 correspond to GPIO0-15 of BANK2 and bits 16-31 correspond to GPIO0-15 of BANK3.
0x4C GPIO_SET_RIS_TRIG23
  [31:0] SETRIS — Writing a 1 enables the rising edge detection for the corresponding GPIOj pin, j = 32 to 64. Reading this register returns the state of the RIS_TRIG23 register. Bits 0-15 correspond to GPIO0-15 of BANK2 and bits 16-31 correspond to GPIO0-15 of BANK3.
0x50 GPIO_CLR_RIS_TRIG23
  [31:0] CLRRIS — Writing a 1 disables the rising edge detection for the corresponding GPIOj pin, j = 32 to 64. Reading this register returns the state of the RIS_TRIG23 register. Bits 0-15 correspond to GPIO0-15 of BANK2 and bits 16-31 correspond to GPIO0-15 of BANK3.
0x54 GPIO_SET_FAL_TRIG23
  [31:0] SETFAL — Writing a 1 enables the falling edge detection for the corresponding GPIOj pin, j = 32 to 64. Reading this register returns the state of the FAL_TRIG23 register. Bits 0-15 correspond to GPIO0-15 of BANK2 and bits 16-31 correspond to GPIO0-15 of BANK3.
0x58 GPIO_CLR_FAL_TRIG23
  [31:0] CLRFAL — Writing a 1 disables the falling edge detection for the corresponding GPIOj pin, j = 32 to 64. Reading this register returns the state of the FAL_TRIG23 register. Bits 0-15 correspond to GPIO0-15 of BANK2 and bits 16-31 correspond to GPIO0-15 of BANK3.
0x5C GPIO_INTSTAT23
  [31:0] STAT — Status of GPIO bank 2 and 3 interrupts. Bits 0-15 correspond to GPIO0-15 of BANK2 and bits 16-31 correspond to GPIO0-15 of BANK3.
0x60 GPIO_DIR45 reset 0xFFFFFFFF
  [31:0] DIR — Controls the direction of the GPIOj pin, j = 65 to 96. Bits 0-15 correspond to GPIO0-15 of BANK4 and bits 16-31 correspond to GPIO0-15 of BANK5.
0x64 GPIO_OUT_DATA45
  [31:0] OUT — Controls the drive state of the corresponding GPIOj pin, j = 65 to 96. These bits do not affect the state of the pin when the pin is configured as an input. Reading these bits returns the value of this register, not the state of the pin. Bits 0-15 correspond to GPIO0-15 of BANK4 and bits 16-31 correspond to GPIO0-15 of BANK5.
0x68 GPIO_SET_DATA45
  [31:0] SET — Writing 1 sets the corresponding bit in the Output Data 4 and 5 register. Reading this register returns the contents of the Output Data 4 and 5 register. Writing a 0 has no effect. Bits 0-15 correspond to GPIO0-15 of BANK4 and bits 16-31 correspond to GPIO0-15 of BANK5.
0x6C GPIO_CLR_DATA45
  [31:0] CLR — Writing 1 clears the corresponding bit in the Output Data 4 and 5 register. Reading this register returns the contents of the Output Data 4 and 5 register. Writing a 0 has no effect. Bits 0-15 correspond to GPIO0-15 of BANK4 and bits 16-31 correspond to GPIO0-15 of BANK5.
0x70 GPIO_IN_DATA45 ro
  [31:0] IN — Returns the status of the corresponding GPIOj pin, j = 65 to 96. Bits 0-15 correspond to GPIO0-15 of BANK4 and bits 16-31 correspond to GPIO0-15 of BANK5.
0x74 GPIO_SET_RIS_TRIG45
  [31:0] SETRIS — Writing a 1 enables the rising edge detection for the corresponding GPIOj pin, j = 65 to 96. Reading this register returns the state of the RIS_TRIG45 register. Bits 0-15 correspond to GPIO0-15 of BANK4 and bits 16-31 correspond to GPIO0-15 of BANK5.
0x78 GPIO_CLR_RIS_TRIG45
  [31:0] CLRRIS — Writing a 1 disables the rising edge detection for the corresponding GPIOj pin, j = 65 to 96. Reading this register returns the state of the RIS_TRIG45 register. Bits 0-15 correspond to GPIO0-15 of BANK4 and bits 16-31 correspond to GPIO0-15 of BANK5.
0x7C GPIO_SET_FAL_TRIG45
  [31:0] SETFAL — Writing a 1 enables the falling edge detection for the corresponding GPIOj pin, j = 65 to 96. Reading this register returns the state of the FAL_TRIG45 register. Bits 0-15 correspond to GPIO0-15 of BANK4 and bits 16-31 correspond to GPIO0-15 of BANK5.
0x80 GPIO_CLR_FAL_TRIG45
  [31:0] CLRFAL — Writing a 1 disables the falling edge detection for the corresponding GPIOj pin, j = 65 to 96. Reading this register returns the state of the FAL_TRIG45 register. Bits 0-15 correspond to GPIO0-15 of BANK4 and bits 16-31 correspond to GPIO0-15 of BANK5.
0x84 GPIO_INTSTAT45
  [31:0] STAT — Status of GPIO bank 4 and 5 interrupts. Bits 0-15 correspond to GPIO0-15 of BANK4 and bits 16-31 correspond to GPIO0-15 of BANK5.
0x88 GPIO_DIR67 reset 0xFFFFFFFF
  [31:0] DIR — Controls the direction of the GPIOj pin, j = 97 to 128. Bits 0-15 correspond to GPIO0-15 of BANK6 and bits 16-31 correspond to GPIO0-15 of BANK7.
0x8C GPIO_OUT_DATA67
  [31:0] OUT — Controls the drive state of the corresponding GPIOj pin, j = 97 to 128. These bits do not affect the state of the pin when the pin is configured as an input. Reading these bits returns the value of this register, not the state of the pin. Bits 0-15 correspond to GPIO0-15 of BANK6 and bits 16-31 correspond to GPIO0-15 of BANK7.
0x90 GPIO_SET_DATA67
  [31:0] SET — Writing 1 sets the corresponding bit in the Output Data 6 and 7 register. Reading this register returns the contents of the Output Data 6 and 7 register. Writing a 0 has no effect. Bits 0-15 correspond to GPIO0-15 of BANK6 and bits 16-31 correspond to GPIO0-15 of BANK7.
0x94 GPIO_CLR_DATA67
  [31:0] CLR — Writing 1 clears the corresponding bit in the Output Data 6 and 7 register. Reading this register returns the contents of the Output Data 6 and 7 register. Writing a 0 has no effect. Bits 0-15 correspond to GPIO0-15 of BANK6 and bits 16-31 correspond to GPIO0-15 of BANK7.
0x98 GPIO_IN_DATA67 ro
  [31:0] IN — Returns the status of the corresponding GPIOj pin, j = 97 to 128. Bits 0-15 correspond to GPIO0-15 of BANK6 and bits 16-31 correspond to GPIO0-15 of BANK7.
0x9C GPIO_SET_RIS_TRIG67
  [31:0] SETRIS — Writing a 1 enables the rising edge detection for the corresponding GPIOj pin, j = 97 to 128. Reading this register returns the state of the RIS_TRIG67 register. Bits 0-15 correspond to GPIO0-15 of BANK6 and bits 16-31 correspond to GPIO0-15 of BANK7.
0xA0 GPIO_CLR_RIS_TRIG67
  [31:0] CLRRIS — Writing a 1 disables the rising edge detection for the corresponding GPIOj pin, j = 97 to 128. Reading this register returns the state of the RIS_TRIG67 register. Bits 0-15 correspond to GPIO0-15 of BANK6 and bits 16-31 correspond to GPIO0-15 of BANK7.
0xA4 GPIO_SET_FAL_TRIG67
  [31:0] SETFAL — Writing a 1 enables the falling edge detection for the corresponding GPIOj pin, j = 97 to 128. Reading this register returns the state of the FAL_TRIG67 register. Bits 0-15 correspond to GPIO0-15 of BANK6 and bits 16-31 correspond to GPIO0-15 of BANK7.
0xA8 GPIO_CLR_FAL_TRIG67
  [31:0] CLRFAL — Writing a 1disables the falling edge detection for the corresponding GPIOj pin, j = 97 to 128. Reading this register returns the state of the FAL_TRIG67 register. Bits 0-15 correspond to GPIO0-15 of BANK6 and bits 16-31 correspond to GPIO0-15 of BANK7.
0xAC GPIO_INTSTAT67
  [31:0] STAT — Status of GPIO bank 6 and 7 interrupts. Bits 0-15 correspond to GPIO0-15 of BANK6 and bits 16-31 correspond to GPIO0-15 of BANK7.
0xB0 GPIO_DIR8 access per field reset 0xFFFF
  [15:0] DIR rw — Controls the direction of the GPIOj pin, j = 129 to 144. Bits 0-15 correspond to GPIO0-15 of BANK8.
0xB4 GPIO_OUT_DATA8 access per field
  [15:0] OUT rw — Controls the drive state of the corresponding GPIOj pin, j = 129 to 144. These bits do not affect the state of the pin when the pin is configured as an input. Reading these bits returns the value of this register, not the state of the pin. Bits 0-15 correspond to GPIO0-15 of BANK8.
0xB8 GPIO_SET_DATA8 access per field
  [15:0] SET rw — Writing 1 sets the corresponding bit in the Output Data 8 register. Reading this register returns the contents of the Output Data 8 register. Writing a 0 has no effect. Bits 0-15 correspond to GPIO0-15 of BANK8.
0xBC GPIO_CLR_DATA8 access per field
  [15:0] CLR rw — Writing 1 clears the corresponding bit in the Output Data 8 register. Reading this register returns the contents of the Output Data 8 register. Writing a 0 has no effect. Bits 0-15 correspond to GPIO0-15 of BANK8.
0xC0 GPIO_IN_DATA8 ro
  [15:0] IN — Returns the status of the corresponding GPIOj pin, j = 129 to 144. Bits 0-15 correspond to GPIO0-15 of BANK8.
0xC4 GPIO_SET_RIS_TRIG8 access per field
  [15:0] SETRIS rw — Writing a 1 enables the rising edge detection for the corresponding GPIOj pin, j = 129 to 144. Reading this register returns the state of the RIS_TRIG8 register. Bits 0-15 correspond to GPIO0-15 of BANK8.
0xC8 GPIO_CLR_RIS_TRIG8 access per field
  [15:0] CLRRIS rw — Writing a 1 disables the rising edge detection for the corresponding GPIOj pin, j = 129 to 144. Reading this register returns the state of the RIS_TRIG8 register. Bits 0-15 correspond to GPIO0-15 of BANK8.
0xCC GPIO_SET_FAL_TRIG8 access per field
  [15:0] SETFAL rw — Writing a 1 enables the falling edge detection for the corresponding GPIOj pin, j = 129 to 144. Reading this register returns the state of the FAL_TRIG8 register. Bits 0-15 correspond to GPIO0-15 of BANK8.
0xD0 GPIO_CLR_FAL_TRIG8 access per field
  [15:0] CLRFAL rw — Writing a 1 disables the falling edge detection for the corresponding GPIOj pin, j = 129 to 144. Reading this register returns the state of the FAL_TRIG8 register. Bits 0-15 correspond to GPIO0-15 of BANK8.
0xD4 GPIO_INTSTAT8 access per field
  [15:0] STAT rw — Status of GPIO bank 8 interrupts. Bits 0-15 correspond to GPIO0-15 of BANK8.
