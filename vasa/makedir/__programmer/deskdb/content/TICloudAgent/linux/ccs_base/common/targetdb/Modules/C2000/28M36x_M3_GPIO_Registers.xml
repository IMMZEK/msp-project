# 28M36x_M3_GPIO_Registers register map
Vendor: Texas Instruments
Peripheral module from a debugger description file (folder C2000).
Address unit: 16 bits
Registers are 32-bit, access not given, no defined reset value unless marked. A register's access mark holds for its fields unless they carry their own. Offsets are as the file gives them; lines under a group give offsets from that group; [hi:lo] are bit positions; {n}, {i} and the like mark numbered series; 'fields as' and 'values as' point back to an identical list; <NAME> marks a mode.

## GPIO_REGS — GPIO REGS Registers
0x3FC GPIODATA
0x400 GPIODIR — GPIO Direction
0x404 GPIOIS — GPIO Interrupt Sense
0x408 GPIOIBE — GPIO Interrupt Both Edges
0x40C GPIOIEV — GPIO Interrupt Event
0x410 GPIOIM — GPIO Interrupt Mask
0x414 GPIORIS — GPIO Raw Interrupt Status
0x418 GPIOMIS — GPIO Masked Interrupt Status
0x41C GPIOICR — GPIO Interrupt Clear
0x420 GPIOAFSEL — GPIO Alternate Function Select
0x50C GPIOODR — GPIO Open Drain Select
0x510 GPIOPUR — GPIO Pull-Up Select
0x51C GPIODEN — GPIO Digital Enable
0x520 GPIOLOCK
0x524 GPIOCR — GPIO Commit
0x528 GPIOAMSEL — GPIO Analog Mode Select
0x52C GPIOPCTL — GPIO Port Control
0x530 GPIOAPSEL — GPIO Alternate Port Select
0x534 GPIOCSEL — GPIO Core Select
{0xFC0+4i} GPIOPeriphID{i} (i=4..7) — GPIO Peripheral Identification {i}
{0xFE0+4i} GPIOPeriphID{i} (i=0..3) — GPIO Peripheral Identification {i}
{0xFF0+4i} GPIOCellID{i} (i=0..3) — GPIO PrimeCell Identification {i}
