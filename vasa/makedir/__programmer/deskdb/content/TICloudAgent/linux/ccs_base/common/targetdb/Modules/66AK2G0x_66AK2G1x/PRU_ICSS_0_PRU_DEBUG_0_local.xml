# PRU_ICSS_0_PRU_DEBUG_0_local register map
Vendor: Texas Instruments
Peripheral module from a debugger description file (folder 66AK2G0x_66AK2G1x).
Registers are 32-bit, read-write, reset 0x0 unless marked. A register's access mark holds for its fields unless they carry their own. Offsets are as the file gives them; lines under a group give offsets from that group; [hi:lo] are bit positions; {n}, {i} and the like mark numbered series; 'fields as' and 'values as' point back to an identical list; <NAME> marks a mode.

## PRU_ICSS_0_PRU_DEBUG_0
{0x0+4i} PRU_ICSS_DBG_GPREG{i} (i=0..30)
  [31:0] GP_REG{i} — PRU Internal GP Register n: Reading / writing this field directly inspects/modifies the corresponding internal register in the PRU internal regfile.
0x7C PRU_ICSS_DBG_GPREG31
0x80 PRU_ICSS_DBG_CT_REG0 ro reset 0x20000
  [31:0] CT_REG0 — PRU Internal Constants Table Entry n: Reading this field directly inspects the corresponding entry in the PRU internal constants table.
0x84 PRU_ICSS_DBG_CT_REG1 ro reset 0x48040000
  [31:0] CT_REG1 — PRU Internal Constants Table Entry n: Reading this field directly inspects the corresponding entry in the PRU internal constants table.
0x88 PRU_ICSS_DBG_CT_REG2 ro reset 0x4802A000
  [31:0] CT_REG2 — PRU Internal Constants Table Entry n: Reading this field directly inspects the corresponding entry in the PRU internal constants table.
0x8C PRU_ICSS_DBG_CT_REG3 ro reset 0x30000
  [31:0] CT_REG3 — PRU Internal Constants Table Entry n: Reading this field directly inspects the corresponding entry in the PRU internal constants table.
0x90 PRU_ICSS_DBG_CT_REG4 ro reset 0x26000
  [31:0] CT_REG4 — PRU Internal Constants Table Entry n: Reading this field directly inspects the corresponding entry in the PRU internal constants table.
0x94 PRU_ICSS_DBG_CT_REG5 ro reset 0x48060000
  [31:0] CT_REG5 — PRU Internal Constants Table Entry n: Reading this field directly inspects the corresponding entry in the PRU internal constants table.
0x98 PRU_ICSS_DBG_CT_REG6 ro reset 0x48030000
  [31:0] CT_REG6 — PRU Internal Constants Table Entry n: Reading this field directly inspects the corresponding entry in the PRU internal constants table.
0x9C PRU_ICSS_DBG_CT_REG7 ro reset 0x28000
  [31:0] CT_REG7 — PRU Internal Constants Table Entry n: Reading this field directly inspects the corresponding entry in the PRU internal constants table.
0xA0 PRU_ICSS_DBG_CT_REG8 ro reset 0x46000000
  [31:0] CT_REG8 — PRU Internal Constants Table Entry n: Reading this field directly inspects the corresponding entry in the PRU internal constants table.
0xA4 PRU_ICSS_DBG_CT_REG9 ro reset 0x4A100000
  [31:0] CT_REG9 — PRU Internal Constants Table Entry n: Reading this field directly inspects the corresponding entry in the PRU internal constants table.
0xA8 PRU_ICSS_DBG_CT_REG10 ro reset 0x48318000
  [31:0] CT_REG10 — PRU Internal Constants Table Entry n: Reading this field directly inspects the corresponding entry in the PRU internal constants table.
0xAC PRU_ICSS_DBG_CT_REG11 ro reset 0x48022000
  [31:0] CT_REG11 — PRU Internal Constants Table Entry n: Reading this field directly inspects the corresponding entry in the PRU internal constants table.
0xB0 PRU_ICSS_DBG_CT_REG12 ro reset 0x48024000
  [31:0] CT_REG12 — PRU Internal Constants Table Entry n: Reading this field directly inspects the corresponding entry in the PRU internal constants table.
0xB4 PRU_ICSS_DBG_CT_REG13 ro reset 0x48310000
  [31:0] CT_REG13 — PRU Internal Constants Table Entry n: Reading this field directly inspects the corresponding entry in the PRU internal constants table.
0xB8 PRU_ICSS_DBG_CT_REG14 ro reset 0x481CC000
  [31:0] CT_REG14 — PRU Internal Constants Table Entry n: Reading this field directly inspects the corresponding entry in the PRU internal constants table.
0xBC PRU_ICSS_DBG_CT_REG15 ro reset 0x481D0000
  [31:0] CT_REG15 — PRU Internal Constants Table Entry n: Reading this field directly inspects the corresponding entry in the PRU internal constants table.
0xC0 PRU_ICSS_DBG_CT_REG16 ro reset 0x481A0000
  [31:0] CT_REG16 — PRU Internal Constants Table Entry n: Reading this field directly inspects the corresponding entry in the PRU internal constants table.
0xC4 PRU_ICSS_DBG_CT_REG17 ro reset 0x4819C000
  [31:0] CT_REG17 — PRU Internal Constants Table Entry n: Reading this field directly inspects the corresponding entry in the PRU internal constants table.
0xC8 PRU_ICSS_DBG_CT_REG18 ro reset 0x48300000
  [31:0] CT_REG18 — PRU Internal Constants Table Entry n: Reading this field directly inspects the corresponding entry in the PRU internal constants table.
0xCC PRU_ICSS_DBG_CT_REG19 ro reset 0x48302000
  [31:0] CT_REG19 — PRU Internal Constants Table Entry n: Reading this field directly inspects the corresponding entry in the PRU internal constants table.
0xD0 PRU_ICSS_DBG_CT_REG20 ro reset 0x48304000
  [31:0] CT_REG20 — PRU Internal Constants Table Entry n: Reading this field directly inspects the corresponding entry in the PRU internal constants table.
0xD4 PRU_ICSS_DBG_CT_REG21 ro reset 0x32400
  [31:0] CT_REG21 — PRU Internal Constants Table Entry n: Reading this field directly inspects the corresponding entry in the PRU internal constants table.
0xD8 PRU_ICSS_DBG_CT_REG22 ro reset 0x480C8000
  [31:0] CT_REG22 — PRU Internal Constants Table Entry n: Reading this field directly inspects the corresponding entry in the PRU internal constants table.
0xDC PRU_ICSS_DBG_CT_REG23 ro reset 0x480CA000
  [31:0] CT_REG23 — PRU Internal Constants Table Entry n: Reading this field directly inspects the corresponding entry in the PRU internal constants table.
{0x80+4i} PRU_ICSS_DBG_CT_REG{i} ro (i=24..31)
  [31:0] CT_REG{i} — PRU Internal Constants Table Entry n: Reading this field directly inspects the corresponding entry in the PRU internal constants table.
