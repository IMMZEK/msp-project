# Local_interconnect register map
Vendor: Texas Instruments
Peripheral module from a debugger description file (folder omap4460).
Registers are 32-bit, read-write, reset 0x0 unless marked. A register's access mark holds for its fields unless they carry their own. Offsets are as the file gives them; lines under a group give offsets from that group; [hi:lo] are bit positions; {n}, {i} and the like mark numbered series; 'fields as' and 'values as' point back to an identical list; <NAME> marks a mode.

## Local_interconnect
0x2000 MA_PRIORITY — Memory Adapter Priority Register. This register indicates the priority of memory access from MA to EMIF. This priority is used by EMIF in scheduling MA access to EMIF. 0x0 is lowest priority and 0x7 highest priority.
  [2:0] PRIORITY — MA priority value
