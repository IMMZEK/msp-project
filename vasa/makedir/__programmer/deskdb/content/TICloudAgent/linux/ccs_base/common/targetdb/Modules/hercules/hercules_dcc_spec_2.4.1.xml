# hercules_dcc_spec_2.4.1 register map
Vendor: Texas Instruments
Peripheral module from a debugger description file (folder hercules).
Registers are 32-bit, access not given, no defined reset value unless marked. A register's access mark holds for its fields unless they carry their own. Offsets are as the file gives them; lines under a group give offsets from that group; [hi:lo] are bit positions; {n}, {i} and the like mark numbered series; 'fields as' and 'values as' point back to an identical list; <NAME> marks a mode.

## DCC — Dual Clock Comparator
0x00 GCtrl — Global Control Register
0x04 Rev — Revision ID
0x08 CntSeed0 — Count0 Seed Value
0x0C ValidSeed0 — Valid0 Seed Value
0x10 CntSeed1 — Count1 Seed Value
0x14 Stat — Status Register
0x18 Cnt0 — Count0 Value Register
0x1C Valid0 — Valid0 Value Register
0x20 Cnt1 — Count1 Value Register
0x24 ClkSrc1 — Clock Source Selection Register 1
0x28 ClkSrc0 — Clock Source Selection Register 0

## Notices in the file
(c) Texas Instruments 2003-2012, All rights reserved.
