# hercules_m3vim_spec_0.0.4 register map
Vendor: Texas Instruments
Peripheral module from a debugger description file (folder hercules).
Registers are 32-bit, access not given, no defined reset value unless marked. A register's access mark holds for its fields unless they carry their own. Offsets are as the file gives them; lines under a group give offsets from that group; [hi:lo] are bit positions; {n}, {i} and the like mark numbered series; 'fields as' and 'values as' point back to an identical list; <NAME> marks a mode.

## M3_VIM — M3 Vectored Interrupt Manager
0x00 IntIsrIVec — Index Offset Vector Register
0x04 IntNmiIVec — Index Offset Vector Register
0x08 Nest_Ctrl — Program Control Register
0x0C Nest_Stat — Program Control Register
{0x10+4i} NmiPR{i} (i=0..3) — Pending Interrupt Read Location
{0x20+4i} IntReq{i} (i=0..3) — Pending Interrupt Read Location
0x30 ReqMaskSet0 — Interrupt Mask Set Register
0x34 ReqMaskSet1 — Interrupt Mask Set Register
0x40 ReqMaskClr0 — Interrupt Mask Clear Register
0x44 ReqMaskClr1 — Interrupt Mask Clear Register
0x50 WakeMaskSet0 — Wake-up Mask Set Register
0x54 WakeMaskSet1 — Wake-up Mask Set Register
0x60 WakeMASKCLR0 — Wake-up Mask Clear Register
0x64 WakeMASKCLR1 — Wake-up Mask Clear Register
0x78 CapEvt — Capture Event register
{0x80+4i} ChanCtrl{i} (i=0..15)

## Notices in the file
(c) Texas Instruments 2003-2012, All rights reserved.
