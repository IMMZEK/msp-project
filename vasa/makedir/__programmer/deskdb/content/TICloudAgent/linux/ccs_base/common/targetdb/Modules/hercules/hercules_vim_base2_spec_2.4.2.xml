# hercules_vim_base2_spec_2.4.2 register map
Vendor: Texas Instruments
Peripheral module from a debugger description file (folder hercules).
Registers are 32-bit, access not given, no defined reset value unless marked. A register's access mark holds for its fields unless they carry their own. Offsets are as the file gives them; lines under a group give offsets from that group; [hi:lo] are bit positions; {n}, {i} and the like mark numbered series; 'fields as' and 'values as' point back to an identical list; <NAME> marks a mode.

## Vim_base2 — Vectored Interrupt Manager
0x00 FirqPr4 — Channel Mapping Register
0x04 FirqPr5 — Channel Mapping Register
0x08 FirqPr6 — Channel Mapping Register
0x0C FirqPr7 — Channel Mapping Register
{0x0+4i} IntReq{i} (i=4..7) — Channel Mapping Register
{0x10+4i} ReqMaskSet{i} (i=4..7) — Channel Mapping Register
{0x20+4i} ReqMaskClr{i} (i=4..7) — Channel Mapping Register
{0x30+4i} WakeMaskSet{i} (i=4..7) — Channel Mapping Register
{0x40+4i} WakeMaskClr{i} (i=4..7) — Channel Mapping Register
0x60 ChanCtrl32 — Channel Mapping Register
0x64 ChanCtrl33 — Channel Mapping Register
0x68 ChanCtrl34 — Channel Mapping Register
0x6C ChanCtrl35 — Channel Mapping Register
0x70 ChanCtrl36 — Channel Mapping Register
0x74 ChanCtrl37 — Channel Mapping Register
0x78 ChanCtrl38 — Channel Mapping Register
0x7C ChanCtrl39 — Channel Mapping Register
0x80 ChanCtrl40 — Channel Mapping Register
0x84 ChanCtrl41 — Channel Mapping Register
0x88 ChanCtrl42 — Channel Mapping Register
0x8C ChanCtrl43 — Channel Mapping Register
0x90 ChanCtrl44 — Channel Mapping Register
0x94 ChanCtrl45 — Channel Mapping Register
0x98 ChanCtrl46 — Channel Mapping Register
0x9C ChanCtrl47 — Channel Mapping Register
0xA0 ChanCtrl48 — Channel Mapping Register
0xA4 ChanCtrl49 — Channel Mapping Register
0xA8 ChanCtrl50 — Channel Mapping Register
0xAC ChanCtrl51 — Channel Mapping Register
0xB0 ChanCtrl52 — Channel Mapping Register
0xB4 ChanCtrl53 — Channel Mapping Register
0xB8 ChanCtrl54 — Channel Mapping Register
0xBC ChanCtrl55 — Channel Mapping Register
0xC0 ChanCtrl56 — Channel Mapping Register
0xC4 ChanCtrl57 — Channel Mapping Register
0xC8 ChanCtrl58 — Channel Mapping Register
0xCC ChanCtrl59 — Channel Mapping Register
0xD0 ChanCtrl60 — Channel Mapping Register
0xD4 ChanCtrl61 — Channel Mapping Register
0xD8 ChanCtrl62 — Channel Mapping Register
0xDC ChanCtrl63 — Channel Mapping Register
0xEC ParEccStat — VIM RAM Parity/ECC Status Register
0xF0 ParEccCtl — VIM RAM Parity/ECC Control Register
0xF4 UerrAddr — Uncorrectable Error Address Register
0xF8 FbVecAddr — FallBack Vector Address Register
0xFC SBErrAddr — Single Bit Error Address Register

## Notices in the file
(c) Texas Instruments 2003-2012, All rights reserved.
