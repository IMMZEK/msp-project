# pga900_csr register map
Vendor: Texas Instruments
Peripheral module from a debugger description file (folder PGA900).
Registers are 8-bit, access not given, no defined reset value unless marked. A register's access mark holds for its fields unless they carry their own. Offsets are as the file gives them; lines under a group give offsets from that group; [hi:lo] are bit positions; {n}, {i} and the like mark numbered series; 'fields as' and 'values as' point back to an identical list; <NAME> marks a mode.

## CSR — Control and Status Register
0x88 EEPROM_PAGE_ADDRESS
0x89 EEPROM_CTRL — EEPROM Control Register
0x8A EEPROM_CRC — EEPROM Calculate CRC Configuration Register
0x8B EEPROM_STATUS
0x8C EEPROM_CRC_STATUS
0x8D EEPROM_CRC_VALUE
0x200 UART_CONFIG — UART Configuration Register
0x201 UART_EN — UART Enable Register
0x202 BAUD_RATE_LO — UART Baud Rate Low Byte
0x203 BAUD_RATE_HI — UART Baud Rate High Byte
0x204 UART_LINE_STATUS
0x208 UART_INTERRUPT_STATUS
0x20A UART_INTERRUPT_ENABLE
0x20C UART_RX_BUF — UART Receive Buffer
0x20E UART_TX_BUF — UART Transmit Buffer
0x210 PWM_ON_TIME1 — PWM ON Time1 Configuration Register
0x211 PWM_ON_TIME2 — PWM ON Time2 Configuration Register
0x212 PWM_OFF_TIME1 — PWM OFF Time1 Configuration Register
0x213 PWM_OFF_TIME2 — PWM OFF Time2 Configuration Register
0x214 PWM_EN — PWM Enable Register
0x218 GPIO_INPUT
0x219 GPIO_OUTPUT
0x21A GPIO_DIR — GPIO Direction Configuration Register
0x220 REMAP — REMAP Configuration Register
0x400 REVISION_ID1 — Device Revision ID
0x401 REVISION_ID2 — Digital Logic Revision ID
0x404 COM_MCU_TO_DIF_B1 — COMBUF Microcontroller to Digital Interface Data1 Register
0x405 COM_MCU_TO_DIF_B2 — COMBUF Microcontroller to Digital Interface Data2 Register
0x406 COM_TX_STATUS — COMBUF Transmit Status Register
0x408 COM_DIF_TO_MCU_B1 — COMBUF Digital Interface to Microcontroller Data1 Register
0x409 COM_DIF_TO_MCU_B2 — COMBUF Digital Interface to Microcontroller Data2 Register
0x40A COM_RX_STATUS — COMBUF Receive Status Register
0x40B COM_RX_INT_ENABLE — COMBUF Rx Interrupt Enable Register
0x40C MICRO_INTERFACE_CONTROL — Microcontroller Interface Register
0x40D SECLOCK — Security Lock Enable Register
0x4F4 AFE_CFG — PGAIN Open Select Register
0x502 RAMBIST_CONTROL — RAM Memory Built-In Self-Test Control Register
0x503 RAMBIST_STATUS — RAM Memory Built-In Self-Test Status Register
0x504 CLK_CTRL_STATUS — M0 Frequency Control Register
0x506 DIG_IF_CTRL — Digital Interface Control Register
0x508 OWI_ERROR_STATUS_LO — OWI Error Status Low Register
0x509 OWI_ERROR_STATUS_HI — OWI Error Status High Register
0x50A OWI_INTERRUPT — OWI Interrupt Status Register
0x50B OWI_INTERRUPT_ENABLE — OWI Interrupt Control Register
{0x50F+i} OTP_PROG_DATA{i} (i=1..4) — OTP Program Data{i} Register
0x514 OTP_PROG_ADDR1 — OTP Program Address1 Register
0x515 OTP_PROG_ADDR2 — OTP Program Address2 Register
0x516 OTP_PROG_CTRL_STAT — OTP Program Control and Status Register
0x518 OTP_PAGE_ADDR — OTP Page Address Register
0x519 DATARAM_PAGE_ADDR — Data RAM Page Address Register
0x51A DEVRAM_PAGE_ADDR — Development RAM Page Address Register
0x51C WDOG_CTRL_STAT — Watchdog Control and Status Register
0x51D WDOG_TRIG — Watchdog Trigger Register
0x51E PIN_MUX — UART/SPI Mutliplex Pin Select
{0x51F+i} PADC_DATA{i} (i=1..3)
0x523 PADC_CONFIG — PADC Configuration Register
{0x523+i} TADC_DATA{i} (i=1..3)
0x527 TADC_CONFIG — TADC Configuration Register
0x529 ADC_CFG_1 — ADC Configuration Register
0x530 DAC_REG0_1 — DAC Register0_1
0x531 DAC_REG0_2 — DAC Register0_2
0x532 DAC_REG1_1 — DAC Register1_1
0x533 DAC_REG1_2 — DAC Register1_2
0x538 DAC_CTRL_STATUS — DAC Control and Status Register
0x539 DAC_CONFIG — DAC Configuration Register
0x53A DAC_LPBK_CTRL — DAC Loopback Control Register
0x53B OP_STAGE_CTRL — DAC Output Stage Control Register
0x545 AFEDIAG_CFG — PGAIN and TGAIN Fault Threshold Configuration Register
0x546 BRDG_CTRL — Bridge Control Register
0x547 P_GAIN_SELECT
0x548 T_GAIN_SELECT
0x54C TEMP_CTRL — Temperature Sensor Control Register
0x550 ALPWR
0x554 DLPWR
0x558 PSMON1 — PSMON1 Fault Detect Register
0x559 PSMON2 — PSMON2 Fault Detect Register
0x55A AFEDIAG — PGAIN and TGAIN Fault Detect Register
0x560 TOPDIG_MUX_SEL — TOPDIG Multiplexer Register
0x561 TONDIG_MUX_SEL — TONDIG Multiplexer Register
0x564 AMUX_ACT — Analog Multiplexer Activate Register
0x565 AMUX_TIN_MUX_CTRL — TIN Analog Multiplexer Register
0x566 AMUX_TOUT_MUX_CTRL — TOUT Analog Multiplexer Register
0x567 AMUX_CTRL — Analog Multiplexer Register
0x570 TRACE_FIFO_CTRL_STAT — Trace FIFO Control and Status Register
