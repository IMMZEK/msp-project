# 28M36x_Code_Security_Module_Registers register map
Vendor: Texas Instruments
Peripheral module from a debugger description file (folder C2000).
Address unit: 16 bits
Registers are 32-bit, access not given, no defined reset value unless marked. A register's access mark holds for its fields unless they carry their own. Offsets are as the file gives them; lines under a group give offsets from that group; [hi:lo] are bit positions; {n}, {i} and the like mark numbered series; 'fields as' and 'values as' point back to an identical list; <NAME> marks a mode.

## DCSM_REGS — DCSM REGS Registers
{0x0+2i} Z1_CSMKEY{i} (i=0..3) — CSMKEY{i} Register for C28X-Zone-1 security Zone
0x0F Z1_CR 16-bit — Status and Control Register for C28X-Zone-1 security Zone
0x10 Z1_ECSLKEY0 — ECSLKEY0 Register for C28X-Zone-1 security Zone
0x12 Z1_ECSLKEY1 — ECSLKEY1 Register for C28X-Zone-1 security Zone
0x15 Z1_EXEONLYR 16-bit — Execute-Only Select Register for flash sectors
