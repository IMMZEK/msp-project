# CORTEXA9_SOCKET_PRCM register map
Vendor: Texas Instruments
Peripheral module from a debugger description file (folder omap4460).
Registers are 32-bit, read-only, no defined reset value unless marked. A register's access mark holds for its fields unless they carry their own. Offsets are as the file gives them; lines under a group give offsets from that group; [hi:lo] are bit positions; {n}, {i} and the like mark numbered series; 'fields as' and 'values as' point back to an identical list; <NAME> marks a mode.

## CORTEXA9_SOCKET_PRCM
0x00 CORTEXA9_PRCM_REVISION — IP Revision register
  [31:0] REVISION — IP revision
