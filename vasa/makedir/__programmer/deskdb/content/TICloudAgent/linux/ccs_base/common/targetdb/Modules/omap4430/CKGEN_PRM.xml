# CKGEN_PRM register map
Vendor: Texas Instruments
Peripheral module from a debugger description file (folder omap4430).
Registers are 32-bit, access per field, reset 0x0 unless marked. A register's access mark holds for its fields unless they carry their own. Offsets are as the file gives them; lines under a group give offsets from that group; [hi:lo] are bit positions; {n}, {i} and the like mark numbered series; 'fields as' and 'values as' point back to an identical list; <NAME> marks a mode.

## CKGEN_PRM
0x00 CM_ABE_DSS_SYS_CLKSEL — Select the SYS CLK for ABE and DSS subsystems. [warm reset insensitive]
  [0] CLKSEL rw — Selects the divider value
    0=Select SYS_CLK divided by 1; 1=Select SYS_CLK divided by 2 Must be used for SYS_CLK > 26 MHz
0x08 CM_L4_WKUP_CLKSEL — Control the functional clock source of L4_WKUP, PRM and Smart Reflex functional clock.
  [0] CLKSEL rw — Select the clock source for L4WKUP_ICLK and for ABE_DPLL_BYPASS_CLK clocks.
    0=Selects SYS_CLK for L4WKUP_ICLK Selects SYS_CLK for ABE_DPLL_BYPASS_CLK; 1=Selects ABE_LP_CLK for L4WKUP_ICLK Selects 32K_FCLK for ABE_DPLL_BYPASS_CLK
0x0C CM_ABE_PLL_REF_CLKSEL reset 0x1 — Control the source of the reference clock for DPLL_ABE
  [0] CLKSEL rw — Select the source for the DPLL_ABE reference clock.
    0=Selects SYS_CLK; 1=Selects SYS_32K
0x10 CM_SYS_CLKSEL — Software sets the SYS_CLK configuration corresponding to the frequency of SYS_CLK. [warm reset insensitive]
  [2:0] SYS_CLKSEL rw — System clock input selection.
    0=Uninitialized; 1=Input clock is 12 MHz; 3=Input clock is 16.8 MHz; 4=Input clock is 19.2 MHz; 5=Input clock is 26 MHz; 7=Input clock is 38.4 MHz
