# hercules_spi_spec_3.0.1 register map
Vendor: Texas Instruments
Peripheral module from a debugger description file (folder hercules).
Registers are 32-bit, access not given, no defined reset value unless marked. A register's access mark holds for its fields unless they carry their own. Offsets are as the file gives them; lines under a group give offsets from that group; [hi:lo] are bit positions; {n}, {i} and the like mark numbered series; 'fields as' and 'values as' point back to an identical list; <NAME> marks a mode.

## MibSpi — Multibuffered Serial Peripheral Interface
0x00 GlbCtrl0 — Global control register 0
0x04 GlbCtrl1 — Global control register 1
0x08 Int0 — Interrupt Register
0x0C IntLvl — Interrupt Level Register
0x10 IntFlg — Flag Register
0x14 Fun — Pin Control 0
0x18 Dir — Pin Control 1
0x1C DIn — Pin Control 2
0x20 DOut — Pin Control 3
0x24 DSet — Pin Control 4
0x28 DClr — Pin Control 5
0x2C PDr — Pin Control 6
0x30 PDis — Pin Control 7
0x34 PSel — Pin Control 8
0x38 TxDat0 — Transmit Data Register 0
0x3C TxDat1 — Transmit Data Register 1
0x40 RxBuf — Receive Buffer Register
0x44 Emu — Emulation Register
0x48 Delay
0x4C DefCs — Default Chip select Register
{0x50+4i} DatFmt{i} (i=0..3) — Data Format Register {i}
0x68 SrSel — Pin Control Register 9
0x134 IoLpbkTstCtrl — IO Loopback Test Control Register

## Notices in the file
(c) Texas Instruments 2003-2012, All rights reserved.
