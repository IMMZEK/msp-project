# c71_MMA register map
Vendor: Texas Instruments
Peripheral module from a debugger description file (folder C71).
Registers are 64-bit, access not given, no defined reset value unless marked. A register's access mark holds for its fields unless they carry their own. Offsets are as the file gives them; lines under a group give offsets from that group; [hi:lo] are bit positions; {n}, {i} and the like mark numbered series; 'fields as' and 'values as' point back to an identical list; <NAME> marks a mode.

## MMA — C71 MMA Registers
{0x90000+i} ARRAY_A0_0[{i}] (i=0..7) — HWA Multiplier Array - A0, Row 0
{0x90200+i} ARRAY_B0_0[{i}] (i=0..7) — HWA Multiplier Array - B0, Row 0
{0x90300+i} ARRAY_B1_0[{i}] (i=0..7) — HWA Multiplier Array - B1, Row 0
{0x90400+i} STORAGE_C0_0[{i}] (i=0..31) — HWA Storage - C0, Row 0
{0x90500+i} STORAGE_C1_0[{i}] (i=0..31) — HWA Storage - C1, Row 0
{0x90600+i} STORAGE_X_0[{i}] (i=0..7) — HWA Storage - X, Row 0
{0x190200+i} ARRAY_B0_1[{i}] (i=0..7) — HWA Multiplier Array - B0, Row 1
{0x190300+i} ARRAY_B1_1[{i}] (i=0..7) — HWA Multiplier Array - B1, Row 1
{0x190400+i} STORAGE_C0_1[{i}] (i=0..31) — HWA Storage - C0, Row 1
{0x190500+i} STORAGE_C1_1[{i}] (i=0..31) — HWA Storage - C1, Row 1
{0x190600+i} STORAGE_X_1[{i}] (i=0..7) — HWA Storage - X, Row 1
{0x290200+i} ARRAY_B0_2[{i}] (i=0..7) — HWA Multiplier Array - B0, Row 2
{0x290300+i} ARRAY_B1_2[{i}] (i=0..7) — HWA Multiplier Array - B1, Row 2
{0x290400+i} STORAGE_C0_2[{i}] (i=0..31) — HWA Storage - C0, Row 2
{0x290500+i} STORAGE_C1_2[{i}] (i=0..31) — HWA Storage - C1, Row 2
{0x290600+i} STORAGE_X_2[{i}] (i=0..7) — HWA Storage - X, Row 2
{0x390200+i} ARRAY_B0_3[{i}] (i=0..7) — HWA Multiplier Array - B0, Row 3
{0x390300+i} ARRAY_B1_3[{i}] (i=0..7) — HWA Multiplier Array - B1, Row 3
{0x390400+i} STORAGE_C0_3[{i}] (i=0..31) — HWA Storage - C0, Row 3
{0x390500+i} STORAGE_C1_3[{i}] (i=0..31) — HWA Storage - C1, Row 3
{0x390600+i} STORAGE_X_3[{i}] (i=0..7) — HWA Storage - X, Row 3
{0x490200+i} ARRAY_B0_4[{i}] (i=0..7) — HWA Multiplier Array - B0, Row 4
{0x490300+i} ARRAY_B1_4[{i}] (i=0..7) — HWA Multiplier Array - B1, Row 4
{0x490400+i} STORAGE_C0_4[{i}] (i=0..31) — HWA Storage - C0, Row 4
{0x490500+i} STORAGE_C1_4[{i}] (i=0..31) — HWA Storage - C1, Row 4
{0x490600+i} STORAGE_X_4[{i}] (i=0..7) — HWA Storage - X, Row 4
{0x590200+i} ARRAY_B0_5[{i}] (i=0..7) — HWA Multiplier Array - B0, Row 5
{0x590300+i} ARRAY_B1_5[{i}] (i=0..7) — HWA Multiplier Array - B1, Row 5
{0x590400+i} STORAGE_C0_5[{i}] (i=0..31) — HWA Storage - C0, Row 5
{0x590500+i} STORAGE_C1_5[{i}] (i=0..31) — HWA Storage - C1, Row 5
{0x590600+i} STORAGE_X_5[{i}] (i=0..7) — HWA Storage - X, Row 5
{0x690200+i} ARRAY_B0_6[{i}] (i=0..7) — HWA Multiplier Array - B0, Row 6
{0x690300+i} ARRAY_B1_6[{i}] (i=0..7) — HWA Multiplier Array - B1, Row 6
{0x690400+i} STORAGE_C0_6[{i}] (i=0..31) — HWA Storage - C0, Row 6
{0x690500+i} STORAGE_C1_6[{i}] (i=0..31) — HWA Storage - C1, Row 6
{0x690600+i} STORAGE_X_6[{i}] (i=0..7) — HWA Storage - X, Row 6
{0x790200+i} ARRAY_B0_7[{i}] (i=0..7) — HWA Multiplier Array - B0, Row 7
{0x790300+i} ARRAY_B1_7[{i}] (i=0..7) — HWA Multiplier Array - B1, Row 7
{0x790400+i} STORAGE_C0_7[{i}] (i=0..31) — HWA Storage - C0, Row 7
{0x790500+i} STORAGE_C1_7[{i}] (i=0..31) — HWA Storage - C1, Row 7
{0x790600+i} STORAGE_X_7[{i}] (i=0..7) — HWA Storage - X, Row 7
{0x890200+i} ARRAY_B0_8[{i}] (i=0..7) — HWA Multiplier Array - B0, Row 8
{0x890300+i} ARRAY_B1_8[{i}] (i=0..7) — HWA Multiplier Array - B1, Row 8
{0x890400+i} STORAGE_C0_8[{i}] (i=0..31) — HWA Storage - C0, Row 8
{0x890500+i} STORAGE_C1_8[{i}] (i=0..31) — HWA Storage - C1, Row 8
{0x890600+i} STORAGE_X_8[{i}] (i=0..7) — HWA Storage - X, Row 8
{0x990200+i} ARRAY_B0_9[{i}] (i=0..7) — HWA Multiplier Array - B0, Row 9
{0x990300+i} ARRAY_B1_9[{i}] (i=0..7) — HWA Multiplier Array - B1, Row 9
{0x990400+i} STORAGE_C0_9[{i}] (i=0..31) — HWA Storage - C0, Row 9
{0x990500+i} STORAGE_C1_9[{i}] (i=0..31) — HWA Storage - C1, Row 9
{0x990600+i} STORAGE_X_9[{i}] (i=0..7) — HWA Storage - X, Row 9
{0xA90200+i} ARRAY_B0_10[{i}] (i=0..7) — HWA Multiplier Array - B0, Row 10
{0xA90300+i} ARRAY_B1_10[{i}] (i=0..7) — HWA Multiplier Array - B1, Row 10
{0xA90400+i} STORAGE_C0_10[{i}] (i=0..31) — HWA Storage - C0, Row 10
{0xA90500+i} STORAGE_C1_10[{i}] (i=0..31) — HWA Storage - C1, Row 10
{0xA90600+i} STORAGE_X_10[{i}] (i=0..7) — HWA Storage - X, Row 10
{0xB90200+i} ARRAY_B0_11[{i}] (i=0..7) — HWA Multiplier Array - B0, Row 11
{0xB90300+i} ARRAY_B1_11[{i}] (i=0..7) — HWA Multiplier Array - B1, Row 11
{0xB90400+i} STORAGE_C0_11[{i}] (i=0..31) — HWA Storage - C0, Row 11
{0xB90500+i} STORAGE_C1_11[{i}] (i=0..31) — HWA Storage - C1, Row 11
{0xB90600+i} STORAGE_X_11[{i}] (i=0..7) — HWA Storage - X, Row 11
{0xC90200+i} ARRAY_B0_12[{i}] (i=0..7) — HWA Multiplier Array - B0, Row 12
{0xC90300+i} ARRAY_B1_12[{i}] (i=0..7) — HWA Multiplier Array - B1, Row 12
{0xC90400+i} STORAGE_C0_12[{i}] (i=0..31) — HWA Storage - C0, Row 12
{0xC90500+i} STORAGE_C1_12[{i}] (i=0..31) — HWA Storage - C1, Row 12
{0xC90600+i} STORAGE_X_12[{i}] (i=0..7) — HWA Storage - X, Row 12
{0xD90200+i} ARRAY_B0_13[{i}] (i=0..7) — HWA Multiplier Array - B0, Row 13
{0xD90300+i} ARRAY_B1_13[{i}] (i=0..7) — HWA Multiplier Array - B1, Row 13
{0xD90400+i} STORAGE_C0_13[{i}] (i=0..31) — HWA Storage - C0, Row 13
{0xD90500+i} STORAGE_C1_13[{i}] (i=0..31) — HWA Storage - C1, Row 13
{0xD90600+i} STORAGE_X_13[{i}] (i=0..7) — HWA Storage - X, Row 13
{0xE90200+i} ARRAY_B0_14[{i}] (i=0..7) — HWA Multiplier Array - B0, Row 14
{0xE90300+i} ARRAY_B1_14[{i}] (i=0..7) — HWA Multiplier Array - B1, Row 14
{0xE90400+i} STORAGE_C0_14[{i}] (i=0..31) — HWA Storage - C0, Row 14
{0xE90500+i} STORAGE_C1_14[{i}] (i=0..31) — HWA Storage - C1, Row 14
{0xE90600+i} STORAGE_X_14[{i}] (i=0..7) — HWA Storage - X, Row 14
{0xF90200+i} ARRAY_B0_15[{i}] (i=0..7) — HWA Multiplier Array - B0, Row 15
{0xF90300+i} ARRAY_B1_15[{i}] (i=0..7) — HWA Multiplier Array - B1, Row 15
{0xF90400+i} STORAGE_C0_15[{i}] (i=0..31) — HWA Storage - C0, Row 15
{0xF90500+i} STORAGE_C1_15[{i}] (i=0..31) — HWA Storage - C1, Row 15
{0xF90600+i} STORAGE_X_15[{i}] (i=0..7) — HWA Storage - X, Row 15
{0x1090200+i} ARRAY_B0_16[{i}] (i=0..7) — HWA Multiplier Array - B0, Row 16
{0x1090300+i} ARRAY_B1_16[{i}] (i=0..7) — HWA Multiplier Array - B1, Row 16
{0x1090400+i} STORAGE_C0_16[{i}] (i=0..31) — HWA Storage - C0, Row 16
{0x1090500+i} STORAGE_C1_16[{i}] (i=0..31) — HWA Storage - C1, Row 16
{0x1090600+i} STORAGE_X_16[{i}] (i=0..7) — HWA Storage - X, Row 16
{0x1190200+i} ARRAY_B0_17[{i}] (i=0..7) — HWA Multiplier Array - B0, Row 17
{0x1190300+i} ARRAY_B1_17[{i}] (i=0..7) — HWA Multiplier Array - B1, Row 17
{0x1190400+i} STORAGE_C0_17[{i}] (i=0..31) — HWA Storage - C0, Row 17
{0x1190500+i} STORAGE_C1_17[{i}] (i=0..31) — HWA Storage - C1, Row 17
{0x1190600+i} STORAGE_X_17[{i}] (i=0..7) — HWA Storage - X, Row 17
{0x1290200+i} ARRAY_B0_18[{i}] (i=0..7) — HWA Multiplier Array - B0, Row 18
{0x1290300+i} ARRAY_B1_18[{i}] (i=0..7) — HWA Multiplier Array - B1, Row 18
{0x1290400+i} STORAGE_C0_18[{i}] (i=0..31) — HWA Storage - C0, Row 18
{0x1290500+i} STORAGE_C1_18[{i}] (i=0..31) — HWA Storage - C1, Row 18
{0x1290600+i} STORAGE_X_18[{i}] (i=0..7) — HWA Storage - X, Row 18
{0x1390200+i} ARRAY_B0_19[{i}] (i=0..7) — HWA Multiplier Array - B0, Row 19
{0x1390300+i} ARRAY_B1_19[{i}] (i=0..7) — HWA Multiplier Array - B1, Row 19
{0x1390400+i} STORAGE_C0_19[{i}] (i=0..31) — HWA Storage - C0, Row 19
{0x1390500+i} STORAGE_C1_19[{i}] (i=0..31) — HWA Storage - C1, Row 19
{0x1390600+i} STORAGE_X_19[{i}] (i=0..7) — HWA Storage - X, Row 19
{0x1490200+i} ARRAY_B0_20[{i}] (i=0..7) — HWA Multiplier Array - B0, Row 20
{0x1490300+i} ARRAY_B1_20[{i}] (i=0..7) — HWA Multiplier Array - B1, Row 20
{0x1490400+i} STORAGE_C0_20[{i}] (i=0..31) — HWA Storage - C0, Row 20
{0x1490500+i} STORAGE_C1_20[{i}] (i=0..31) — HWA Storage - C1, Row 20
{0x1490600+i} STORAGE_X_20[{i}] (i=0..7) — HWA Storage - X, Row 20
{0x1590200+i} ARRAY_B0_21[{i}] (i=0..7) — HWA Multiplier Array - B0, Row 21
{0x1590300+i} ARRAY_B1_21[{i}] (i=0..7) — HWA Multiplier Array - B1, Row 21
{0x1590400+i} STORAGE_C0_21[{i}] (i=0..31) — HWA Storage - C0, Row 21
{0x1590500+i} STORAGE_C1_21[{i}] (i=0..31) — HWA Storage - C1, Row 21
{0x1590600+i} STORAGE_X_21[{i}] (i=0..7) — HWA Storage - X, Row 21
{0x1690200+i} ARRAY_B0_22[{i}] (i=0..7) — HWA Multiplier Array - B0, Row 22
{0x1690300+i} ARRAY_B1_22[{i}] (i=0..7) — HWA Multiplier Array - B1, Row 22
{0x1690400+i} STORAGE_C0_22[{i}] (i=0..31) — HWA Storage - C0, Row 22
{0x1690500+i} STORAGE_C1_22[{i}] (i=0..31) — HWA Storage - C1, Row 22
{0x1690600+i} STORAGE_X_22[{i}] (i=0..7) — HWA Storage - X, Row 22
{0x1790200+i} ARRAY_B0_23[{i}] (i=0..7) — HWA Multiplier Array - B0, Row 23
{0x1790300+i} ARRAY_B1_23[{i}] (i=0..7) — HWA Multiplier Array - B1, Row 23
{0x1790400+i} STORAGE_C0_23[{i}] (i=0..31) — HWA Storage - C0, Row 23
{0x1790500+i} STORAGE_C1_23[{i}] (i=0..31) — HWA Storage - C1, Row 23
{0x1790600+i} STORAGE_X_23[{i}] (i=0..7) — HWA Storage - X, Row 23
{0x1890200+i} ARRAY_B0_24[{i}] (i=0..7) — HWA Multiplier Array - B0, Row 24
{0x1890300+i} ARRAY_B1_24[{i}] (i=0..7) — HWA Multiplier Array - B1, Row 24
{0x1890400+i} STORAGE_C0_24[{i}] (i=0..31) — HWA Storage - C0, Row 24
{0x1890500+i} STORAGE_C1_24[{i}] (i=0..31) — HWA Storage - C1, Row 24
{0x1890600+i} HWA_CONFIG[{i}] (i=0..7)
{0x1990200+i} ARRAY_B0_25[{i}] (i=0..7) — HWA Multiplier Array - B0, Row 25
{0x1990300+i} ARRAY_B1_25[{i}] (i=0..7) — HWA Multiplier Array - B1, Row 25
{0x1990400+i} STORAGE_C0_25[{i}] (i=0..31) — HWA Storage - C0, Row 25
{0x1990500+i} STORAGE_C1_25[{i}] (i=0..31) — HWA Storage - C1, Row 25
{0x1990600+i} HWA_OFFSET[{i}] (i=0..7)
{0x1A90200+i} ARRAY_B0_26[{i}] (i=0..7) — HWA Multiplier Array - B0, Row 26
{0x1A90300+i} ARRAY_B1_26[{i}] (i=0..7) — HWA Multiplier Array - B1, Row 26
{0x1A90400+i} STORAGE_C0_26[{i}] (i=0..31) — HWA Storage - C0, Row 26
{0x1A90500+i} STORAGE_C1_26[{i}] (i=0..31) — HWA Storage - C1, Row 26
{0x1A90600+i} HWA_STATUS[{i}] (i=0..7)
{0x1B90200+i} ARRAY_B0_27[{i}] (i=0..7) — HWA Multiplier Array - B0, Row 27
{0x1B90300+i} ARRAY_B1_27[{i}] (i=0..7) — HWA Multiplier Array - B1, Row 27
{0x1B90400+i} STORAGE_C0_27[{i}] (i=0..31) — HWA Storage - C0, Row 27
{0x1B90500+i} STORAGE_C1_27[{i}] (i=0..31) — HWA Storage - C1, Row 27
{0x1C90200+i} ARRAY_B0_28[{i}] (i=0..7) — HWA Multiplier Array - B0, Row 28
{0x1C90300+i} ARRAY_B1_28[{i}] (i=0..7) — HWA Multiplier Array - B1, Row 28
{0x1C90400+i} STORAGE_C0_28[{i}] (i=0..31) — HWA Storage - C0, Row 28
{0x1C90500+i} STORAGE_C1_28[{i}] (i=0..31) — HWA Storage - C1, Row 28
{0x1D90200+i} ARRAY_B0_29[{i}] (i=0..7) — HWA Multiplier Array - B0, Row 29
{0x1D90300+i} ARRAY_B1_29[{i}] (i=0..7) — HWA Multiplier Array - B1, Row 29
{0x1D90400+i} STORAGE_C0_29[{i}] (i=0..31) — HWA Storage - C0, Row 29
{0x1D90500+i} STORAGE_C1_29[{i}] (i=0..31) — HWA Storage - C1, Row 29
{0x1E90200+i} ARRAY_B0_30[{i}] (i=0..7) — HWA Multiplier Array - B0, Row 30
{0x1E90300+i} ARRAY_B1_30[{i}] (i=0..7) — HWA Multiplier Array - B1, Row 30
{0x1E90400+i} STORAGE_C0_30[{i}] (i=0..31) — HWA Storage - C0, Row 30
{0x1E90500+i} STORAGE_C1_30[{i}] (i=0..31) — HWA Storage - C1, Row 30
{0x1F90200+i} ARRAY_B0_31[{i}] (i=0..7) — HWA Multiplier Array - B0, Row 31
{0x1F90300+i} ARRAY_B1_31[{i}] (i=0..7) — HWA Multiplier Array - B1, Row 31
{0x1F90400+i} STORAGE_C0_31[{i}] (i=0..31) — HWA Storage - C0, Row 31
{0x1F90500+i} STORAGE_C1_31[{i}] (i=0..31) — HWA Storage - C1, Row 31
{0x2090200+i} ARRAY_B0_32[{i}] (i=0..7) — HWA Multiplier Array - B0, Row 32
{0x2090300+i} ARRAY_B1_32[{i}] (i=0..7) — HWA Multiplier Array - B1, Row 32
{0x2090400+i} STORAGE_C0_32[{i}] (i=0..31) — HWA Storage - C0, Row 32
{0x2090500+i} STORAGE_C1_32[{i}] (i=0..31) — HWA Storage - C1, Row 32
{0x2190200+i} ARRAY_B0_33[{i}] (i=0..7) — HWA Multiplier Array - B0, Row 33
{0x2190300+i} ARRAY_B1_33[{i}] (i=0..7) — HWA Multiplier Array - B1, Row 33
{0x2190400+i} STORAGE_C0_33[{i}] (i=0..31) — HWA Storage - C0, Row 33
{0x2190500+i} STORAGE_C1_33[{i}] (i=0..31) — HWA Storage - C1, Row 33
{0x2290200+i} ARRAY_B0_34[{i}] (i=0..7) — HWA Multiplier Array - B0, Row 34
{0x2290300+i} ARRAY_B1_34[{i}] (i=0..7) — HWA Multiplier Array - B1, Row 34
{0x2290400+i} STORAGE_C0_34[{i}] (i=0..31) — HWA Storage - C0, Row 34
{0x2290500+i} STORAGE_C1_34[{i}] (i=0..31) — HWA Storage - C1, Row 34
{0x2390200+i} ARRAY_B0_35[{i}] (i=0..7) — HWA Multiplier Array - B0, Row 35
{0x2390300+i} ARRAY_B1_35[{i}] (i=0..7) — HWA Multiplier Array - B1, Row 35
{0x2390400+i} STORAGE_C0_35[{i}] (i=0..31) — HWA Storage - C0, Row 35
{0x2390500+i} STORAGE_C1_35[{i}] (i=0..31) — HWA Storage - C1, Row 35
{0x2490200+i} ARRAY_B0_36[{i}] (i=0..7) — HWA Multiplier Array - B0, Row 36
{0x2490300+i} ARRAY_B1_36[{i}] (i=0..7) — HWA Multiplier Array - B1, Row 36
{0x2490400+i} STORAGE_C0_36[{i}] (i=0..31) — HWA Storage - C0, Row 36
{0x2490500+i} STORAGE_C1_36[{i}] (i=0..31) — HWA Storage - C1, Row 36
{0x2590200+i} ARRAY_B0_37[{i}] (i=0..7) — HWA Multiplier Array - B0, Row 37
{0x2590300+i} ARRAY_B1_37[{i}] (i=0..7) — HWA Multiplier Array - B1, Row 37
{0x2590400+i} STORAGE_C0_37[{i}] (i=0..31) — HWA Storage - C0, Row 37
{0x2590500+i} STORAGE_C1_37[{i}] (i=0..31) — HWA Storage - C1, Row 37
{0x2690200+i} ARRAY_B0_38[{i}] (i=0..7) — HWA Multiplier Array - B0, Row 38
{0x2690300+i} ARRAY_B1_38[{i}] (i=0..7) — HWA Multiplier Array - B1, Row 38
{0x2690400+i} STORAGE_C0_38[{i}] (i=0..31) — HWA Storage - C0, Row 38
{0x2690500+i} STORAGE_C1_38[{i}] (i=0..31) — HWA Storage - C1, Row 38
{0x2790200+i} ARRAY_B0_39[{i}] (i=0..7) — HWA Multiplier Array - B0, Row 39
{0x2790300+i} ARRAY_B1_39[{i}] (i=0..7) — HWA Multiplier Array - B1, Row 39
{0x2790400+i} STORAGE_C0_39[{i}] (i=0..31) — HWA Storage - C0, Row 39
{0x2790500+i} STORAGE_C1_39[{i}] (i=0..31) — HWA Storage - C1, Row 39
{0x2890200+i} ARRAY_B0_40[{i}] (i=0..7) — HWA Multiplier Array - B0, Row 40
{0x2890300+i} ARRAY_B1_40[{i}] (i=0..7) — HWA Multiplier Array - B1, Row 40
{0x2890400+i} STORAGE_C0_40[{i}] (i=0..31) — HWA Storage - C0, Row 40
{0x2890500+i} STORAGE_C1_40[{i}] (i=0..31) — HWA Storage - C1, Row 40
{0x2990200+i} ARRAY_B0_41[{i}] (i=0..7) — HWA Multiplier Array - B0, Row 41
{0x2990300+i} ARRAY_B1_41[{i}] (i=0..7) — HWA Multiplier Array - B1, Row 41
{0x2990400+i} STORAGE_C0_41[{i}] (i=0..31) — HWA Storage - C0, Row 41
{0x2990500+i} STORAGE_C1_41[{i}] (i=0..31) — HWA Storage - C1, Row 41
{0x2A90200+i} ARRAY_B0_42[{i}] (i=0..7) — HWA Multiplier Array - B0, Row 42
{0x2A90300+i} ARRAY_B1_42[{i}] (i=0..7) — HWA Multiplier Array - B1, Row 42
{0x2A90400+i} STORAGE_C0_42[{i}] (i=0..31) — HWA Storage - C0, Row 42
{0x2A90500+i} STORAGE_C1_42[{i}] (i=0..31) — HWA Storage - C1, Row 42
{0x2B90200+i} ARRAY_B0_43[{i}] (i=0..7) — HWA Multiplier Array - B0, Row 43
{0x2B90300+i} ARRAY_B1_43[{i}] (i=0..7) — HWA Multiplier Array - B1, Row 43
{0x2B90400+i} STORAGE_C0_43[{i}] (i=0..31) — HWA Storage - C0, Row 43
{0x2B90500+i} STORAGE_C1_43[{i}] (i=0..31) — HWA Storage - C1, Row 43
{0x2C90200+i} ARRAY_B0_44[{i}] (i=0..7) — HWA Multiplier Array - B0, Row 44
{0x2C90300+i} ARRAY_B1_44[{i}] (i=0..7) — HWA Multiplier Array - B1, Row 44
{0x2C90400+i} STORAGE_C0_44[{i}] (i=0..31) — HWA Storage - C0, Row 44
{0x2C90500+i} STORAGE_C1_44[{i}] (i=0..31) — HWA Storage - C1, Row 44
{0x2D90200+i} ARRAY_B0_45[{i}] (i=0..7) — HWA Multiplier Array - B0, Row 45
{0x2D90300+i} ARRAY_B1_45[{i}] (i=0..7) — HWA Multiplier Array - B1, Row 45
{0x2D90400+i} STORAGE_C0_45[{i}] (i=0..31) — HWA Storage - C0, Row 45
{0x2D90500+i} STORAGE_C1_45[{i}] (i=0..31) — HWA Storage - C1, Row 45
{0x2E90200+i} ARRAY_B0_46[{i}] (i=0..7) — HWA Multiplier Array - B0, Row 46
{0x2E90300+i} ARRAY_B1_46[{i}] (i=0..7) — HWA Multiplier Array - B1, Row 46
{0x2E90400+i} STORAGE_C0_46[{i}] (i=0..31) — HWA Storage - C0, Row 46
{0x2E90500+i} STORAGE_C1_46[{i}] (i=0..31) — HWA Storage - C1, Row 46
{0x2F90200+i} ARRAY_B0_47[{i}] (i=0..7) — HWA Multiplier Array - B0, Row 47
{0x2F90300+i} ARRAY_B1_47[{i}] (i=0..7) — HWA Multiplier Array - B1, Row 47
{0x2F90400+i} STORAGE_C0_47[{i}] (i=0..31) — HWA Storage - C0, Row 47
{0x2F90500+i} STORAGE_C1_47[{i}] (i=0..31) — HWA Storage - C1, Row 47
{0x3090200+i} ARRAY_B0_48[{i}] (i=0..7) — HWA Multiplier Array - B0, Row 48
{0x3090300+i} ARRAY_B1_48[{i}] (i=0..7) — HWA Multiplier Array - B1, Row 48
{0x3090400+i} STORAGE_C0_48[{i}] (i=0..31) — HWA Storage - C0, Row 48
{0x3090500+i} STORAGE_C1_48[{i}] (i=0..31) — HWA Storage - C1, Row 48
{0x3190200+i} ARRAY_B0_49[{i}] (i=0..7) — HWA Multiplier Array - B0, Row 49
{0x3190300+i} ARRAY_B1_49[{i}] (i=0..7) — HWA Multiplier Array - B1, Row 49
{0x3190400+i} STORAGE_C0_49[{i}] (i=0..31) — HWA Storage - C0, Row 49
{0x3190500+i} STORAGE_C1_49[{i}] (i=0..31) — HWA Storage - C1, Row 49
{0x3290200+i} ARRAY_B0_50[{i}] (i=0..7) — HWA Multiplier Array - B0, Row 50
{0x3290300+i} ARRAY_B1_50[{i}] (i=0..7) — HWA Multiplier Array - B1, Row 50
{0x3290400+i} STORAGE_C0_50[{i}] (i=0..31) — HWA Storage - C0, Row 50
{0x3290500+i} STORAGE_C1_50[{i}] (i=0..31) — HWA Storage - C1, Row 50
{0x3390200+i} ARRAY_B0_51[{i}] (i=0..7) — HWA Multiplier Array - B0, Row 51
{0x3390300+i} ARRAY_B1_51[{i}] (i=0..7) — HWA Multiplier Array - B1, Row 51
{0x3390400+i} STORAGE_C0_51[{i}] (i=0..31) — HWA Storage - C0, Row 51
{0x3390500+i} STORAGE_C1_51[{i}] (i=0..31) — HWA Storage - C1, Row 51
{0x3490200+i} ARRAY_B0_52[{i}] (i=0..7) — HWA Multiplier Array - B0, Row 52
{0x3490300+i} ARRAY_B1_52[{i}] (i=0..7) — HWA Multiplier Array - B1, Row 52
{0x3490400+i} STORAGE_C0_52[{i}] (i=0..31) — HWA Storage - C0, Row 52
{0x3490500+i} STORAGE_C1_52[{i}] (i=0..31) — HWA Storage - C1, Row 52
{0x3590200+i} ARRAY_B0_53[{i}] (i=0..7) — HWA Multiplier Array - B0, Row 53
{0x3590300+i} ARRAY_B1_53[{i}] (i=0..7) — HWA Multiplier Array - B1, Row 53
{0x3590400+i} STORAGE_C0_53[{i}] (i=0..31) — HWA Storage - C0, Row 53
{0x3590500+i} STORAGE_C1_53[{i}] (i=0..31) — HWA Storage - C1, Row 53
{0x3690200+i} ARRAY_B0_54[{i}] (i=0..7) — HWA Multiplier Array - B0, Row 54
{0x3690300+i} ARRAY_B1_54[{i}] (i=0..7) — HWA Multiplier Array - B1, Row 54
{0x3690400+i} STORAGE_C0_54[{i}] (i=0..31) — HWA Storage - C0, Row 54
{0x3690500+i} STORAGE_C1_54[{i}] (i=0..31) — HWA Storage - C1, Row 54
{0x3790200+i} ARRAY_B0_55[{i}] (i=0..7) — HWA Multiplier Array - B0, Row 55
{0x3790300+i} ARRAY_B1_55[{i}] (i=0..7) — HWA Multiplier Array - B1, Row 55
{0x3790400+i} STORAGE_C0_55[{i}] (i=0..31) — HWA Storage - C0, Row 55
{0x3790500+i} STORAGE_C1_55[{i}] (i=0..31) — HWA Storage - C1, Row 55
{0x3890200+i} ARRAY_B0_56[{i}] (i=0..7) — HWA Multiplier Array - B0, Row 56
{0x3890300+i} ARRAY_B1_56[{i}] (i=0..7) — HWA Multiplier Array - B1, Row 56
{0x3890400+i} STORAGE_C0_56[{i}] (i=0..31) — HWA Storage - C0, Row 56
{0x3890500+i} STORAGE_C1_56[{i}] (i=0..31) — HWA Storage - C1, Row 56
{0x3990200+i} ARRAY_B0_57[{i}] (i=0..7) — HWA Multiplier Array - B0, Row 57
{0x3990300+i} ARRAY_B1_57[{i}] (i=0..7) — HWA Multiplier Array - B1, Row 57
{0x3990400+i} STORAGE_C0_57[{i}] (i=0..31) — HWA Storage - C0, Row 57
{0x3990500+i} STORAGE_C1_57[{i}] (i=0..31) — HWA Storage - C1, Row 57
{0x3A90200+i} ARRAY_B0_58[{i}] (i=0..7) — HWA Multiplier Array - B0, Row 58
{0x3A90300+i} ARRAY_B1_58[{i}] (i=0..7) — HWA Multiplier Array - B1, Row 58
{0x3A90400+i} STORAGE_C0_58[{i}] (i=0..31) — HWA Storage - C0, Row 58
{0x3A90500+i} STORAGE_C1_58[{i}] (i=0..31) — HWA Storage - C1, Row 58
{0x3B90200+i} ARRAY_B0_59[{i}] (i=0..7) — HWA Multiplier Array - B0, Row 59
{0x3B90300+i} ARRAY_B1_59[{i}] (i=0..7) — HWA Multiplier Array - B1, Row 59
{0x3B90400+i} STORAGE_C0_59[{i}] (i=0..31) — HWA Storage - C0, Row 59
{0x3B90500+i} STORAGE_C1_59[{i}] (i=0..31) — HWA Storage - C1, Row 59
{0x3C90200+i} ARRAY_B0_60[{i}] (i=0..7) — HWA Multiplier Array - B0, Row 60
{0x3C90300+i} ARRAY_B1_60[{i}] (i=0..7) — HWA Multiplier Array - B1, Row 60
{0x3C90400+i} STORAGE_C0_60[{i}] (i=0..31) — HWA Storage - C0, Row 60
{0x3C90500+i} STORAGE_C1_60[{i}] (i=0..31) — HWA Storage - C1, Row 60
{0x3D90200+i} ARRAY_B0_61[{i}] (i=0..7) — HWA Multiplier Array - B0, Row 61
{0x3D90300+i} ARRAY_B1_61[{i}] (i=0..7) — HWA Multiplier Array - B1, Row 61
{0x3D90400+i} STORAGE_C0_61[{i}] (i=0..31) — HWA Storage - C0, Row 61
{0x3D90500+i} STORAGE_C1_61[{i}] (i=0..31) — HWA Storage - C1, Row 61
{0x3E90200+i} ARRAY_B0_62[{i}] (i=0..7) — HWA Multiplier Array - B0, Row 62
{0x3E90300+i} ARRAY_B1_62[{i}] (i=0..7) — HWA Multiplier Array - B1, Row 62
{0x3E90400+i} STORAGE_C0_62[{i}] (i=0..31) — HWA Storage - C0, Row 62
{0x3E90500+i} STORAGE_C1_62[{i}] (i=0..31) — HWA Storage - C1, Row 62
{0x3F90200+i} ARRAY_B0_63[{i}] (i=0..7) — HWA Multiplier Array - B0, Row 63
{0x3F90300+i} ARRAY_B1_63[{i}] (i=0..7) — HWA Multiplier Array - B1, Row 63
{0x3F90400+i} STORAGE_C0_63[{i}] (i=0..31) — HWA Storage - C0, Row 63
{0x3F90500+i} STORAGE_C1_63[{i}] (i=0..31) — HWA Storage - C1, Row 63
