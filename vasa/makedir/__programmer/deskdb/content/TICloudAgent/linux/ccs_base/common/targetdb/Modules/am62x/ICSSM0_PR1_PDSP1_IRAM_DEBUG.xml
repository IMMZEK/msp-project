# ICSSM0_PR1_PDSP1_IRAM_DEBUG register map
Vendor: Texas Instruments
Peripheral module from a debugger description file (folder am62x).
Registers are 32-bit, read-write, reset 0x0 unless marked. A register's access mark holds for its fields unless they carry their own. Offsets are as the file gives them; lines under a group give offsets from that group; [hi:lo] are bit positions; {n}, {i} and the like mark numbered series; 'fields as' and 'values as' point back to an identical list; <NAME> marks a mode.

## ICSSM0_PR1_PDSP1_IRAM_DEBUG
0x00 PR1_PDSP1__IRAM__DEBUG_IGP — PDSP Internal General Purpose Register
  [31:0] REGN — PDSP Internal GP Register N
0x80 PR1_PDSP1__IRAM__DEBUG_ICTE ro — PDSP Internal Contants Table Entry Register
  [31:0] CT_ENTRYN — PDSP Internal Constants Table Entry N
