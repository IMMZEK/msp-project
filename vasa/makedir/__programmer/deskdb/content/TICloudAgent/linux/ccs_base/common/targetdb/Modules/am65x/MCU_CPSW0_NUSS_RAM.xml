# MCU_CPSW0_NUSS_RAM register map
Vendor: Texas Instruments
Peripheral module from a debugger description file (folder am65x).
Registers are 32-bit, read-write, reset 0x0 unless marked. A register's access mark holds for its fields unless they carry their own. Offsets are as the file gives them; lines under a group give offsets from that group; [hi:lo] are bit positions; {n}, {i} and the like mark numbered series; 'fields as' and 'values as' point back to an identical list; <NAME> marks a mode.

## MCU_CPSW0_NUSS_RAM
0x32000 CPSW_FETCH_LOC_y — These are the RAM locations for one Ethernet port. Offset = 00032000h + (y * 4h); where y = 0h to 7Fh
  [21:0] LOC — RAM Location.
