# hercules_rwm_spec_0.5.0 register map
Vendor: Texas Instruments
Peripheral module from a debugger description file (folder hercules).
Registers are 32-bit, access not given, no defined reset value unless marked. A register's access mark holds for its fields unless they carry their own. Offsets are as the file gives them; lines under a group give offsets from that group; [hi:lo] are bit positions; {n}, {i} and the like mark numbered series; 'fields as' and 'values as' point back to an identical list; <NAME> marks a mode.

## Rwm — RAM Wrapper Module
0x00 Ctrl — Ram Control Register 1
0x04 Threshold
0x08 Occur — Occurrence Register
0x0C IntCtrl — Interrupt Control Register
0x10 ErrStatus — Memory Fault Detect Status Register
0x14 SErrAddr — Single Error Address Register
0x18 ErrPosition — RAM Error Position Register
0x1C DErrAddr — Double Error Address Register
0x20 Ctrl2 — RAM Control Register 2

## Notices in the file
(c) Texas Instruments 2003-2012, All rights reserved.
