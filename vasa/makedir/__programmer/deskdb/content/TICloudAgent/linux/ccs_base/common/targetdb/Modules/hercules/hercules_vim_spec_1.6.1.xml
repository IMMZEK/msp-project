# hercules_vim_spec_1.6.1 register map
Vendor: Texas Instruments
Peripheral module from a debugger description file (folder hercules).
Registers are 32-bit, access not given, no defined reset value unless marked. A register's access mark holds for its fields unless they carry their own. Offsets are as the file gives them; lines under a group give offsets from that group; [hi:lo] are bit positions; {n}, {i} and the like mark numbered series; 'fields as' and 'values as' point back to an identical list; <NAME> marks a mode.

## Vim — Vectored Interrupt Manager
0x00 IrqIVec — Index Offset Vector Register
0x04 FiqIVec — Index Offset Vector Register
{0x10+4i} FIrqPr{i} (i=0..2) — Program Control Register
{0x20+4i} IntReq{i} (i=0..2) — Pending Interrupt Read Location
{0x30+4i} ReqMaskSet{i} (i=0..2) — Interrupt Mask Set Register
{0x40+4i} ReqMaskClr{i} (i=0..2) — Interrupt Mask Clear Register
{0x50+4i} WakeMaskSet{i} (i=0..2) — Wake-up Mask Set Register
{0x60+4i} WakeMaskClr{i} (i=0..2) — Wake-up Mask Clear Register
0x70 IrqVecReg — Irq Interrupt Vector Register
0x74 FiqVecReg — Fiq Interrupt Vector Register
0x78 CapEvtSrc — Capture Event register
{0x80+4i} ChanCtrl{i} (i=0..23) — Channel Mapping Register

## Notices in the file
(c) Texas Instruments 2003-2012, All rights reserved.
