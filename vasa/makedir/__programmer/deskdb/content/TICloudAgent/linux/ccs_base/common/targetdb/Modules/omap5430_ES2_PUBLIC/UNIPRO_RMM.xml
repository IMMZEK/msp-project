# UNIPRO_RMM register map
Vendor: Texas Instruments
Peripheral module from a debugger description file (folder omap5430_ES2_PUBLIC).
Registers are 32-bit, write-only, reset 0x0 unless marked. A register's access mark holds for its fields unless they carry their own. Offsets are as the file gives them; lines under a group give offsets from that group; [hi:lo] are bit positions; {n}, {i} and the like mark numbered series; 'fields as' and 'values as' point back to an identical list; <NAME> marks a mode.

## UNIPRO_RMM
0x00 UNIPRO_CREDITS_INC_0 — Register mapped command for coherent CreditsToSend / CFDcredits counter increment, for C-Port #0 Credits are dierctly incremented with Credits_amount in TN accelerator cache without need for memory coherency operation.
  [31:0] VALUE
0x1FFC UNIPRO_CREDITS_INC_2047 — Register mapped command for coherent CreditsToSend / CFDcredits counter increment, for C-Port #2047 Credits are dierctly incremented with Credits_amount in TN accelerator cache without need for memory coherency operation.
  [31:0] VALUE
