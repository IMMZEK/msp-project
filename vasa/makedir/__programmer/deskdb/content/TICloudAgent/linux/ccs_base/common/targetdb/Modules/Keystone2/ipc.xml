# ipc register map
Vendor: Texas Instruments
Peripheral module from a debugger description file (folder Keystone2).
Registers are 32-bit, access not given, no defined reset value unless marked. A register's access mark holds for its fields unless they carry their own. Offsets are as the file gives them; lines under a group give offsets from that group; [hi:lo] are bit positions; {n}, {i} and the like mark numbered series; 'fields as' and 'values as' point back to an identical list; <NAME> marks a mode.

## IPC
0x00 nmigr — (1 of 8, stride 4)
0x40 ipcgr — (1 of 8, stride 4)
0x7C ipcgrh
0x80 ipcar — (1 of 8, stride 4)
0xBC ipcarh
