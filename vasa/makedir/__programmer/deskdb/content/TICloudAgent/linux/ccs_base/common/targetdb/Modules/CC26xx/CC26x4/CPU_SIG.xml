# CPU_SIG register map
Vendor: Texas Instruments
Peripheral module from a debugger description file (folder CC26x4).
Registers are 32-bit, access per field, reset 0x0 unless marked. A register's access mark holds for its fields unless they carry their own. Offsets are as the file gives them; lines under a group give offsets from that group; [hi:lo] are bit positions; {n}, {i} and the like mark numbered series; 'fields as' and 'values as' point back to an identical list; <NAME> marks a mode.

## CPU_SIG — Cortex-M's Software Interrupt Generator (SIG)
0x00 STIR — Provides a mechanism for software to generate an interrupt
  [8:0] INTID wo — Indicates the interrupt to be pended. The value written is (ExceptionNumber - 16)
