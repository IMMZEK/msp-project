# hercules_emif_spec_2.5.5 register map
Vendor: Texas Instruments
Peripheral module from a debugger description file (folder hercules).
Registers are 32-bit, access not given, no defined reset value unless marked. A register's access mark holds for its fields unless they carry their own. Offsets are as the file gives them; lines under a group give offsets from that group; [hi:lo] are bit positions; {n}, {i} and the like mark numbered series; 'fields as' and 'values as' point back to an identical list; <NAME> marks a mode.

## Emif — External Memory Interface
0x00 RevCdStat — Revision Code and Status Register
{0xC+4i} Async{i}Cfg (i=1..4) — Asynchronous {i} Configuration Register (CS{i-1} space)
0x20 SdramTiming
0x24 SdramStat — SDRAM Status Register
0x28 DdrPhyCtrl — DDR PHY Control Register
0x2C DdrPhyStat — DDR PHY Status Register
0x30 SdramAccess — Total SDRAM Accesses Register
0x34 SdramActivat — Total SDRAM Activate Register
0x38 DdrPhyIdRev — DDR PHY ID and Revision Register
0x3C SdramSrExTiming — SDRAM SR/PD Exit Timing Register
0x40 IntRaw — Interrupt Raw Register
0x44 IntMask — Interrupt Masked Register
0x48 IntMaskSet — Interrupt Mask Set Register
0x4C IntMaskClr — Interrupt Mask Clear Register
0x50 IoCtrl — IO Control Register
0x54 IoStat — IO Status Register
0x58 SdramConfig2
0x5C OneNandFlashCtrl — NAND Flash Control Register
0x60 NandFlashCtrl — NAND Flash Control Register
0x64 NandFlashStat — NAND Flash Status Register
0x68 PageModCtrl — Page Mode Control Register
{0x68+4i} NandFlashCs{i}Ecc (i=2..4) — NAND Flash CS{i} 1-Bit ECC Register
0x7C NandFlashCs5Ecc — NAND Flash CS2 1-Bit ECC Register
0x84 IoDftExecCount — IODFT Test Logic Execution Counter Register
0x88 IoDftGlobCtrl — IODFT Test Logic Global Control Register
0x90 IoDftAddrMisrResult — IODFT Test Logic Address MISR Result Register
0x94 IoDftDataMisrResult — IODFT Test Logic Data MISR Result Register
0x98 IoDftCtrlResult — IODFT Test Logic Data and Control MISR Result
0xB0 ModuleRev — Module Release Number Register
0xBC NandFlashEccLoad — NAND Flash 4-Bit ECC Load Register
{0xBC+4i} NandFlashEcc{i} (i=1..4) — NAND Flash 4-Bit ECC {i} Register
{0xCC+4i} NandFlashErrAddr{i} (i=1..4) — NAND Flash Error Address {i} Register

## Notices in the file
(c) Texas Instruments 2003-2012, All rights reserved.
