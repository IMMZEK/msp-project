# MCU_NAVSS0_PROXY0_BUF_CFG register map
Vendor: Texas Instruments
Peripheral module from a debugger description file (folder am65x).
Registers are 32-bit, read-write, reset 0xFFFF unless marked. A register's access mark holds for its fields unless they carry their own. Offsets are as the file gives them; lines under a group give offsets from that group; [hi:lo] are bit positions; {n}, {i} and the like mark numbered series; 'fields as' and 'values as' point back to an identical list; <NAME> marks a mode.

## MCU_NAVSS0_PROXY0_BUF_CFG
0x00 PROXY_EVT_REG_j — The Proxy Event for the proxy Offset = 0h + (j * 1000h); where j = 0h to 3Fh
  [15:0] ERR_EVENT — Proxy Error Event
