# IOC register map
Vendor: Texas Instruments
Peripheral module from a debugger description file (folder cc2538).
Registers are 32-bit, access per field, no defined reset value unless marked. A register's access mark holds for its fields unless they carry their own. Offsets are as the file gives them; lines under a group give offsets from that group; [hi:lo] are bit positions; {n}, {i} and the like mark numbered series; 'fields as' and 'values as' point back to an identical list; <NAME> marks a mode.

## IOC — Register fields should be considered static unless otherwise noted as dynamic.
{0x0+4i} PA{i}_SEL (i=0..7) — Peripheral select control for PA{i}
  [4:0] PA{i}_sel rw — Select one peripheral signal output for PA{i}.
{0x20+4i} PB{i}_SEL (i=0..7) — Peripheral select control for PB{i}
  [4:0] PB{i}_sel rw — Select one peripheral signal output for PB{i}.
{0x40+4i} PC{i}_SEL (i=0..7) — Peripheral select control for PC{i}
  [4:0] PC{i}_sel rw — Select one peripheral signal output for PC{i}.
{0x60+4i} PD{i}_SEL (i=0..7) — Peripheral select control for PD{i}
  [4:0] PD{i}_sel rw — Select one peripheral signal output for PD{i}.
{0x80+4i} PA{i}_OVER (i=0..7) — This is the overide configuration register for each pad.
  [3:0] PA{i}_over rw — 0x8: oe - output enable 0x4: pue - pullup enable 0x2: pde - pulldown enable 0x1: ana - analog enable
{0xA0+4i} PB{i}_OVER (i=0..7) — This is the overide configuration register for each pad.
  [3:0] PB{i}_over rw — 0x8: oe - output enable 0x4: pue - pullup enable 0x2: pde - pulldown enable 0x1: ana - analog enable
{0xC0+4i} PC{i}_OVER (i=0..3) — This is the overide configuration register for each pad. PC{i} has high drive capability.
  [3] PC{i}_over rw — 0: output disable 1: oe - output enable
{0xC0+4i} PC{i}_OVER (i=4..7) — This is the overide configuration register for each pad.
  [3:0] PC{i}_over rw — 0x8: oe - output enable 0x4: pue - pullup enable 0x2: pde - pulldown enable 0x1: ana - analog enable
{0xE0+4i} PD{i}_OVER (i=0..7) — This is the overide configuration register for each pad.
  [3:0] PD{i}_over rw — 0x8: oe - output enable 0x4: pue - pullup enable 0x2: pde - pulldown enable 0x1: ana - analog enable
0x100 UARTRXD_UART0 — Selects one of the 32 pins on the four 8-pin I/O-ports (port A, port B, port C, and port D) to be the UART0 RX.
  [4:0] INPUT_SEL rw — 0: PA0 selected as UART0 RX 1: PA1 selected as UART0 RX ... 31: PD7 selected as UART0 RX
0x104 UARTCTS_UART1 — Selects one of the 32 pins on the four 8-pin I/O-ports (port A, port B, port C, and port D) to be the UART1 CTS.
  [4:0] INPUT_SEL rw — 0: PA0 selected as UART1 CTS 1: PA1 selected as UART1 CTS ... 31: PD7 selected as UART1 CTS
0x108 UARTRXD_UART1 — Selects one of the 32 pins on the four 8-pin I/O-ports (port A, port B, port C, and port D) to be the UART1 RX.
  [4:0] INPUT_SEL rw — 0: PA0 selected as UART1 RX 1: PA1 selected as UART1 RX ... 31: PD7 selected as UART1 RX
0x10C CLK_SSI_SSI0 — Selects one of the 32 pins on the four 8-pin I/O-ports (port A, port B, port C, and port D) to be the SSI0 CLK.
  [4:0] INPUT_SEL rw — 0: PA0 selected as SSI0 CLK 1: PA1 selected as SSI0 CLK ... 31: PD7 selected as SSI0 CLK
0x110 SSIRXD_SSI0 — Selects one of the 32 pins on the four 8-pin I/O-ports (port A, port B, port C, and port D) to be the SSI0 RX.
  [4:0] INPUT_SEL rw — 0: PA0 selected as SSI0 RX 1: PA1 selected as SSI0 RX ... 31: PD7 selected as SSI0 RX
0x114 SSIFSSIN_SSI0 — Selects one of the 32 pins on the four 8-pin I/O-ports (port A, port B, port C, and port D) to be the SSI0 FSSIN.
  [4:0] INPUT_SEL rw — 0: PA0 selected as SSI0 FSSIN 1: PA1 selected as SSI0 FSSIN ... 31: PD7 selected as SSI0 FSSIN
0x118 CLK_SSIIN_SSI0 — Selects one of the 32 pins on the four 8-pin I/O-ports (port A, port B, port C, and port D) to be the SSI0 CLK_SSIN.
  [4:0] INPUT_SEL rw — 0: PA0 selected as SSI0 CLK_SSIN 1: PA1 selected as SSI0 CLK_SSIN ... 31: PD7 selected as SSI0 CLK_SSIN
0x11C CLK_SSI_SSI1 — Selects one of the 32 pins on the four 8-pin I/O-ports (port A, port B, port C, and port D) to be the SSI1 CLK.
  [4:0] INPUT_SEL rw — 0: PA0 selected as SSI1 CLK 1: PA1 selected as SSI1 CLK ... 31: PD7 selected as SSI1 CLK
0x120 SSIRXD_SSI1 — Selects one of the 32 pins on the four 8-pin I/O-ports (port A, port B, port C, and port D) to be the SSI1 RX.
  [4:0] INPUT_SEL rw — 0: PA0 selected as SSI1 RX 1: PA1 selected as SSI1 RX ... 31: PD7 selected as SSI1 RX
0x124 SSIFSSIN_SSI1 — Selects one of the 32 pins on the four 8-pin I/O-ports (port A, port B, port C, and port D) to be the SSI1 FSSIN.
  [4:0] INPUT_SEL rw — 0: PA0 selected as SSI1 FSSIN 1: PA1 selected as SSI1 FSSIN ... 31: PD7 selected as SSI1 FSSIN
0x128 CLK_SSIIN_SSI1 — Selects one of the 32 pins on the four 8-pin I/O-ports (port A, port B, port C, and port D) to be the SSI1 CLK_SSIN.
  [4:0] INPUT_SEL rw — 0: PA0 selected as SSI1 CLK_SSIN 1: PA1 selected as SSI1 CLK_SSIN ... 31: PD7 selected as SSI1 CLK_SSIN
0x12C I2CMSSDA — Selects one of the 32 pins on the four 8-pin I/O-ports (port A, port B, port C, and port D) to be the I2C SDA.
  [4:0] INPUT_SEL rw — 0: PA0 selected as I2C SDA 1: PA1 selected as I2C SDA ... 31: PD7 selected as I2C SDA
0x130 I2CMSSCL — Selects one of the 32 pins on the four 8-pin I/O-ports (port A, port B, port C, and port D) to be the I2C SCL.
  [4:0] INPUT_SEL rw — 0: PA0 selected as I2C SCL 1: PA1 selected as I2C SCL ... 31: PD7 selected as I2C SCL
{0x134+8i} GPT{i}OCP1 (i=0..3) — Selects one of the 32 pins on the four 8-pin I/O-ports (port A, port B, port C, and port D) to be the GPT{i}OCP1.
  [4:0] INPUT_SEL rw — 0: PA0 selected as GPT{i}OCP1 1: PA1 selected as GPT{i}OCP1 ... 31: PD7 selected as GPT{i}OCP1
{0x138+8i} GPT{i}OCP2 (i=0..3) — Selects one of the 32 pins on the four 8-pin I/O-ports (port A, port B, port C, and port D) to be the GPT{i}OCP2.
  [4:0] INPUT_SEL rw — 0: PA0 selected as GPT{i}OCP2 1: PA1 selected as GPT{i}OCP2 ... 31: PD7 selected as GPT{i}OCP2
