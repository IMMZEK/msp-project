# hts_targetdb register map
Vendor: Texas Instruments
Peripheral module from a debugger description file (folder hts).
Registers are 32-bit, read-write, no defined reset value unless marked. A register's access mark holds for its fields unless they carry their own. Offsets are as the file gives them; lines under a group give offsets from that group; [hi:lo] are bit positions; {n}, {i} and the like mark numbered series; 'fields as' and 'values as' point back to an identical list; <NAME> marks a mode.

## HTS (part 1 of 2) — Hardware Thread Schedule (HTS)
{0x188+0x68*i} HWA{i}_scheduler_control access per field (i=12..19) — Scheduler Control Register
  [13:8] dma_channel_no rw — DMA channel number for thread scheduler for HWA{i}
  [7:4] state ro — Current state of HWA{i} Scheduler
  [3:1] pipeline_num rw — Pipeline Number of HWA{i} Scheduler
  [5:1] strm_en rw — '1' -> Streaming input enable, '0' No streaming input
  [6:1] pause rw — '1' -> pause/suspend scheduler , '0' -> resume scheduler
  [12:1] debug_rdy rw — '0' -> HWA{i} Scheduler resources must not be read during halted state. '1'-> HWA{i} Scheduler resources are readable during halted state
  [23:1] start_loop_back rw — '1' -> loop back start onto done in same cycle w/o asserting external channel start, '0' No loop back
  [1:0] sch_en rw — scheduler enable; write '1' to enable scheduler
{0x18C+0x68*i} HWA{i}_HOP (i=12..19) — Scheduler HOP Control Register. Help in detecting eop within scheduler. Once configured, it counts task/channel starts and stops issuing further starts. Specifically useful for Head of pipe dma scheduler .
  [13:1] hop_thread_count — Number of Task count for Head of pipe
  [1:0] hop — '1' -> Head of Pipe producer Sch , '0' -> No hop
0x678 HWA12_cons0_control access per field — Controlling consumer socket 0 for HWA12
  [9:1] prod_select rw — producer select for HWA12 cons socket 0
  [30:1] set_pend wo — writing '1' sets pend on consumer socket
  [31:1] ehwa_prod rw — '1' -> spare consumer is connected to external host producer , '0' --> no external host producer
  [1:0] cons_en rw — '1' -> Consumer socket 0 enable , '0' Disable
{0x19C+0x68*i} HWA{i}_cons1_control (i=12..19) — Controlling consumer socket 1 for HWA{i}
  [9:1] prod_select — producer select for HWA{i} cons socket 1
  [1:0] cons_en — '1' -> Consumer socket 1 enable , '0' Disable
0x680 HWA12_prod0_control access per field — Controlling producer socket0 for HWA12
  [8:1] cons_select rw — consumer select for HWA12 prod socket 0. Used in decrementing count of producer buffer
  [30:1] prod_dec wo — writing '1' decrement prod count value
  [31:1] ehwa_cons rw — '1' -> spare consumer is connected to external host consumer , '0' --> no external host consumer
  [1:0] prod_en rw — '1' -> Producer socket 0 enable , '0' Disable
{0x1A4+0x68*i} HWA{i}_prod0_buf_control (i=12..19) — Controlling producer socket0 buffer for HWA{i}
  [13:8] threshold — Count threshold to generate pend for consumer
  [21:6] count_dec — Count decrement value for prod count
  [13:0] depth — Maximum number of producer buffer count
{0x1A8+0x68*i} HWA{i}_prod0_count access per field (i=12..19) — Defining count values for pre/post load for generating pend by HWA{i} prod0
  [16:13] count ro — current count value
  [8] count_postload rw — count postload after producer max thread count reached
  [8:0] count_preload rw — count preload after scheduler start/init
{0x1AC+0x68*i} HWA{i}_pa0_control (i=12..19) — control register to manage pattern adapter on HWA{i} prod socket0
  [13:10] pa_ps_maxcount — destination count for pattern adaptation (N), M --> N
  [10:3] pa_cs_maxcount — source count for pattern adaptation (M), M --> N
  [1] pa_dec_cntl — '1' -> post pattern adaptation, decrement ps count by count_dec , '0' -> post pattern adaptation, decrement ps count by pa_cs_maxcount
  [2:1] pa_buf_cntl — '1' -> Apply threshold, count_preload and count_postload on pattern adapter count (use this only when pa_enable='1') '0' -> Apply threshold, count_preload and count_postload on prod count (same behavior as if no pattern adapter. Note when pa_enable='1' and pa_buf_cntl='0' threshold is not used and ignored)
  [1:0] pa_enable — '1' -> pa enable, '0' -> disable
{0x1B0+0x68*i} HWA{i}_pa0_prodcount access per field (i=12..19) — count values for HWA{i} prod socket0
  [10:6] pa_pscount ro — current count value of pa prod count
  [6:0] pa_count_dec rw — Decrement count value of pa_prod_count after pattern adapter prod count reaches threshold
{0x1B4+0x68*i} HWA{i}_prod1_control (i=12..19) — Controlling producer socket1 for HWA{i}
  [8:1] cons_select — consumer select for HWA{i} prod socket 1. Used in decrementing count of producer buffer
  [1:0] prod_en — '1' -> Producer socket 0 enable , '0' Disable
{0x1B8+0x68*i} HWA{i}_prod1_buf_control (i=12..19) — Controlling producer socket1 buffer for HWA{i}
  fields as HWA12_prod0_buf_control
{0x1BC+0x68*i} HWA{i}_prod1_count access per field (i=12..19) — Defining count values for pre/post load for generating pend by HWA{i} prod1
  fields as HWA12_prod0_count
{0x1C0+0x68*i} HWA{i}_pa1_control (i=12..19) — control register to manage pattern adapter on HWA{i} prod socket1
  fields as HWA12_pa0_control
{0x1C4+0x68*i} HWA{i}_pa1_prodcount access per field (i=12..19) — count values for HWA{i} prod socket1
  fields as HWA12_pa0_prodcount
{0x1C8+0x68*i} HWA{i}_prod2_control (i=12..19) — Controlling producer socket2 for HWA{i}
  [8:1] cons_select — consumer select for HWA{i} prod socket 2. Used in decrementing count of producer buffer
  [1:0] prod_en — '1' -> Producer socket 0 enable , '0' Disable
{0x1CC+0x68*i} HWA{i}_prod2_buf_control (i=12..19) — Controlling producer socket2 buffer for HWA{i}
  fields as HWA12_prod0_buf_control
{0x1D0+0x68*i} HWA{i}_prod2_count access per field (i=12..19) — Defining count values for pre/post load for generating pend by HWA{i} prod2
  fields as HWA12_prod0_count
{0x1D4+0x68*i} HWA{i}_pa2_control (i=12..19) — control register to manage pattern adapter on HWA{i} prod socket2
  fields as HWA12_pa0_control
{0x1D8+0x68*i} HWA{i}_pa2_prodcount access per field (i=12..19) — count values for HWA{i} prod socket2
  fields as HWA12_pa0_prodcount
{0x1DC+0x68*i} HWA{i}_prod3_control (i=12..19) — Controlling producer socket3 for HWA{i}
  [8:1] cons_select — consumer select for HWA{i} prod socket 3. Used in decrementing count of producer buffer
  [1:0] prod_en — '1' -> Producer socket 0 enable , '0' Disable
{0x1E0+0x68*i} HWA{i}_prod3_buf_control (i=12..19) — Controlling producer socket3 buffer for HWA{i}
  fields as HWA12_prod0_buf_control
{0x1E4+0x68*i} HWA{i}_prod3_count access per field (i=12..19) — Defining count values for pre/post load for generating pend by HWA{i} prod3
  fields as HWA12_prod0_count
0x6E0 HWA13_cons0_control access per field — Controlling consumer socket 0 for HWA13
  [9:1] prod_select rw — producer select for HWA13 cons socket 0
  [30:1] set_pend wo — writing '1' sets pend on consumer socket
  [31:1] ehwa_prod rw — '1' -> spare consumer is connected to external host producer , '0' --> no external host producer
  [1:0] cons_en rw — '1' -> Consumer socket 0 enable , '0' Disable
0x6E8 HWA13_prod0_control access per field — Controlling producer socket0 for HWA13
  [8:1] cons_select rw — consumer select for HWA13 prod socket 0. Used in decrementing count of producer buffer
  [30:1] prod_dec wo — writing '1' decrement prod count value
  [31:1] ehwa_cons rw — '1' -> spare consumer is connected to external host consumer , '0' --> no external host consumer
  [1:0] prod_en rw — '1' -> Producer socket 0 enable , '0' Disable
{0x198+0x68*i} HWA{i}_cons0_control (i=14..19) — Controlling consumer socket 0 for HWA{i}
  [9:1] prod_select — producer select for HWA{i} cons socket 0
  [1:0] cons_en — '1' -> Consumer socket 0 enable , '0' Disable
{0x1A0+0x68*i} HWA{i}_prod0_control (i=14..19) — Controlling producer socket0 for HWA{i}
  [8:1] cons_select — consumer select for HWA{i} prod socket 0. Used in decrementing count of producer buffer
  [1:0] prod_en — '1' -> Producer socket 0 enable , '0' Disable
{0x9A8+0x1C*i} DMA{i}_scheduler_control access per field (i=0..4) — Scheduler Control Register
  [13:8] dma_channel_no rw — DMA channel number for thread scheduler for DMA{i}
  [7:4] state ro — Current state of DMA{i} Scheduler
  [3:1] pipeline_num rw — Pipeline Number of DMA{i} Scheduler
  [5:1] strm_en rw — '1' -> Streaming input enable, '0' No streaming input
  [6:1] pause rw — '1' -> pause/suspend scheduler , '0' -> resume scheduler
  [12:1] debug_rdy rw — '0' -> DMA{i} Scheduler resources must not be read during halted state. '1'-> DMA{i} Scheduler resources are readable during halted state
  [1:0] sch_en rw — scheduler enable; write '1' to enable scheduler
{0x9AC+0x1C*i} DMA{i}_HOP (i=0..4) — Scheduler HOP Control Register. Help in detecting eop within scheduler. Once configured, it counts task/channel starts and stops issuing further starts. Specifically useful for Head of pipe dma scheduler .
  fields as HWA12_HOP
{0x9B8+0x1C*i} DMA{i}_prod0_control (i=0..4) — Controlling producer socket0 for DMA{i}
  [8:1] cons_select — consumer select for DMA{i} prod socket 0. Used in decrementing count of producer buffer
  [1:0] prod_en — '1' -> Producer socket 0 enable , '0' Disable
{0x9BC+0x1C*i} DMA{i}_prod0_buf_control (i=0..4) — Controlling producer socket0 buffer for DMA{i}
  fields as HWA12_prod0_buf_control
{0x9C0+0x1C*i} DMA{i}_prod0_count access per field (i=0..4) — Defining count values for pre/post load for generating pend by DMA{i} prod0
  fields as HWA12_prod0_count
{0x968+0x24*i} DMA{i}_scheduler_control access per field (i=8..10) — Scheduler Control Register
  fields as DMA0_scheduler_control
{0x96C+0x24*i} DMA{i}_HOP (i=8..10) — Scheduler HOP Control Register. Help in detecting eop within scheduler. Once configured, it counts task/channel starts and stops issuing further starts. Specifically useful for Head of pipe dma scheduler .
  fields as HWA12_HOP
{0x978+0x24*i} DMA{i}_prod0_control (i=8..10) — Controlling producer socket0 for DMA{i}
  fields as DMA0_prod0_control
{0x97C+0x24*i} DMA{i}_prod0_buf_control (i=8..10) — Controlling producer socket0 buffer for DMA{i}
  fields as HWA12_prod0_buf_control
{0x980+0x24*i} DMA{i}_prod0_count access per field (i=8..10) — Defining count values for pre/post load for generating pend by DMA{i} prod0
  fields as HWA12_prod0_count
{0x984+0x24*i} DMA{i}_pa0_control (i=8..10) — control register to manage pattern adapter on DMA{i} prod socket0
  fields as HWA12_pa0_control
{0x988+0x24*i} DMA{i}_pa0_prodcount access per field (i=8..10) — count values for HWA{i} prod socket0
  fields as HWA12_pa0_prodcount
0xD40 DMA32_scheduler_control access per field — Scheduler Control Register
  [13:8] dma_channel_no rw — DMA channel number for thread scheduler for DMA32
  [7:4] state ro — Current state of DMA32 Scheduler
  [3:1] pipeline_num rw — Pipeline Number of DMA32 Scheduler
  [5:1] strm_en rw — '1' -> Streaming input enable, '0' No streaming input
  [6:1] pause rw — '1' -> pause/suspend scheduler , '0' -> resume scheduler
  [12:1] debug_rdy rw — '0' -> DMA32 Scheduler resources must not be read during halted state. '1'-> DMA32 Scheduler resources are readable during halted state
  [1:0] sch_en rw — scheduler enable; write '1' to enable scheduler
0xD44 DMA32_HOP — Scheduler HOP Control Register. Help in detecting eop within scheduler. Once configured, it counts task/channel starts and stops issuing further starts. Specifically useful for Head of pipe dma scheduler .
  fields as HWA12_HOP
0xD50 DMA32_prod0_control — Controlling producer socket0 for DMA32
  [8:1] cons_select — consumer select for DMA32 prod socket 0. Used in decrementing count of producer buffer
  [1:0] prod_en — '1' -> Producer socket 0 enable , '0' Disable
0xD54 DMA32_prod0_buf_control — Controlling producer socket0 buffer for DMA32
  fields as HWA12_prod0_buf_control
0xD58 DMA32_prod0_count access per field — Defining count values for pre/post load for generating pend by DMA32 prod0
  fields as HWA12_prod0_count
0xE20 DMA40_scheduler_control access per field — Scheduler Control Register
  [13:8] dma_channel_no rw — DMA channel number for thread scheduler for DMA40
  [7:4] state ro — Current state of DMA40 Scheduler
  [3:1] pipeline_num rw — Pipeline Number of DMA40 Scheduler
  [5:1] strm_en rw — '1' -> Streaming input enable, '0' No streaming input
  [6:1] pause rw — '1' -> pause/suspend scheduler , '0' -> resume scheduler
  [12:1] debug_rdy rw — '0' -> DMA40 Scheduler resources must not be read during halted state. '1'-> DMA40 Scheduler resources are readable during halted state
  [1:0] sch_en rw — scheduler enable; write '1' to enable scheduler
0xE24 DMA40_HOP — Scheduler HOP Control Register. Help in detecting eop within scheduler. Once configured, it counts task/channel starts and stops issuing further starts. Specifically useful for Head of pipe dma scheduler .
  fields as HWA12_HOP
0xE30 DMA40_prod0_control — Controlling producer socket0 for DMA40
  [8:1] cons_select — consumer select for DMA40 prod socket 0. Used in decrementing count of producer buffer
  [1:0] prod_en — '1' -> Producer socket 0 enable , '0' Disable
0xE34 DMA40_prod0_buf_control — Controlling producer socket0 buffer for DMA40
  fields as HWA12_prod0_buf_control
0xE38 DMA40_prod0_count access per field — Defining count values for pre/post load for generating pend by DMA40 prod0
  fields as HWA12_prod0_count
0xF00 DMA48_scheduler_control access per field — Scheduler Control Register
  [13:8] dma_channel_no rw — DMA channel number for thread scheduler for DMA48
  [7:4] state ro — Current state of DMA48 Scheduler
  [3:1] pipeline_num rw — Pipeline Number of DMA48 Scheduler
  [5:1] strm_en rw — '1' -> Streaming input enable, '0' No streaming input
  [6:1] pause rw — '1' -> pause/suspend scheduler , '0' -> resume scheduler
  [12:1] debug_rdy rw — '0' -> DMA48 Scheduler resources must not be read during halted state. '1'-> DMA48 Scheduler resources are readable during halted state
  [1:0] sch_en rw — scheduler enable; write '1' to enable scheduler
0xF04 DMA48_HOP — Scheduler HOP Control Register. Help in detecting eop within scheduler. Once configured, it counts task/channel starts and stops issuing further starts. Specifically useful for Head of pipe dma scheduler .
  fields as HWA12_HOP
0xF10 DMA48_prod0_control — Controlling producer socket0 for DMA48
  [8:1] cons_select — consumer select for DMA48 prod socket 0. Used in decrementing count of producer buffer
  [1:0] prod_en — '1' -> Producer socket 0 enable , '0' Disable
0xF14 DMA48_prod0_buf_control — Controlling producer socket0 buffer for DMA48
  fields as HWA12_prod0_buf_control
0xF18 DMA48_prod0_count access per field — Defining count values for pre/post load for generating pend by DMA48 prod0
  fields as HWA12_prod0_count
{0x9C0+0x1C*i} DMA{i}_scheduler_control access per field (i=56..59) — Scheduler Control Register
  fields as DMA0_scheduler_control
{0x9C4+0x1C*i} DMA{i}_HOP (i=56..59) — Scheduler HOP Control Register. Help in detecting eop within scheduler. Once configured, it counts task/channel starts and stops issuing further starts. Specifically useful for Head of pipe dma scheduler .
  fields as HWA12_HOP
{0x9D0+0x1C*i} DMA{i}_prod0_control (i=56..59) — Controlling producer socket0 for DMA{i}
  fields as DMA0_prod0_control
{0x9D4+0x1C*i} DMA{i}_prod0_buf_control (i=56..59) — Controlling producer socket0 buffer for DMA{i}
  fields as HWA12_prod0_buf_control
{0x9D8+0x1C*i} DMA{i}_prod0_count access per field (i=56..59) — Defining count values for pre/post load for generating pend by DMA{i} prod0
  fields as HWA12_prod0_count
{0x9C0+0x1C*i} DMA{i}_scheduler_control access per field (i=64..67) — Scheduler Control Register
  fields as DMA0_scheduler_control
{0x9C4+0x1C*i} DMA{i}_HOP (i=64..67) — Scheduler HOP Control Register. Help in detecting eop within scheduler. Once configured, it counts task/channel starts and stops issuing further starts. Specifically useful for Head of pipe dma scheduler .
  fields as HWA12_HOP
{0x9D0+0x1C*i} DMA{i}_prod0_control (i=64..67) — Controlling producer socket0 for DMA{i}
  fields as DMA0_prod0_control
{0x9D4+0x1C*i} DMA{i}_prod0_buf_control (i=64..67) — Controlling producer socket0 buffer for DMA{i}
  fields as HWA12_prod0_buf_control
{0x9D8+0x1C*i} DMA{i}_prod0_count access per field (i=64..67) — Defining count values for pre/post load for generating pend by DMA{i} prod0
  fields as HWA12_prod0_count
{0xEF4+0x14*i} DMA{i}_scheduler_control access per field (i=240..245) — Scheduler Control Register
  fields as DMA0_scheduler_control
{0xF04+0x14*i} DMA{i}_cons0_control (i=240..245) — Controlling consumer socket 0 for DMA{i}
  [9:1] prod_select — producer select for DMA{i} cons socket 0
  [1:0] cons_en — '1' -> Consumer socket 0 enable , '0' Disable
{0xE2C+0x14*i} DMA{i}_scheduler_control access per field (i=256..261) — Scheduler Control Register
  fields as DMA0_scheduler_control
{0xE3C+0x14*i} DMA{i}_cons0_control (i=256..261) — Controlling consumer socket 0 for DMA{i}
  fields as DMA240_cons0_control
{0xD64+0x14*i} DMA{i}_scheduler_control access per field (i=272..275) — Scheduler Control Register
  fields as DMA0_scheduler_control
{0xD74+0x14*i} DMA{i}_cons0_control (i=272..275) — Controlling consumer socket 0 for DMA{i}
  fields as DMA240_cons0_control
{0xC74+0x14*i} DMA{i}_scheduler_control access per field (i=288..291) — Scheduler Control Register
  fields as DMA0_scheduler_control
{0xC84+0x14*i} DMA{i}_cons0_control (i=288..291) — Controlling consumer socket 0 for DMA{i}
  fields as DMA240_cons0_control
{0xB84+0x14*i} DMA{i}_scheduler_control access per field (i=304..313) — Scheduler Control Register
  fields as DMA0_scheduler_control
{0xB94+0x14*i} DMA{i}_cons0_control (i=304..313) — Controlling consumer socket 0 for DMA{i}
  fields as DMA240_cons0_control
0x240C DMA336_scheduler_control access per field — Scheduler Control Register
  [13:8] dma_channel_no rw — DMA channel number for thread scheduler for DMA336
  [7:4] state ro — Current state of DMA336 Scheduler
  [3:1] pipeline_num rw — Pipeline Number of DMA336 Scheduler
  [5:1] strm_en rw — '1' -> Streaming input enable, '0' No streaming input
  [6:1] pause rw — '1' -> pause/suspend scheduler , '0' -> resume scheduler
  [12:1] debug_rdy rw — '0' -> DMA336 Scheduler resources must not be read during halted state. '1'-> DMA336 Scheduler resources are readable during halted state
  [1:0] sch_en rw — scheduler enable; write '1' to enable scheduler
0x241C DMA336_cons0_control — Controlling consumer socket 0 for DMA336
  [9:1] prod_select — producer select for DMA336 cons socket 0
  [1:0] cons_en — '1' -> Consumer socket 0 enable , '0' Disable
{0x8A0+0x14*i} DMA{i}_scheduler_control access per field (i=352..355) — Scheduler Control Register
  fields as DMA0_scheduler_control
{0x8B0+0x14*i} DMA{i}_cons0_control (i=352..355) — Controlling consumer socket 0 for DMA{i}
  fields as DMA240_cons0_control
{0x7B0+0x14*i} DMA{i}_scheduler_control access per field (i=368..371) — Scheduler Control Register
  fields as DMA0_scheduler_control
{0x7C0+0x14*i} DMA{i}_cons0_control (i=368..371) — Controlling consumer socket 0 for DMA{i}
  fields as DMA240_cons0_control
0x2650 pipe_dbg_cntl access per field — Pipeline Debug Control register is used by debug software to control pipeline debug behavior
  [17:3] debug_state ro — Current state of Debug activity
  [1] pipe_dbg_dis_1 rw — '1' -> Pipeline1 doesn't respond to debug events, '0' Pipeline1 respond to debug events
  [n:1] pipe_dbg_dis_{n} rw (n=2..5) — '1' -> Pipeline{n} doesn't respond to debug events, '0' Pipeline{n} respond to debug events
  [6:1] pipe_dbg_dis_6 rw — '1' -> Pipeline6 doesn't respond to debug events, '0' Pipeline5 respond to debug events
  [16:1] abort_debug wo — '1' -> Abort Debug activity on debug enabled pipelines, '0' no impact
  [1:0] pipe_dbg_dis_0 rw — '1' -> Pipeline0 doesn't respond to debug events, '0' Pipeline0 respond to debug events
0x2654 dbg_cap ro — Debug Capability register is used by debug software to determine which optional debug modules are present and how many instances of each module exist.
  [4] REV_MAJ — Major Revision
  [8:4] NUM_BPS — The number of breakpoint modules that exist. The registers supporting the breakpoint modules must be implemented consecutively in the memory map.
  [12:4] NUM_WPS — The number of watchpoint modules that exist. The registers supporting the watchpoint modules must be implemented consecutively in the memory map
  [16:4] NUM_CNTRS — The number of counter modules that exist. The registers supporting the counter modules must be implemented consecutively in the memory map.
  [20:2] TRIG_CHNS — Number of Trigger Channels Supported. b00 ------ No channels supported. b01 ------ One channel supported. b10 ------ Two channels supported. Others ---- Reserved.
  [22:1] TRIG_INPUT — b0 - Trigger Inputs are not supported. b1 - Trigger Inputs are supported.
  [23:1] TRIG_OUTPUT — b0 - Trigger Outputs are not supported. b1 - Trigger Outputs are supported.
  [24:1] SYS_EXE_REQ — Whether HWA Core Execution status and control is supported. b0 - Not Supported. b1 - Supported.
  [25:1] DBQ_RESET_SUP — Whether HWA Core reset is supported or not which does not affect debug logic. b0 - Not Supported. b1 - Supported.
  [26:1] DBG_SWBP_SUP — Whether HWA Core supports SWBP or not. b0 - Not Supported. b1 - Supported.
  [27:1] DBG_INDIRECT_SUP — Indicates if the HWA supports an indirect memory access port. v2.0 and above. b0 - Not Supported. b1 - Indirect port supported.
  [28:1] DBG_OWN_SUP — Indicates if the HWA supports an module ownership. v2.0 and above. b0 - Not Supported. b1 - Ownership supported.
  [29:1] DBG_WP_DATA_SUP — Indicates if the WP resources has corresponding data qualification. b0 - Not supported. b1 - Data qualifiers are supported.
  [30:1] DBG_INT_STEP_SUP — Indicates that debug execution control can determine if single step blocks or allows interrupts. b0 No step/interrupt control b1 Step interrupt control via DBG_INT_STEP_IN
  [4:0] REV_MIN — Minor Revision
0x2658 dbg_cntl access per field — Debug Control register is used by debug software to control all of the basic debug functions.
  [16:4] DBG_EMU0_CNTL rw — EMU0 output control. The cross trigger output control. The value in this field determines the behavior of the outputs generated on EMU0. NOTE: The effect of setting any non-zero value is ignored if the HWA Core is currently in HALTED state until the HWA core exits and re-enters HALTED state. DBG_EMUn_CNTL Output Enable Output Pulse Description 0 De-asserted 0 NA No output. Input only 1 Stopping 0 Yes Pulse on halt. If this bit is set when halted then no effect until the HWA re-enters halted state. 2 HWBP 0 Yes Pulse when any HWBP triggers 3 HWWP 0 Yes Pulse when any HWWP triggers 4 Asserted 1 No Drive pin high 5 Asserted 0 No Drive pin low 6-15 - - Reserved
  [1] dbg_restart rw — Debug Restart Status bit.This bit is normally set when the DBG_HALT bit transitions from '1' to '0' when the natural execution state is entered.It is a sticky bit. It may also be set when a synchronous run causes the accelerator to leave halted state. Reading '1' means HWA Core exited halted state (at least temporarily). Reading '0' means HWA Core did not exit halted state. Writing '1' shall clear the bit if set. There is no restriction on when it can be cleared. Writing '0' shall have no effect.
  [2:1] dbg_single_step_en rw — Single Step Execution enable. When this bit is set, the accelerator core shall be halted upon execution of a single instruction. This is after the accelerator core has left the halted state by clearing the DBG_HALT control bit. Writing '1' enables halting when the next instruction following exit from halted state is executed. Writing '0' disables halts via single step. NOTE: 1. When the accelerator core enters its natural execution state, it may or may not execute an instruction and re-enter HALTED state.
  [5:1] DBG_EMU0_EN rw — EMU0 input trigger enable Writing '1' enables halting on the falling edge of the EMU0 input Writing '0' disables halts via EMU0 input
  [7:1] DBG_EXE_STAT ro — The execution status of the module Set to '1' when halted due to debug event Set to '0' when execution resumes
  [10:1] DBG_HALT_STEP ro — Execution halted due to single step completion Set to '1' when the single step completes Set to '0' when execution resumes
  [11:1] DBG_HALT_USER ro — Execution halted due to register update of DBG_HALT Set to '1' when halt due to DBG_HALT update completes Set to '0' when execution resumes
  [12:1] DBG_HALT_EMU0 ro — Execution halted due to trigger in on EMU0 input Set to '1' when halt due to EMU0 input completes Set to '0' when execution resumes
  [26:1] DBG_RESET_OCC rw — Sticky status bit to reflect reset has been generated
  [1:0] dbg_halt rw — Global debug run control. The bit will be read as being set upon entry to HALTED state due to halted state being entered because of SWBP, HWBP, HWWP, EMU0 / 1 trigger or manual halt requested through this control. Writing '1' when read '0' shall cause a halt on the next possible halt boundary.Writing '0' when read '1' returns the system to the natural execution state.A synchronous run hardware request has the same effect.Reading '1' means that the halted state has been reached or been requested by the manual halt mechanism.Reading '0' means that the target is in its natural execution state.NOTE: 1. The natural execution state means the FSM state entered prior to last entry into Halted state. 2. This would be the last application requested FSM state unless the DBG_SYS_EXE_REQ control was used to change it.
