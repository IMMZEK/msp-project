# hts_targetdb register map
Vendor: Texas Instruments
Registers are 32-bit, read-write, no defined reset value unless marked. A register's access mark holds for its fields unless they carry their own. Offsets are as the file gives them; [hi:lo] are bit positions; {n}, {i} and the like mark numbered series; 'fields as' and 'values as' point back to an identical list.

## HTS (part 2 of 2) — Hardware Thread Schedule (HTS)
{0x0+4i} pipeline_control_{i} (i=0..6) — Enable pipeline to activate all connected scheduler
  [1:0] pipe_en — Pipeline {i} enable, writing '1' activate pipeline , writing '0' during active pipeline is illegal and behavior is undefined, read '1' -> pipeline is active , read '0' -> pipeline is inactive
0x50 HWA0_scheduler_control access per field — Scheduler Control Register
  [7:4] state ro — Current state of HWA0 Scheduler
  [3:1] pipeline_num rw — Pipeline Number of HWA0 Scheduler
  [5:1] strm_en rw — '1' -> Streaming input enable, '0' No streaming input
  [6:1] pause rw — '1' -> pause/suspend scheduler , '0' -> resume scheduler
  [12:1] debug_rdy rw — '0' -> HWA0 Scheduler resources must not be read during halted state. '1'-> HWA0 Scheduler resources are readable during halted state
  [1:0] sch_en rw — scheduler enable; write '1' to enable scheduler
0x54 HWA0_HOP — Scheduler HOP Control Register. Help in detecting eop within scheduler. Once configured, it counts task/channel starts and stops issuing further start. Specifically useful for Head of pipe dma scheduler .
  [13:1] hop_thread_count — Number of Task count for Head of pipe
  [1:0] hop — '1' -> Head of Pipe producer Sch , '0' -> No hop
{0x58+0xB4*i} HWA{i}_WDTimer access per field (i=0..2) — Watchdog timer control register
  [17:8] wdtimer_count ro — Current value of HWA{i} Scheduler watchdog timer count
  [1] wdtimer_status ro — HWA{i} Scheduler watchdog timer status '1' -> Timer Active '0' -> Timer Inactive (count is stable)
  [2:1] wdtimer_mode rw — Watchdog timeout count '1' -> 128K , '0' -> 64K
  [1:0] wdtimer_en rw — '1' -> activate watchdog timer for 64K VPAC/DMPAC cycles between task start and task done '0' -> Disable watchdog timer
{0x5C+0xB4*i} HWA{i}_BW_limiter (i=0..2) — Scheduler BW Control Register. Processing unit level BW control. Use DMA to eliminate peak system BW within processing units line/Block
  [15:8] BW_cycle_count — Average Cycle count between successive Task Start
  [4:1] BW_token_count — Max Token count to create average BW
  [1:0] BW_limiter_en — '1' -> Enable BW limiter function for HWA{i} sch, '0' --> Disable
{0x60+4i} HWA0_cons{i}_control (i=0..5) — Controlling consumer socket {i} for HWA0
  [9:1] prod_select — producer select for HWA0 cons socket {i}
  [1:0] cons_en — '1' -> Consumer socket {i} enable , '0' Disable
{0x78+0x14*i} HWA0_prod{i}_control (i=0..5) — Controlling producer socket{i} for HWA0
  [8:1] cons_select — consumer select for HWA0 prod socket {i}. Used in decrementing count of producer buffer
  [1:0] prod_en — '1' -> Producer socket 0 enable , '0' Disable
{0x7C+0x14*i} HWA0_prod{i}_buf_control (i=0..6) — Controlling producer socket{i} buffer for HWA0
  [13:8] threshold — Count threshold to generate pend for consumer
  [21:6] count_dec — Count decrement value for prod count
  [13:0] depth — Maximum number of producer buffer count
{0x80+0x14*i} HWA0_prod{i}_count access per field (i=0..6) — Defining count values for pre/post load for generating pend by HWA0 prod{i}
  [16:13] count ro — current count value
  [8] count_postload rw — count postload after producer max thread count reached
  [8:0] count_preload rw — count preload after scheduler start/init
0x84 HWA0_pa0_control — control register to manage pattern adapter on HWA0 prod socket0
  [13:10] pa_ps_maxcount — destination count for pattern adaptation (N), M --> N
  [10:3] pa_cs_maxcount — source count for pattern adaptation (M), M --> N
  [1] pa_dec_cntl — '1' -> post pattern adaptation, decrement ps count by count_dec , '0' -> post pattern adaptation, decrement ps count by pa_cs_maxcount
  [2:1] pa_buf_cntl — '1' -> Apply threshold, count_preload and count_postload on pattern adapter count (use this only when pa_enable='1') '0' -> Apply threshold, count_preload and count_postload on prod count (same behavior as if no pattern adapter. Note when pa_enable='1' and pa_buf_cntl='0' threshold is not used and ignored)
  [1:0] pa_enable — '1' -> pa enable, '0' -> disable
0x88 HWA0_pa0_prodcount access per field — count values for HWA0 prod socket0
  [10:6] pa_pscount ro — current count value of pa prod count
  [6:0] pa_count_dec rw — Decrement count value of pa_prod_count after pattern adapter prod count reaches threshold
0x98 HWA0_pa1_control — control register to manage pattern adapter on HWA0 prod socket1
  fields as HWA0_pa0_control
0x9C HWA0_pa1_prodcount access per field — count values for HWA0 prod socket1
  fields as HWA0_pa0_prodcount
0xF0 HWA0_prod6_control — Controlling producer socket6 for HWA0
  [24:3] mask_select — define which tdone_mask apply to prod socket 6. tdone_mask[mask_select] applies to prod_socket6
  [8:1] cons_select — consumer select for HWA0 prod socket 6. Used in decrementing count of producer buffer
  [1:0] prod_en — '1' -> Producer socket 0 enable , '0' Disable
0x104 HWA1_scheduler_control access per field — Scheduler Control Register
  [7:4] state ro — Current state of HWA1 Scheduler
  [3:1] pipeline_num rw — Pipeline Number of HWA1 Scheduler
  [5:1] strm_en rw — '1' -> Streaming input enable, '0' No streaming input
  [6:1] pause rw — '1' -> pause/suspend scheduler , '0' -> resume scheduler
  [12:1] debug_rdy rw — '0' -> HWA1 Scheduler resources must not be read during halted state. '1'-> HWA1 Scheduler resources are readable during halted state
  [1:0] sch_en rw — scheduler enable; write '1' to enable scheduler
0x108 HWA1_HOP — Scheduler HOP Control Register. Help in detecting eop within scheduler. Once configured, it counts task/channel starts and stops issuing further start. Specifically useful for Head of pipe dma scheduler .
  fields as HWA0_HOP
{0x114+4i} HWA1_cons{i}_control (i=0..5) — Controlling consumer socket {i} for HWA1
  [9:1] prod_select — producer select for HWA1 cons socket {i}
  [1:0] cons_en — '1' -> Consumer socket {i} enable , '0' Disable
{0x12C+0x14*i} HWA1_prod{i}_control (i=0..5) — Controlling producer socket{i} for HWA1
  [8:1] cons_select — consumer select for HWA1 prod socket {i}. Used in decrementing count of producer buffer
  [1:0] prod_en — '1' -> Producer socket 0 enable , '0' Disable
{0x130+0x14*i} HWA1_prod{i}_buf_control (i=0..6) — Controlling producer socket{i} buffer for HWA1
  fields as HWA0_prod0_buf_control
{0x134+0x14*i} HWA1_prod{i}_count access per field (i=0..6) — Defining count values for pre/post load for generating pend by HWA1 prod{i}
  fields as HWA0_prod0_count
0x138 HWA1_pa0_control — control register to manage pattern adapter on HWA1 prod socket0
  fields as HWA0_pa0_control
0x13C HWA1_pa0_prodcount access per field — count values for HWA1 prod socket0
  fields as HWA0_pa0_prodcount
0x14C HWA1_pa1_control — control register to manage pattern adapter on HWA1 prod socket1
  fields as HWA0_pa0_control
0x150 HWA1_pa1_prodcount access per field — count values for HWA1 prod socket1
  fields as HWA0_pa0_prodcount
0x1A4 HWA1_prod6_control — Controlling producer socket6 for HWA1
  [24:3] mask_select — define which tdone_mask apply to prod socket 6. tdone_mask[mask_select] applies to prod_socket6
  [8:1] cons_select — consumer select for HWA1 prod socket 6. Used in decrementing count of producer buffer
  [1:0] prod_en — '1' -> Producer socket 0 enable , '0' Disable
0x1B8 HWA2_scheduler_control access per field — Scheduler Control Register
  [7:4] state ro — Current state of HWA2 Scheduler
  [3:1] pipeline_num rw — Pipeline Number of HWA2 Scheduler
  [5:1] strm_en rw — '1' -> Streaming input enable, '0' No streaming input
  [6:1] pause rw — '1' -> pause/suspend scheduler , '0' -> resume scheduler
  [12:1] debug_rdy rw — '0' -> HWA2 Scheduler resources must not be read during halted state. '1'-> HWA2 Scheduler resources are readable during halted state
  [22:1] eor_en rw — '1' -> LDC REGION/sub-frame feature enabled, '0' LDC works in Frame mode only
  [1:0] sch_en rw — scheduler enable; write '1' to enable scheduler
{0x44+0xBC*i} HWA{i}_HOP (i=2..4) — Scheduler HOP Control Register. Help in detecting eop within scheduler. Once configured, it counts task/channel starts and stops issuing further starts. Specifically useful for Head of pipe dma scheduler .
  fields as HWA0_HOP
{0x1C8+4i} HWA2_cons{i}_control (i=0..2) — Controlling consumer socket {i} for HWA2
  [9:1] prod_select — producer select for HWA2 cons socket {i}
  [1:0] cons_en — '1' -> Consumer socket {i} enable , '0' Disable
{0x1D4+0x14*i} HWA2_prod{i}_control (i=0..3) — Controlling producer socket{i} for HWA2
  [18:4] partial_bpr_count — Remaining block count to complete configured BPR at End of Row or End of Region Row when LDC is configured in tdone_gen_mode='0'
  [22:2] partial_bpr_trigmode — 0: Normal behavior; 1 : Prod Socket {i} is used to trigger DMA channel to transfer end of Row or End of Region Row buffer data for prod socket ({i}+2)%4. Useful when this Buffer is not completely filled at end of row and it enables triggering separate DMA channel for end of row. Rely on tdone_bpr_early attribute; 2: Prod Socket {i} is used to trigger DMA channel to transfer end of Row or End of Region Row buffer data for prod socket ({i}+2)%4. Useful when this Buffer is not completely filled at end of row and it enables triggering separate DMA channel for end of row. Rely on end of Row attribute. Must not be used in dual output mode
  [8:1] cons_select — consumer select for HWA2 prod socket {i}. Used in decrementing count of producer buffer
  [1:0] prod_en — '1' -> Producer socket 0 enable , '0' Disable
{0x1D8+0x14*i} HWA2_prod{i}_buf_control (i=0..7) — Controlling producer socket{i} buffer for HWA2
  fields as HWA0_prod0_buf_control
{0x1DC+0x14*i} HWA2_prod{i}_count access per field (i=0..7) — Defining count values for pre/post load for generating pend by HWA2 prod{i}
  fields as HWA0_prod0_count
{0x1E0+0x14*i} HWA2_pa{i}_control (i=0..6) — control register to manage pattern adapter on HWA2 prod socket{i}
  fields as HWA0_pa0_control
{0x1E4+0x14*i} HWA2_pa{i}_prodcount access per field (i=0..6) — count values for HWA2 prod socket{i}
  fields as HWA0_pa0_prodcount
{0x1D4+0x14*i} HWA2_prod{i}_control (i=4..7) — Controlling producer socket{i} for HWA2
  [24:2] mask_select — define which tdone_mask apply to prod socket {i}. tdone_mask[mask_select] applies to prod_socket{i}.
  [8:1] cons_select — consumer select for HWA2 prod socket {i}. Used in decrementing count of producer buffer
  [1:0] prod_en — '1' -> Producer socket 0 enable , '0' Disable
0x274 HWA3_scheduler_control access per field — Scheduler Control Register
  [7:4] state ro — Current state of HWA3 Scheduler
  [3:1] pipeline_num rw — Pipeline Number of HWA3 Scheduler
  [5:1] strm_en rw — '1' -> Streaming input enable, '0' No streaming input
  [6:1] pause rw — '1' -> pause/suspend scheduler , '0' -> resume scheduler
  [12:1] debug_rdy rw — '0' -> HWA3 Scheduler resources must not be read during halted state. '1'-> HWA3 Scheduler resources are readable during halted state
  [22:1] eor_en rw — '1' -> LDC REGION/sub-frame feature enabled, '0' LDC works in Frame mode only
  [1:0] sch_en rw — scheduler enable; write '1' to enable scheduler
0x27C HWA3_WDTimer access per field — Watchdog timer control register
  [17:8] wdtimer_count ro — Current value of HWA3 Scheduler watchdog timer count
  [1] wdtimer_status ro — HWA3 Scheduler watchdog timer status '1' -> Timer Active '0' -> Timer Inactive (count is stable)
  [2:1] wdtimer_mode rw — Watchdog timeout count '1' -> 128K , '0' -> 64K
  [1:0] wdtimer_en rw — '1' -> activate watchdog timer for 64K VPAC/DMPAC cycles between task start and task done '0' -> Disable watchdog timer
0x280 HWA3_BW_limiter — Scheduler BW Control Register. Processing unit level BW control. Use DMA to eliminate peak system BW within processing units line/Block
  [15:8] BW_cycle_count — Average Cycle count between successive Task Start
  [4:1] BW_token_count — Max Token count to create average BW
  [1:0] BW_limiter_en — '1' -> Enable BW limiter function for HWA3 sch, '0' --> Disable
{0x284+4i} HWA3_cons{i}_control (i=0..2) — Controlling consumer socket {i} for HWA3
  [9:1] prod_select — producer select for HWA3 cons socket {i}
  [1:0] cons_en — '1' -> Consumer socket {i} enable , '0' Disable
{0x290+0x14*i} HWA3_prod{i}_control (i=0..3) — Controlling producer socket{i} for HWA3
  [18:4] partial_bpr_count — Remaining block count to complete configured BPR at End of Row or End of Region Row when LDC is configured in tdone_gen_mode='0'
  [22:2] partial_bpr_trigmode — 0: Normal behavior; 1 : Prod Socket {i} is used to trigger DMA channel to transfer end of Row or End of Region Row buffer data for prod socket ({i}+2)%4. Useful when this Buffer is not completely filled at end of row and it enables triggering separate DMA channel for end of row. Rely on tdone_bpr_early attribute; 2: Prod Socket {i} is used to trigger DMA channel to transfer end of Row or End of Region Row buffer data for prod socket ({i}+2)%4. Useful when this Buffer is not completely filled at end of row and it enables triggering separate DMA channel for end of row. Rely on end of Row attribute. Must not be used in dual output mode
  [8:1] cons_select — consumer select for HWA3 prod socket {i}. Used in decrementing count of producer buffer
  [1:0] prod_en — '1' -> Producer socket 0 enable , '0' Disable
{0x294+0x14*i} HWA3_prod{i}_buf_control (i=0..7) — Controlling producer socket{i} buffer for HWA3
  fields as HWA0_prod0_buf_control
{0x298+0x14*i} HWA3_prod{i}_count access per field (i=0..7) — Defining count values for pre/post load for generating pend by HWA3 prod{i}
  fields as HWA0_prod0_count
{0x29C+0x14*i} HWA3_pa{i}_control (i=0..6) — control register to manage pattern adapter on HWA3 prod socket{i}
  fields as HWA0_pa0_control
{0x2A0+0x14*i} HWA3_pa{i}_prodcount access per field (i=0..6) — count values for HWA3 prod socket{i}
  fields as HWA0_pa0_prodcount
{0x290+0x14*i} HWA3_prod{i}_control (i=4..7) — Controlling producer socket{i} for HWA3
  [24:2] mask_select — define which tdone_mask apply to prod socket {i}. tdone_mask[mask_select] applies to prod_socket{i}.
  [8:1] cons_select — consumer select for HWA3 prod socket {i}. Used in decrementing count of producer buffer
  [1:0] prod_en — '1' -> Producer socket 0 enable , '0' Disable
0x330 HWA4_scheduler_control access per field — Scheduler Control Register
  [7:4] state ro — Current state of HWA4 Scheduler
  [3:1] pipeline_num rw — Pipeline Number of HWA4 Scheduler
  [5:1] strm_en rw — '1' -> Streaming input enable, '0' No streaming input
  [6:1] pause rw — '1' -> pause/suspend scheduler , '0' -> resume scheduler
  [12:1] debug_rdy rw — '0' -> HWA4 Scheduler resources must not be read during halted state. '1'-> HWA4 Scheduler resources are readable during halted state
  [1:0] sch_en rw — scheduler enable; write '1' to enable scheduler
0x338 HWA4_WDTimer access per field — Watchdog timer control register
  [17:8] wdtimer_count ro — Current value of HWA4 Scheduler watchdog timer count
  [1] wdtimer_status ro — HWA4 Scheduler watchdog timer status '1' -> Timer Active '0' -> Timer Inactive (count is stable)
  [2:1] wdtimer_mode rw — Watchdog timeout count '1' -> 128K , '0' -> 64K
  [1:0] wdtimer_en rw — '1' -> activate watchdog timer for 64K VPAC/DMPAC cycles between task start and task done '0' -> Disable watchdog timer
0x33C HWA4_BW_limiter — Scheduler BW Control Register. Processing unit level BW control. Use DMA to eliminate peak system BW within processing units line/Block
  [15:8] BW_cycle_count — Average Cycle count between successive Task Start
  [4:1] BW_token_count — Max Token count to create average BW
  [1:0] BW_limiter_en — '1' -> Enable BW limiter function for HWA4 sch, '0' --> Disable
0x340 HWA4_cons0_control — Controlling consumer socket 0 for HWA4
  [9:1] prod_select — producer select for HWA4 cons socket 0
  [1:0] cons_en — '1' -> Consumer socket 0 enable , '0' Disable
0x344 HWA4_cons1_control — Controlling consumer socket 1 for HWA4
  [9:1] prod_select — producer select for HWA4 cons socket 1
  [1:0] cons_en — '1' -> Consumer socket 1 enable , '0' Disable
{0x348+0x14*i} HWA4_prod{i}_control (i=0..9) — Controlling producer socket{i} for HWA4
  [8:1] cons_select — consumer select for HWA4 prod socket {i}. Used in decrementing count of producer buffer
  [1:0] prod_en — '1' -> Producer socket 0 enable , '0' Disable
{0x34C+0x14*i} HWA4_prod{i}_buf_control (i=0..10) — Controlling producer socket{i} buffer for HWA4
  fields as HWA0_prod0_buf_control
{0x350+0x14*i} HWA4_prod{i}_count access per field (i=0..10) — Defining count values for pre/post load for generating pend by HWA4 prod{i}
  fields as HWA0_prod0_count
0x410 HWA4_prod10_control — Controlling producer socket10 for HWA4
  [24:4] mask_select — define which tdone_mask apply to prod socket 10. tdone_mask[mask_select] applies to prod_socket10
  [8:1] cons_select — consumer select for HWA4 prod socket 10. Used in decrementing count of producer buffer
  [1:0] prod_en — '1' -> Producer socket 0 enable , '0' Disable
0x424 HWA5_scheduler_control access per field — Scheduler Control Register
  [7:4] state ro — Current state of HWA5 Scheduler
  [3:1] pipeline_num rw — Pipeline Number of HWA5 Scheduler
  [5:1] strm_en rw — '1' -> Streaming input enable, '0' No streaming input
  [6:1] pause rw — '1' -> pause/suspend scheduler , '0' -> resume scheduler
  [12:1] debug_rdy rw — '0' -> HWA5 Scheduler resources must not be read during halted state. '1'-> HWA5 Scheduler resources are readable during halted state
  [1:0] sch_en rw — scheduler enable; write '1' to enable scheduler
0x428 HWA5_HOP — Scheduler HOP Control Register. Help in detecting eop within scheduler. Once configured, it counts task/channel starts and stops issuing further starts. Specifically useful for Head of pipe dma scheduler .
  fields as HWA0_HOP
0x42C HWA5_WDTimer access per field — Watchdog timer control register
  [17:8] wdtimer_count ro — Current value of HWA5 Scheduler watchdog timer count
  [1] wdtimer_status ro — HWA5 Scheduler watchdog timer status '1' -> Timer Active '0' -> Timer Inactive (count is stable)
  [2:1] wdtimer_mode rw — Watchdog timeout count '1' -> 128K , '0' -> 64K
  [1:0] wdtimer_en rw — '1' -> activate watchdog timer for 64K VPAC/DMPAC cycles between task start and task done '0' -> Disable watchdog timer
0x430 HWA5_BW_limiter — Scheduler BW Control Register. Processing unit level BW control. Use DMA to eliminate peak system BW within processing units line/Block
  [15:8] BW_cycle_count — Average Cycle count between successive Task Start
  [4:1] BW_token_count — Max Token count to create average BW
  [1:0] BW_limiter_en — '1' -> Enable BW limiter function for HWA5 sch, '0' --> Disable
0x434 HWA5_cons0_control — Controlling consumer socket 0 for HWA5
  [9:1] prod_select — producer select for HWA5 cons socket 0
  [1:0] cons_en — '1' -> Consumer socket 0 enable , '0' Disable
0x438 HWA5_cons1_control — Controlling consumer socket 1 for HWA5
  [9:1] prod_select — producer select for HWA5 cons socket 1
  [1:0] cons_en — '1' -> Consumer socket 1 enable , '0' Disable
{0x43C+0x14*i} HWA5_prod{i}_control (i=0..9) — Controlling producer socket{i} for HWA5
  [8:1] cons_select — consumer select for HWA5 prod socket {i}. Used in decrementing count of producer buffer
  [1:0] prod_en — '1' -> Producer socket 0 enable , '0' Disable
{0x440+0x14*i} HWA5_prod{i}_buf_control (i=0..10) — Controlling producer socket{i} buffer for HWA5
  fields as HWA0_prod0_buf_control
{0x444+0x14*i} HWA5_prod{i}_count access per field (i=0..10) — Defining count values for pre/post load for generating pend by HWA5 prod{i}
  fields as HWA0_prod0_count
0x504 HWA5_prod10_control — Controlling producer socket10 for HWA5
  [24:4] mask_select — define which tdone_mask apply to prod socket 10. tdone_mask[mask_select] applies to prod_socket10
  [8:1] cons_select — consumer select for HWA5 prod socket 10. Used in decrementing count of producer buffer
  [1:0] prod_en — '1' -> Producer socket 0 enable , '0' Disable
0x518 HWA6_scheduler_control access per field — Scheduler Control Register
  [7:4] state ro — Current state of HWA6 Scheduler
  [3:1] pipeline_num rw — Pipeline Number of HWA6 Scheduler
  [5:1] strm_en rw — '1' -> Streaming input enable, '0' No streaming input
  [6:1] pause rw — '1' -> pause/suspend scheduler , '0' -> resume scheduler
  [12:1] debug_rdy rw — '0' -> HWA6 Scheduler resources must not be read during halted state. '1'-> HWA6 Scheduler resources are readable during halted state
  [1:0] sch_en rw — scheduler enable; write '1' to enable scheduler
0x51C HWA6_HOP — Scheduler HOP Control Register. Help in detecting eop within scheduler. Once configured, it counts task/channel starts and stops issuing further starts. Specifically useful for Head of pipe dma scheduler .
  fields as HWA0_HOP
0x520 HWA6_WDTimer access per field — Watchdog timer control register
  [17:8] wdtimer_count ro — Current value of HWA6 Scheduler watchdog timer count
  [1] wdtimer_status ro — HWA6 Scheduler watchdog timer status '1' -> Timer Active '0' -> Timer Inactive (count is stable)
  [2:1] wdtimer_mode rw — Watchdog timeout count '1' -> 128K , '0' -> 64K
  [1:0] wdtimer_en rw — '1' -> activate watchdog timer for 64K VPAC/DMPAC cycles between task start and task done '0' -> Disable watchdog timer
0x524 HWA6_BW_limiter — Scheduler BW Control Register. Processing unit level BW control. Use DMA to eliminate peak system BW within processing units line/Block
  [15:8] BW_cycle_count — Average Cycle count between successive Task Start
  [4:1] BW_token_count — Max Token count to create average BW
  [1:0] BW_limiter_en — '1' -> Enable BW limiter function for HWA6 sch, '0' --> Disable
0x528 HWA6_cons0_control — Controlling consumer socket 0 for HWA6
  [9:1] prod_select — producer select for HWA6 cons socket 0
  [1:0] cons_en — '1' -> Consumer socket 0 enable , '0' Disable
0x52C HWA6_cons1_control — Controlling consumer socket 1 for HWA6
  [9:1] prod_select — producer select for HWA6 cons socket 1
  [1:0] cons_en — '1' -> Consumer socket 1 enable , '0' Disable
0x530 HWA6_prod0_control — Controlling producer socket0 for HWA6
  [8:1] cons_select — consumer select for HWA6 prod socket 0. Used in decrementing count of producer buffer
  [1:0] prod_en — '1' -> Producer socket 0 enable , '0' Disable
0x534 HWA6_prod0_buf_control — Controlling producer socket0 buffer for HWA6
  fields as HWA0_prod0_buf_control
0x538 HWA6_prod0_count access per field — Defining count values for pre/post load for generating pend by HWA6 prod0
  fields as HWA0_prod0_count
0x544 HWA6_prod1_control — Controlling producer socket1 for HWA6
  [8:1] cons_select — consumer select for HWA6 prod socket 1. Used in decrementing count of producer buffer
  [1:0] prod_en — '1' -> Producer socket 0 enable , '0' Disable
0x548 HWA6_prod1_buf_control — Controlling producer socket1 buffer for HWA6
  fields as HWA0_prod0_buf_control
0x54C HWA6_prod1_count access per field — Defining count values for pre/post load for generating pend by HWA6 prod1
  fields as HWA0_prod0_count
0x558 HWA7_scheduler_control access per field — Scheduler Control Register
  [7:4] state ro — Current state of HWA7 Scheduler
  [3:1] pipeline_num rw — Pipeline Number of HWA7 Scheduler
  [5:1] strm_en rw — '1' -> Streaming input enable, '0' No streaming input
  [6:1] pause rw — '1' -> pause/suspend scheduler , '0' -> resume scheduler
  [12:1] debug_rdy rw — '0' -> HWA7 Scheduler resources must not be read during halted state. '1'-> HWA7 Scheduler resources are readable during halted state
  [1:0] sch_en rw — scheduler enable; write '1' to enable scheduler
0x55C HWA7_HOP — Scheduler HOP Control Register. Help in detecting eop within scheduler. Once configured, it counts task/channel starts and stops issuing further start. Specifically useful for Head of pipe dma scheduler .
  fields as HWA0_HOP
0x560 HWA7_WDTimer access per field — Watchdog timer control register
  [17:8] wdtimer_count ro — Current value of HWA7 Scheduler watchdog timer count
  [1] wdtimer_status ro — HWA7 Scheduler watchdog timer status '1' -> Timer Active '0' -> Timer Inactive (count is stable)
  [2:1] wdtimer_mode rw — Watchdog timeout count '1' -> 128K , '0' -> 64K
  [1:0] wdtimer_en rw — '1' -> activate watchdog timer for 64K VPAC/DMPAC cycles between task start and task done '0' -> Disable watchdog timer
0x564 HWA7_BW_limiter — Scheduler BW Control Register. Processing unit level BW control. Use DMA to eliminate peak system BW within processing units line/Block
  [15:8] BW_cycle_count — Average Cycle count between successive Task Start
  [4:1] BW_token_count — Max Token count to create average BW
  [1:0] BW_limiter_en — '1' -> Enable BW limiter function for HWA7 sch, '0' --> Disable
{0x568+4i} HWA7_cons{i}_control (i=0..4) — Controlling consumer socket {i} for HWA7
  [9:1] prod_select — producer select for HWA7 cons socket {i}
  [1:0] cons_en — '1' -> Consumer socket {i} enable , '0' Disable
{0x57C+0x14*i} HWA7_prod{i}_control (i=0..3) — Controlling producer socket{i} for HWA7
  [8:1] cons_select — consumer select for HWA7 prod socket {i}. Used in decrementing count of producer buffer
  [1:0] prod_en — '1' -> Producer socket 0 enable , '0' Disable
{0x580+0x14*i} HWA7_prod{i}_buf_control (i=0..4) — Controlling producer socket{i} buffer for HWA7
  fields as HWA0_prod0_buf_control
{0x584+0x14*i} HWA7_prod{i}_count access per field (i=0..4) — Defining count values for pre/post load for generating pend by HWA7 prod{i}
  fields as HWA0_prod0_count
{0x588+0x14*i} HWA7_pa{i}_control (i=0..3) — control register to manage pattern adapter on HWA7 prod socket{i}
  fields as HWA0_pa0_control
{0x58C+0x14*i} HWA7_pa{i}_prodcount access per field (i=0..3) — count values for HWA7 prod socket{i}
  fields as HWA0_pa0_prodcount
0x5CC HWA7_prod4_control — Controlling producer socket4 for HWA7
  [24:2] mask_select — define which tdone_mask apply to prod socket 4. tdone_mask[mask_select] applies to prod_socket4
  [8:1] cons_select — consumer select for HWA7 prod socket 4. Used in decrementing count of producer buffer
  [1:0] prod_en — '1' -> Producer socket 0 enable , '0' Disable
0x5E0 HWA8_scheduler_control access per field — Scheduler Control Register
  [7:4] state ro — Current state of HWA8 Scheduler
  [3:1] pipeline_num rw — Pipeline Number of HWA8 Scheduler
  [5:1] strm_en rw — '1' -> Streaming input enable, '0' No streaming input
  [6:1] pause rw — '1' -> pause/suspend scheduler , '0' -> resume scheduler
  [12:1] debug_rdy rw — '0' -> HWA8 Scheduler resources must not be read during halted state. '1'-> HWA8 Scheduler resources are readable during halted state
  [1:0] sch_en rw — scheduler enable; write '1' to enable scheduler
0x5E4 HWA8_HOP — Scheduler HOP Control Register. Help in detecting eop within scheduler. Once configured, it counts task/channel starts and stops issuing further start. Specifically useful for Head of pipe dma scheduler .
  fields as HWA0_HOP
0x5E8 HWA8_WDTimer access per field — Watchdog timer control register
  [17:8] wdtimer_count ro — Current value of HWA8 Scheduler watchdog timer count
  [1] wdtimer_status ro — HWA8 Scheduler watchdog timer status '1' -> Timer Active '0' -> Timer Inactive (count is stable)
  [2:1] wdtimer_mode rw — Watchdog timeout count '1' -> 128K , '0' -> 64K
  [1:0] wdtimer_en rw — '1' -> activate watchdog timer for 64K VPAC/DMPAC cycles between task start and task done '0' -> Disable watchdog timer
0x5EC HWA8_BW_limiter — Scheduler BW Control Register. Processing unit level BW control. Use DMA to eliminate peak system BW within processing units line/Block
  [15:8] BW_cycle_count — Average Cycle count between successive Task Start
  [4:1] BW_token_count — Max Token count to create average BW
  [1:0] BW_limiter_en — '1' -> Enable BW limiter function for HWA8 sch, '0' --> Disable
{0x5F0+4i} HWA8_cons{i}_control (i=0..4) — Controlling consumer socket {i} for HWA8
  [9:1] prod_select — producer select for HWA8 cons socket {i}
  [1:0] cons_en — '1' -> Consumer socket {i} enable , '0' Disable
{0x604+0x14*i} HWA8_prod{i}_control (i=0..3) — Controlling producer socket{i} for HWA8
  [8:1] cons_select — consumer select for HWA8 prod socket {i}. Used in decrementing count of producer buffer
  [1:0] prod_en — '1' -> Producer socket 0 enable , '0' Disable
{0x608+0x14*i} HWA8_prod{i}_buf_control (i=0..4) — Controlling producer socket{i} buffer for HWA8
  fields as HWA0_prod0_buf_control
{0x60C+0x14*i} HWA8_prod{i}_count access per field (i=0..4) — Defining count values for pre/post load for generating pend by HWA8 prod{i}
  fields as HWA0_prod0_count
{0x610+0x14*i} HWA8_pa{i}_control (i=0..3) — control register to manage pattern adapter on HWA8 prod socket{i}
  fields as HWA0_pa0_control
{0x614+0x14*i} HWA8_pa{i}_prodcount access per field (i=0..3) — count values for HWA8 prod socket{i}
  fields as HWA0_pa0_prodcount
0x654 HWA8_prod4_control — Controlling producer socket4 for HWA8
  [24:2] mask_select — define which tdone_mask apply to prod socket 4. tdone_mask[mask_select] applies to prod_socket4
  [8:1] cons_select — consumer select for HWA8 prod socket 4. Used in decrementing count of producer buffer
  [1:0] prod_en — '1' -> Producer socket 0 enable , '0' Disable
