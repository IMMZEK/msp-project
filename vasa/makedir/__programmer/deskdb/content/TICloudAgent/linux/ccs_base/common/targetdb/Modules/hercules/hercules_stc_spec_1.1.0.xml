# hercules_stc_spec_1.1.0 register map
Vendor: Texas Instruments
Peripheral module from a debugger description file (folder hercules).
Registers are 32-bit, access not given, no defined reset value unless marked. A register's access mark holds for its fields unless they carry their own. Offsets are as the file gives them; lines under a group give offsets from that group; [hi:lo] are bit positions; {n}, {i} and the like mark numbered series; 'fields as' and 'values as' point back to an identical list; <NAME> marks a mode.

## Stc — Self Test Controller
0x00 GlbCtrl0 — Global Control Register 0
0x04 GlbCtrl1 — Global Control Register 1
0x08 Tpr — Run TimeOut Counter Preload Register
0x0C CAddr — Current ROM Address Register
0x10 CICnt — Current Interval Count Register
0x14 GStat — SelfTest Global Status Register
0x18 FStat — Fail Status Register
0x2C CpuCurMisr0 — Cpu Current Misr Register
0x30 CpuCurMisr1 — Cpu Current Misr Register
0x44 CpuCurMisr2 — Cpu Current Misr Register
0x48 CpuCurMisr3 — Cpu Current Misr Register

## Notices in the file
(c) Texas Instruments 2003-2012, All rights reserved.
