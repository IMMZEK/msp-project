# 28M36x_GpioG1Trip_Registers register map
Vendor: Texas Instruments
Peripheral module from a debugger description file (folder C2000).
Address unit: 16 bits
Registers are 16-bit, access not given, no defined reset value unless marked. A register's access mark holds for its fields unless they carry their own. Offsets are as the file gives them; lines under a group give offsets from that group; [hi:lo] are bit positions; {n}, {i} and the like mark numbered series; 'fields as' and 'values as' point back to an identical list; <NAME> marks a mode.

## GPIOG1_TRIP_REGS — GPIOG1 TRIP REGS Registers
0x00 GPTRIP1SEL — GPTRIP1 (TZ1n) Input Select Register (GPIO0 to 63)
0x01 GPTRIP2SEL — GPTRIP2 (TZ2n) Input Select Register (GPIO0 to 63)
0x02 GPTRIP3SEL — GPTRIP3 (TZ3n) Input Select Register (GPIO0 to 63)
0x03 GPTRIP4SEL — GPTRIP4 (XINT1) Input Select Register (GPIO0 to 63)
0x04 GPTRIP5SEL — GPTRIP5 (XINT2) Input Select Register (GPIO0 to 63)
0x05 GPTRIP6SEL — GPTRIP6 (XINT3 and SYNCIN) Input Select Register (GPIO0 to 63)
0x06 GPTRIP7SEL — GPTRIP7 (ECAP1) Input Select Register (GPIO0 to 63)
0x07 GPTRIP8SEL — GPTRIP8 (ECAP2) Input Select Register (GPIO0 to 63)
0x08 GPIOLPMSEL1 32-bit — C28 LPM GPIO Select 1 Register (GPIO0 to 31)
0x0A GPIOLPMSEL2 32-bit — C28 LPM GPIO Select 2 Register (GPIO32 to 63)
{0x7+i} GPTRIP{i}SEL (i=9..12) — GPTRIP{i} (ECAP{i-6}) Input Select Register (GPIO0 to 63)
