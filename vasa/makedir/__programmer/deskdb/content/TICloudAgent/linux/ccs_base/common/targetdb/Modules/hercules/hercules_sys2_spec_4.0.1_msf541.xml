# hercules_sys2_spec_4.0.1_msf541 register map
Vendor: Texas Instruments
Peripheral module from a debugger description file (folder hercules).
Registers are 32-bit, access not given, no defined reset value unless marked. A register's access mark holds for its fields unless they carry their own. Offsets are as the file gives them; lines under a group give offsets from that group; [hi:lo] are bit positions; {n}, {i} and the like mark numbered series; 'fields as' and 'values as' point back to an identical list; <NAME> marks a mode.

## R4_SYS2 — R4 System Registers Second Frame
0x08 STCCLKDIV — CPU Logic BIST Clock Divider

## Notices in the file
(c) Texas Instruments 2003-2012, All rights reserved.
