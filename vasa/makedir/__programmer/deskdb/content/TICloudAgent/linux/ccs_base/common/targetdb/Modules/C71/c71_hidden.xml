# c71_hidden register map
Vendor: Texas Instruments
Peripheral module from a debugger description file (folder C71).
Registers are 64-bit, access not given, no defined reset value unless marked. A register's access mark holds for its fields unless they carry their own. Offsets are as the file gives them; lines under a group give offsets from that group; [hi:lo] are bit positions; {n}, {i} and the like mark numbered series; 'fields as' and 'values as' point back to an identical list; <NAME> marks a mode.

## Hidden
{0x40000+i} VB0[{i}] (i=0..7) — Global vector register 0
{0x40100+i} VB1[{i}] (i=0..7) — Global vector register 1
{0x40200+i} VB2[{i}] (i=0..7) — Global vector register 2
{0x40300+i} VB3[{i}] (i=0..7) — Global vector register 3
{0x40400+i} VB4[{i}] (i=0..7) — Global vector register 4
{0x40500+i} VB5[{i}] (i=0..7) — Global vector register 5
{0x40600+i} VB6[{i}] (i=0..7) — Global vector register 6
{0x40700+i} VB7[{i}] (i=0..7) — Global vector register 7
{0x40800+i} VB8[{i}] (i=0..7) — Global vector register 8
{0x40900+i} VB9[{i}] (i=0..7) — Global vector register 9
{0x40A00+i} VB10[{i}] (i=0..7) — Global vector register 10
{0x40B00+i} VB11[{i}] (i=0..7) — Global vector register 11
{0x40C00+i} VB12[{i}] (i=0..7) — Global vector register 12
{0x40D00+i} VB13[{i}] (i=0..7) — Global vector register 13
{0x40E00+i} VB14[{i}] (i=0..7) — Global vector register 14
{0x40F00+i} VB15[{i}] (i=0..7) — Global vector register 15
{0x60000+i} VBM0[{i}] (i=0..7) — Local .M2/.C register 0
{0x60100+i} VBM1[{i}] (i=0..7) — Local .M2/.C register 1
{0x60200+i} VBM2[{i}] (i=0..7) — Local .M2/.C register 2
{0x60300+i} VBM3[{i}] (i=0..7) — Local .M2/.C register 3
{0x60400+i} VBM4[{i}] (i=0..7) — Local .M2/.C register 4
{0x60500+i} VBM5[{i}] (i=0..7) — Local .M2/.C register 5
{0x60600+i} VBM6[{i}] (i=0..7) — Local .M2/.C register 6
{0x60700+i} VBM7[{i}] (i=0..7) — Local .M2/.C register 7
{0x70000+i} VBL0[{i}] (i=0..7) — Local .L2/.S2 register 0
{0x70100+i} VBL1[{i}] (i=0..7) — Local .L2/.S2 register 1
{0x70200+i} VBL2[{i}] (i=0..7) — Local .L2/.S2 register 2
{0x70300+i} VBL3[{i}] (i=0..7) — Local .L2/.S2 register 3
{0x70400+i} VBL4[{i}] (i=0..7) — Local .L2/.S2 register 4
{0x70500+i} VBL5[{i}] (i=0..7) — Local .L2/.S2 register 5
{0x70600+i} VBL6[{i}] (i=0..7) — Local .L2/.S2 register 6
{0x70700+i} VBL7[{i}] (i=0..7) — Local .L2/.S2 register 7
{0xB0400+i} SA0CR[{i}] (i=0..7) — Streaming address generator configuration register 0[Access Permissions: Guest User=RW, Guest Supervisor=RW, User=RW, Supervisor=RW, Secure User=RW, Secure Supervisor=RW]
{0xB0500+i} SA0CNTR0[{i}] (i=0..7) — Streaming address generator counter register 0[Access Permissions: Guest User=RW, Guest Supervisor=RW, User=RW, Supervisor=RW, Secure User=RW, Secure Supervisor=RW]
{0xB0600+i} SA1CR[{i}] (i=0..7) — Streaming address generator configuration register 1[Access Permissions: Guest User=RW, Guest Supervisor=RW, User=RW, Supervisor=RW, Secure User=RW, Secure Supervisor=RW]
{0xB0700+i} SA0CNTR1[{i}] (i=0..7) — Streaming address generator counter register 1[Access Permissions: Guest User=RW, Guest Supervisor=RW, User=RW, Supervisor=RW, Secure User=RW, Secure Supervisor=RW]
{0xB0800+i} SA2CR[{i}] (i=0..7) — Streaming address generator configuration register 2[Access Permissions: Guest User=RW, Guest Supervisor=RW, User=RW, Supervisor=RW, Secure User=RW, Secure Supervisor=RW]
{0xB0900+i} SA0CNTR2[{i}] (i=0..7) — Streaming address generator counter register 2[Access Permissions: Guest User=RW, Guest Supervisor=RW, User=RW, Supervisor=RW, Secure User=RW, Secure Supervisor=RW]
{0xB0A00+i} SA3CR[{i}] (i=0..7) — Streaming address generator configuration register 3[Access Permissions: Guest User=RW, Guest Supervisor=RW, User=RW, Supervisor=RW, Secure User=RW, Secure Supervisor=RW]
{0xB0B00+i} SA0CNTR3[{i}] (i=0..7) — Streaming address generator counter register 3[Access Permissions: Guest User=RW, Guest Supervisor=RW, User=RW, Supervisor=RW, Secure User=RW, Secure Supervisor=RW]
{0xCF900+i} SE1[{i}] (i=0..7) — Streaming Engine Data Register 1 -- For Debug only[Access Permissions: Non-Secure Debug=R, Secure Debug=R]
{0xCFA00+i} SE0[{i}] (i=0..7) — Streaming Engine Data Register 0 -- For Debug only[Access Permissions: Non-Secure Debug=R, Secure Debug=R]
