# 28M36_EPI_Registers register map
Vendor: Texas Instruments
Peripheral module from a debugger description file (folder C2000).
Address unit: 16 bits
Registers are 32-bit, access not given, no defined reset value unless marked. A register's access mark holds for its fields unless they carry their own. Offsets are as the file gives them; lines under a group give offsets from that group; [hi:lo] are bit positions; {n}, {i} and the like mark numbered series; 'fields as' and 'values as' point back to an identical list; <NAME> marks a mode.

## EPI_REGS — EPI REGS Registers
0x00 CEPIRTWCFG — Real Time Window Configure Register
0x02 CEPIRTWCNT — Real Time Window Counter Register
0x04 CEPIRTWPRD — Real Time Window Period Register
0x0A CEPISTATUS — EPI Status Register
