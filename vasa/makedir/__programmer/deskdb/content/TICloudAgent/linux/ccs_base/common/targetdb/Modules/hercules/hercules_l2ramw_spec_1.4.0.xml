# hercules_l2ramw_spec_1.4.0 register map
Vendor: Texas Instruments
Peripheral module from a debugger description file (folder hercules).
Registers are 32-bit, access not given, no defined reset value unless marked. A register's access mark holds for its fields unless they carry their own. Offsets are as the file gives them; lines under a group give offsets from that group; [hi:lo] are bit positions; {n}, {i} and the like mark numbered series; 'fields as' and 'values as' point back to an identical list; <NAME> marks a mode.

## L2ramw — L2 RAM Wrapper
0x00 RamCtrl — Ram Control Register
0x10 RamErrStat — Ram Error Status Register
0x24 DiagDataVectH — Diagnostic Data Vector Upper 32bits
0x28 DiagDataVectL — Diagnostic Data Vector Lower 32bits
0x2C DiagEccVect — Diagnostic ECC Vector
0x30 RamTest — RAM Test Control register
0x38 AddrVectTstReg — RAM Address Decode Vector Test Register
0x3C MemInitDomain — Memory Initialization Domain Register
0x44 BnkDmnMap0 — Bank to Domain Mapping Register0
0x48 BnkDmnMap1 — Bank to Domain Mapping Register1

## Notices in the file
(c) Texas Instruments 2003-2012, All rights reserved.
