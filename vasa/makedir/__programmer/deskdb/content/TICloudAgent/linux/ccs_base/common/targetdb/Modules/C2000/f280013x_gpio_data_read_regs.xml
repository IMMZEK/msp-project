# f280013x_gpio_data_read_regs register map
Vendor: Texas Instruments
Peripheral module from a debugger description file (folder C2000).
Address unit: 16 bits
Registers are 32-bit, read-only, no defined reset value unless marked. A register's access mark holds for its fields unless they carry their own. Offsets are as the file gives them; lines under a group give offsets from that group; [hi:lo] are bit positions; {n}, {i} and the like mark numbered series; 'fields as' and 'values as' point back to an identical list; <NAME> marks a mode.

## GPIO_DATA_READ_REGS — GPIO DATA READ Registers
0x00 GPADAT_R — GPIO A Data Read Register
  [31:0] DATA — GPADAT register value
0x02 GPBDAT_R — GPIO B Data Read Register
  [31:0] DATA — GPBDAT register value
0x0E GPHDAT_R — GPIO H Data Read Register
  [31:0] DATA — GPHDAT register value
