# hercules_ccmr5_spec_0.6.0 register map
Vendor: Texas Instruments
Peripheral module from a debugger description file (folder hercules).
Registers are 32-bit, access not given, no defined reset value unless marked. A register's access mark holds for its fields unless they carry their own. Offsets are as the file gives them; lines under a group give offsets from that group; [hi:lo] are bit positions; {n}, {i} and the like mark numbered series; 'fields as' and 'values as' point back to an identical list; <NAME> marks a mode.

## CcmR5 — CPU Compare Module for Cortex-R5
0x00 CcmSr1 — CCMR5 Status Register1
0x04 CcmKeyR1 — CCMR5 Key Register1
0x08 CcmSr2 — CCMR5 Status Register2
0x0C CcmKeyR2 — CCMR5 Key Register2
0x10 CcmSr3 — CCMR5 Status Register3
0x14 CcmKeyR3 — CCMR5 Key Register3
0x18 CcmPolCntrl — CCMR5 Polarity Control Register
0x1C CcmSr4 — CCMR5 Status Register4
0x20 CcmKeyR4 — CCMR5 Key Register4
0x24 CcmPDStat0 — CCMR5 Power Domain Status Register0
0x28 CcmPDStat1 — CCMR5 Power Domain Status Register1

## Notices in the file
(c) Texas Instruments 2003-2012, All rights reserved.
