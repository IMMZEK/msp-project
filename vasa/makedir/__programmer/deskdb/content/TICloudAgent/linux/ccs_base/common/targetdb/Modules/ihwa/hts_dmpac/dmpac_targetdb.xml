# dmpac_targetdb register map
Vendor: Texas Instruments
Registers are 32-bit, read-write, no defined reset value unless marked. A register's access mark holds for its fields unless they carry their own. Offsets are as the file gives them; [hi:lo] are bit positions; {n}, {i} and the like mark numbered series; 'fields as' and 'values as' point back to an identical list.

## DMPAC (part 5 of 5) — Depth and Motion Perception Accelerator (DMPAC)
0xA80 intr_vector_reg_level_dmpac_out_0 ro — Interrupt Vector for level_dmpac_out_0
  [31:0] intr_vector_level_dmpac_out_0 — Interrupt Vector
{0xA80+4i} CTOWN{i} access per field (i=0..22) — Counter/Timer Ownership register {i}
  [30:2] OWNERSHIP rw — Counter/Timer Ownership Status. The Read encoding is (0=Available, 1=Claimed, 2=Enabled, 3=Reserved). The write commands are (0=release, 1=claim, 2=enable, 3=nop)
  [28:1] CURRENT_OWNER ro — This value reflects the Counter/Timer ownership when the register is in a non-Available state, 1=Ap owned, 0=Dbg owned
  [29:1] DBG_OVERIDE rw — This bit indicates the debugger is Claiming the resource, always reads back as 1
0xA84 intr_vector_reg_level_dmpac_out_1 ro — Interrupt Vector for level_dmpac_out_1
  [31:0] intr_vector_level_dmpac_out_1 — Interrupt Vector
0xA88 intr_vector_reg_pulse_dmpac_out_0 ro — Interrupt Vector for pulse_dmpac_out_0
  [31:0] intr_vector_pulse_dmpac_out_0 — Interrupt Vector
{0x968+0x24*i} DMA{i}_scheduler_control access per field (i=8..10) — Scheduler Control Register
  [13:8] dma_channel_no rw — DMA channel number for thread scheduler for DMA{i}
  [7:4] state ro — Current state of DMA{i} Scheduler
  [3:1] pipeline_num rw — Pipeline Number of DMA{i} Scheduler
  [5:1] strm_en rw — '1' -> Streaming input enable, '0' No streaming input
  [6:1] pause rw — '1' -> pause/suspend scheduler , '0' -> resume scheduler
  [12:1] debug_rdy rw — '0' -> DMA{i} Scheduler resources must not be read during halted state. '1'-> DMA{i} Scheduler resources are readable during halted state
  [1:0] sch_en rw — scheduler enable; write '1' to enable scheduler
0xA8C intr_vector_reg_pulse_dmpac_out_1 ro — Interrupt Vector for pulse_dmpac_out_1
  [31:0] intr_vector_pulse_dmpac_out_1 — Interrupt Vector
{0x96C+0x24*i} DMA{i}_HOP (i=8..10) — Scheduler HOP Control Register. Help in detecting eop within scheduler. Once configured, it counts task/channel starts and stops issuing further starts. Specifically useful for Head of pipe dma scheduler .
  [13:1] hop_thread_count — Number of Task count for Head of pipe
  [1:0] hop — '1' -> Head of Pipe producer Sch , '0' -> No hop
{0x978+0x24*i} DMA{i}_prod0_control (i=8..10) — Controlling producer socket0 for DMA{i}
  [8:1] cons_select — consumer select for DMA{i} prod socket 0. Used in decrementing count of producer buffer
  [1:0] prod_en — '1' -> Producer socket 0 enable , '0' Disable
{0x97C+0x24*i} DMA{i}_prod0_buf_control (i=8..10) — Controlling producer socket0 buffer for DMA{i}
  [13:8] threshold — Count threshold to generate pend for consumer
  [21:6] count_dec — Count decrement value for prod count
  [13:0] depth — Maximum number of producer buffer count
{0x980+0x24*i} DMA{i}_prod0_count access per field (i=8..10) — Defining count values for pre/post load for generating pend by DMA{i} prod0
  [16:13] count ro — current count value
  [8] count_postload rw — count postload after producer max thread count reached
  [8:0] count_preload rw — count preload after scheduler start/init
{0x984+0x24*i} DMA{i}_pa0_control (i=8..10) — control register to manage pattern adapter on DMA{i} prod socket0
  [13:10] pa_ps_maxcount — destination count for pattern adaptation (N), M --> N
  [10:3] pa_cs_maxcount — source count for pattern adaptation (M), M --> N
  [1] pa_dec_cntl — '1' -> post pattern adaptation, decrement ps count by count_dec , '0' -> post pattern adaptation, decrement ps count by pa_cs_maxcount
  [2:1] pa_buf_cntl — '1' -> Apply threshold, count_preload and count_postload on pattern adapter count (use this only when pa_enable='1') '0' -> Apply threshold, count_preload and count_postload on prod count (same behavior as if no pattern adapter. Note when pa_enable='1' and pa_buf_cntl='0' threshold is not used and ignored)
  [1:0] pa_enable — '1' -> pa enable, '0' -> disable
{0x988+0x24*i} DMA{i}_pa0_prodcount access per field (i=8..10) — count values for HWA{i} prod socket0
  [10:6] pa_pscount ro — current count value of pa prod count
  [6:0] pa_count_dec rw — Decrement count value of pa_prod_count after pattern adapter prod count reaches threshold
0xADC CTOWN23 access per field — Counter/Timer Ownership register2 3
  fields as CTOWN0
{0xA80+4i} CTOWN{i} access per field (i=24..31) — Counter/Timer Ownership register {i}
  fields as CTOWN0
{0xB00+4i} CTFILT{i} access per field (i=0..31) — Counter Timer {i} Filter Register. These filters are only activated if the CTCRn : FILTER is set
  [1] IDLE rw — Counter functions while system/core is in idle
  [2:1] NRUSER rw — Counter functions while system is in in Non-Root-User mode
  [3:1] NRSUPER rw — Counter functions while system is in Non-Root-Supervisor mode
  [4:1] RUSER rw — Counter functions while system is in Root-User mode
  [5:1] RSUPER rw — Counter functions while system is in Root-Supervisor node
  [6:1] SECUSER rw — Counter functions while system is in Secure-User mode
  [7:1] SECSUPER rw — Counter functions while system is in Secure-Supervisor mode
  [1:0] FREE rw — Counter functions while system/core is halted
{0xB80+4i} CTCNTR{i} ro (i=0..31) — Counter Timer Counter Register {i}
  [32:0] COUNT — This field reflects the current value of the counter. It is incremented when the system events configured in the corresponding Counter Control Register is asserted. If CTCRn.CHNSHD is set, the Counter will increment when the low order counter rolls over.
0xC00 CT_EOI access per field — Counter Timer EOI Register. This register is the End of Interrupt used by SW to signal HW that an interrupt event service is complete and an interrupt can be rearmed. This register exists only if NUMTIMR > 0
  [1:0] EOI rw — EOI value
{0xC00+0x20*i} hts_cfg_fw_region_{i}_control (i=0..3) — The FW Region {i} Control Register defines the control fields for the slave hts.s_vbusp region {i} firewall.
  [4:1] lock — Lock region. Once set region values cannot be modified.
  [8:1] background — Background enable for region. There can be 1 backgroun region per FW and foreground regions can have overlapping addresses only with the background region.
  [9:1] cache_mode — Cache mode for region. Set to 1 to check cache permissions. Set to 0 to ignore cache permissions.
  [4:0] enable — Enable region. A value of 0xA enables, others disable.
0xC04 CTIRQSTAT_RAW — Counter Timer IRQSTATUS RAW Register. This register indicates the raw status of the interrupt. It can be written by SW for testing. This register exists only if NUMTIMR > 0
  [32:0] TIM_INTn_IRQ — IRQSTATUS_RAW value. The individual bits is this field correspond to individual interrupts generated for each timer associated with Counter Timer Control Register (CTCRn : INT).
{0xC04+0x20*i} hts_cfg_fw_region_{i}_permission_0 (i=0..3) — The FW Region {i} Permission 0 Register defines the permissions for the slave hts.s_vbusp region {i} firewall.
  [16:8] priv_id — Allowed privid.
  [1] sec_supv_read — Secure supervisor read allowed.
  [2:1] sec_supv_cacheable — Secure supervisor cacheable allowed.
  [3:1] sec_supv_debug — Secure supervisor debug allowed.
  [4:1] sec_user_write — Secure user write allowed.
  [5:1] sec_user_read — Secure user read allowed.
  [6:1] sec_user_cacheable — Secure user cacheable allowed.
  [7:1] sec_user_debug — Secure user debug allowed.
  [8:1] nonsec_supv_write — Non-secure supervisor write allowed.
  [9:1] nonsec_supv_read — Non-secure supervisor read allowed.
  [10:1] nonsec_supv_cacheable — Non-secure supervisor cacheable allowed.
  [11:1] nonsec_supv_debug — Non-secure supervisor debug allowed.
  [12:1] nonsec_user_write — Non-secure user write allowed.
  [13:1] nonsec_user_read — Non-secure user read allowed.
  [14:1] nonsec_user_cacheable — Non-secure user cacheable allowed.
  [15:1] nonsec_user_debug — Non-secure user debug allowed.
  [1:0] sec_supv_write — Secure supervisor write allowed.
0xC08 CTIRQSTAT — Counter Timer IRQSTATUS Register. This bit clears the interrupt event. SW can also read this bit to indicate that the interrupt is active and enabled. This register exists only if NUMTIMR > 0
  [32:0] TIM_INTn_IE — IRQSTATUS value. The individual bits is this field correspond to individual interrupts generated for each timer associated with Counter Timer Control Register (CTCRn : INT).
{0xC08+0x20*i} hts_cfg_fw_region_{i}_permission_1 (i=0..3) — The FW Region {i} Permission 1 Register defines the permissions for the slave hts.s_vbusp region {i} firewall.
  fields as hts_cfg_fw_region_0_permission_0
0xC0C CTIRQENABLE_SET — Counter Timer IRQENABLE_SET Register. This register is to enable generation of Interrupt Event used by SW. This register exists only if NUMTIMR > 0
  [32:0] TIM_INTn_IES — IRQSET value. This bit sets the enable of the interrupt event. SW can also read this bit to determine if the interrupt is enabled. The individual bits is this field correspond to individual interrupts generated for each timer associated with Counter Timer Control Register (CTCRn : INT).
{0xC0C+0x20*i} hts_cfg_fw_region_{i}_permission_2 (i=0..3) — The FW Region {i} Permission 2 Register defines the permissions for the slave hts.s_vbusp region {i} firewall.
  fields as hts_cfg_fw_region_0_permission_0
0xC10 CTIRQENABLE_CLR — Counter Timer IRQENABLE_CLR Register. This register is to disable generation of Interrupt Event used by SW. This register exists only if NUMTIMR > 0
  [32:0] TIM_INTn_IEC — IRQCLR value. This bit clears the enable of the interrupt event. SW can also read this bit to determine if the interrupt is enabled. The individual bits is this field correspond to individual interrupts generated for each timer associated with Counter Timer Control Register (CTCRn : INT).
{0xC10+0x20*i} hts_cfg_fw_region_{i}_start_address_l access per field (i=0..3) — The FW Region {i} Start Address Low Register defines the start address bits 31 to 0 for the slave hts.s_vbusp region {i} firewall.
  [20:12] start_address_l rw — Start address bits 31 to 12. Lowest 12 bits are forced to 0 as address must be 4KB aligned.
  [12:0] start_address_lsb ro — Start address bits 11 to 0 are forced to 0 as address must be 4KB aligned.
{0xC14+0x20*i} hts_cfg_fw_region_{i}_start_address_h (i=0..3) — The FW Region {i} Start Address High Register defines the start address bits 47 to 32 for the slave hts.s_vbusp region {i} firewall.
  [16:0] start_address_h — Start address bits 47 to 32.
{0xC18+0x20*i} hts_cfg_fw_region_{i}_end_address_l access per field (i=0..3) — The FW Region {i} End Address Low Register defines the end address bits 31 to 0 to include for the slave hts.s_vbusp region {i} firewall.
  [20:12] end_address_l rw — End address bits 31 to 12 to include in the match. Lowest 12 bits are forced to 1s as address must be 4KB aligned.
  [12:0] end_address_lsb ro — End address bits 11 to 0 are forced to 1s as address must be 4KB aligned minus 1.
{0xC1C+0x20*i} hts_cfg_fw_region_{i}_end_address_h (i=0..3) — The FW Region {i} End Address High Register defines the end address bits 47 to 32 to include for the slave hts.s_vbusp region {i} firewall.
  [16:0] end_address_h — End address bits 47 to 32 to include in the match.
0xD40 DMA32_scheduler_control access per field — Scheduler Control Register
  [13:8] dma_channel_no rw — DMA channel number for thread scheduler for DMA32
  [7:4] state ro — Current state of DMA32 Scheduler
  [3:1] pipeline_num rw — Pipeline Number of DMA32 Scheduler
  [5:1] strm_en rw — '1' -> Streaming input enable, '0' No streaming input
  [6:1] pause rw — '1' -> pause/suspend scheduler , '0' -> resume scheduler
  [12:1] debug_rdy rw — '0' -> DMA32 Scheduler resources must not be read during halted state. '1'-> DMA32 Scheduler resources are readable during halted state
  [1:0] sch_en rw — scheduler enable; write '1' to enable scheduler
0xD44 DMA32_HOP — Scheduler HOP Control Register. Help in detecting eop within scheduler. Once configured, it counts task/channel starts and stops issuing further starts. Specifically useful for Head of pipe dma scheduler .
  fields as DMA8_HOP
0xD50 DMA32_prod0_control — Controlling producer socket0 for DMA32
  [8:1] cons_select — consumer select for DMA32 prod socket 0. Used in decrementing count of producer buffer
  [1:0] prod_en — '1' -> Producer socket 0 enable , '0' Disable
0xD54 DMA32_prod0_buf_control — Controlling producer socket0 buffer for DMA32
  fields as DMA8_prod0_buf_control
0xD58 DMA32_prod0_count access per field — Defining count values for pre/post load for generating pend by DMA32 prod0
  fields as DMA8_prod0_count
0xE20 DMA40_scheduler_control access per field — Scheduler Control Register
  [13:8] dma_channel_no rw — DMA channel number for thread scheduler for DMA40
  [7:4] state ro — Current state of DMA40 Scheduler
  [3:1] pipeline_num rw — Pipeline Number of DMA40 Scheduler
  [5:1] strm_en rw — '1' -> Streaming input enable, '0' No streaming input
  [6:1] pause rw — '1' -> pause/suspend scheduler , '0' -> resume scheduler
  [12:1] debug_rdy rw — '0' -> DMA40 Scheduler resources must not be read during halted state. '1'-> DMA40 Scheduler resources are readable during halted state
  [1:0] sch_en rw — scheduler enable; write '1' to enable scheduler
0xE24 DMA40_HOP — Scheduler HOP Control Register. Help in detecting eop within scheduler. Once configured, it counts task/channel starts and stops issuing further starts. Specifically useful for Head of pipe dma scheduler .
  fields as DMA8_HOP
0xE30 DMA40_prod0_control — Controlling producer socket0 for DMA40
  [8:1] cons_select — consumer select for DMA40 prod socket 0. Used in decrementing count of producer buffer
  [1:0] prod_en — '1' -> Producer socket 0 enable , '0' Disable
0xE34 DMA40_prod0_buf_control — Controlling producer socket0 buffer for DMA40
  fields as DMA8_prod0_buf_control
0xE38 DMA40_prod0_count access per field — Defining count values for pre/post load for generating pend by DMA40 prod0
  fields as DMA8_prod0_count
0xF00 DMA48_scheduler_control access per field — Scheduler Control Register
  [13:8] dma_channel_no rw — DMA channel number for thread scheduler for DMA48
  [7:4] state ro — Current state of DMA48 Scheduler
  [3:1] pipeline_num rw — Pipeline Number of DMA48 Scheduler
  [5:1] strm_en rw — '1' -> Streaming input enable, '0' No streaming input
  [6:1] pause rw — '1' -> pause/suspend scheduler , '0' -> resume scheduler
  [12:1] debug_rdy rw — '0' -> DMA48 Scheduler resources must not be read during halted state. '1'-> DMA48 Scheduler resources are readable during halted state
  [1:0] sch_en rw — scheduler enable; write '1' to enable scheduler
0xF04 DMA48_HOP — Scheduler HOP Control Register. Help in detecting eop within scheduler. Once configured, it counts task/channel starts and stops issuing further starts. Specifically useful for Head of pipe dma scheduler .
  fields as DMA8_HOP
0xF10 DMA48_prod0_control — Controlling producer socket0 for DMA48
  [8:1] cons_select — consumer select for DMA48 prod socket 0. Used in decrementing count of producer buffer
  [1:0] prod_en — '1' -> Producer socket 0 enable , '0' Disable
0xF14 DMA48_prod0_buf_control — Controlling producer socket0 buffer for DMA48
  fields as DMA8_prod0_buf_control
0xF18 DMA48_prod0_count access per field — Defining count values for pre/post load for generating pend by DMA48 prod0
  fields as DMA8_prod0_count
{0x9C0+0x1C*i} DMA{i}_scheduler_control access per field (i=56..59) — Scheduler Control Register
  fields as DMA8_scheduler_control
{0x9C4+0x1C*i} DMA{i}_HOP (i=56..59) — Scheduler HOP Control Register. Help in detecting eop within scheduler. Once configured, it counts task/channel starts and stops issuing further starts. Specifically useful for Head of pipe dma scheduler .
  fields as DMA8_HOP
{0x9D0+0x1C*i} DMA{i}_prod0_control (i=56..59) — Controlling producer socket0 for DMA{i}
  fields as DMA8_prod0_control
{0x9D4+0x1C*i} DMA{i}_prod0_buf_control (i=56..59) — Controlling producer socket0 buffer for DMA{i}
  fields as DMA8_prod0_buf_control
{0x9D8+0x1C*i} DMA{i}_prod0_count access per field (i=56..59) — Defining count values for pre/post load for generating pend by DMA{i} prod0
  fields as DMA8_prod0_count
{0x1000+0x800*i} SRB_L{i}_RAM ro (i=0..6) — srb_l{i}_ram diagnostic read only port, vbusp will stall until RAM is available for read
  [24:8] rsvd — Always read as 0. Writes have no effect.
  [24:0] data — Data read from RAM
0x1000 ctset_cfg_fw_region_0_control — The FW Region 0 Control Register defines the control fields for the slave ctset2_wrap.cfg region 0 firewall.
  fields as hts_cfg_fw_region_0_control
0x1000 sde_mst_isc_region_0_control access per field — The ISC Region 0 Control Register defines the control fields for the master .sde_mst region 0 ISC.
  [8] priv_id rw
  [16:4] sec rw — Make outgoing secure. A value of 0xA enables, others disable.
  [24:2] priv rw — Set outgoing priv attribute. If each bit is set then the outgoing priv bit is set.
  [26:2] nopriv rw — Clear output priv attribute. If each bit is set then the outgoing priv bit is cleared.
  [4:1] lock rw — Lock region. Once set the region values cannot be modified.
  [5:1] ch_mode rw — Enable channel mode to match region to a chanid value. Otherwise use address mode to match region to an address range.
  [6:1] def ro — Default region indication. The default region is used when all other regions do not match.
  [20:1] nonsec rw — Make outgoing non-secure.
  [21:1] pass rw — No privID replacement, pass through value.
  [4:0] enable rw — Enable region. A value of 0xA enables, others disable.
{0x1004+4i} ctset_cfg_fw_region_0_permission_{i} (i=0..2) — The FW Region 0 Permission {i} Register defines the permissions for the slave ctset2_wrap.cfg region 0 firewall.
  fields as hts_cfg_fw_region_0_permission_0
0x1010 ctset_cfg_fw_region_0_start_address_l access per field — The FW Region 0 Start Address Low Register defines the start address bits 31 to 0 for the slave ctset2_wrap.cfg region 0 firewall.
  fields as hts_cfg_fw_region_0_start_address_l
0x1010 sde_mst_isc_region_0_start_address_l — The ISC Region 0 Start Address Low Register defines the start address bits 31 to 0 for the master .sde_mst region 0 ISC.
  [20:12] start_address_l — Start address bits 31 to 12.
  [12:0] start_address_lsb — Start address bits 11 to 0 must be 0 as address must be 4KB aligned in address mode. Can also be channel number in channel mode.
0x1014 ctset_cfg_fw_region_0_start_address_h — The FW Region 0 Start Address High Register defines the start address bits 47 to 32 for the slave ctset2_wrap.cfg region 0 firewall.
  [16:0] start_address_h — Start address bits 47 to 32.
0x1014 sde_mst_isc_region_0_start_address_h — The ISC Region 0 Start Address High Register defines the start address bits 47 to 32 for the master .sde_mst region 0 ISC.
  [16:0] start_address_h — Start address bits 47 to 32.
0x1018 ctset_cfg_fw_region_0_end_address_l access per field — The FW Region 0 End Address Low Register defines the end address bits 31 to 0 to include for the slave ctset2_wrap.cfg region 0 firewall.
  fields as hts_cfg_fw_region_0_end_address_l
0x1018 sde_mst_isc_region_0_end_address_l access per field — The ISC Region 0 End Address Low Register defines the end included address bits 31 to 0 for the master .sde_mst region 0 ISC.
  [20:12] end_address_l rw — End address bits 31 to 12 to include in the match.
  [12:0] end_address_lsb ro — End address bits 11 to 0 are forced to Fs as address must be 4KB aligned.
0x101C ctset_cfg_fw_region_0_end_address_h — The FW Region 0 End Address High Register defines the end address bits 47 to 32 to include for the slave ctset2_wrap.cfg region 0 firewall.
  fields as hts_cfg_fw_region_0_end_address_h
0x101C sde_mst_isc_region_0_end_address_h — The ISC Region 0 End Address High Register defines the end address bits 47 to 32 for the master .sde_mst region 0 ISC.
  [16:0] end_address_h — End address bits 47 to 32.
0x1020 sde_mst_isc_region_def_control access per field — The ISC Default Region Control Register defines the control fields for the master .sde_mst region 1 ISC.
  [8] priv_id rw
  [16:4] sec rw — Make outgoing secure. A value of 0xA enables, others disable.
  [24:2] priv rw — Set outgoing priv attribute. If each bit is set then the outgoing priv bit is set.
  [26:2] nopriv rw — Clear output priv attribute. If each bit is set then the outgoing priv bit is cleared.
  [4:1] lock rw — Lock region. Once set, the region values cannot be modified.
  [5:1] ch_mode ro — Enable channel mode to match region to a chanid value. Otherwise use address mode to match region to an address range.
  [6:1] def ro — Default region indication. The default region is used when all other regions do not match.
  [20:1] nonsec rw — Make outgoing non-secure.
  [21:1] pass rw — No privID replacement, pass through value.
  [4:0] enable ro — Enable region. A value of 0xA enables, others disable.
{0x9C0+0x1C*i} DMA{i}_scheduler_control access per field (i=64..67) — Scheduler Control Register
  fields as DMA8_scheduler_control
{0x9C4+0x1C*i} DMA{i}_HOP (i=64..67) — Scheduler HOP Control Register. Help in detecting eop within scheduler. Once configured, it counts task/channel starts and stops issuing further starts. Specifically useful for Head of pipe dma scheduler .
  fields as DMA8_HOP
{0x9D0+0x1C*i} DMA{i}_prod0_control (i=64..67) — Controlling producer socket0 for DMA{i}
  fields as DMA8_prod0_control
{0x9D4+0x1C*i} DMA{i}_prod0_buf_control (i=64..67) — Controlling producer socket0 buffer for DMA{i}
  fields as DMA8_prod0_buf_control
{0x9D8+0x1C*i} DMA{i}_prod0_count access per field (i=64..67) — Defining count values for pre/post load for generating pend by DMA{i} prod0
  fields as DMA8_prod0_count
0x1400 foco_0_cfg_fw_region_0_control — The FW Region 0 Control Register defines the control fields for the slave dmpac_foco_0.cfg_slv region 0 firewall.
  fields as hts_cfg_fw_region_0_control
0x1400 dof_rd_mst_isc_region_0_control access per field — The ISC Region 0 Control Register defines the control fields for the master .dof_rd_mst region 0 ISC.
  fields as sde_mst_isc_region_0_control
{0x1404+4i} foco_0_cfg_fw_region_0_permission_{i} (i=0..2) — The FW Region 0 Permission {i} Register defines the permissions for the slave dmpac_foco_0.cfg_slv region 0 firewall.
  fields as hts_cfg_fw_region_0_permission_0
0x1410 foco_0_cfg_fw_region_0_start_address_l access per field — The FW Region 0 Start Address Low Register defines the start address bits 31 to 0 for the slave dmpac_foco_0.cfg_slv region 0 firewall.
  fields as hts_cfg_fw_region_0_start_address_l
0x1410 dof_rd_mst_isc_region_0_start_address_l — The ISC Region 0 Start Address Low Register defines the start address bits 31 to 0 for the master .dof_rd_mst region 0 ISC.
  fields as sde_mst_isc_region_0_start_address_l
0x1414 foco_0_cfg_fw_region_0_start_address_h — The FW Region 0 Start Address High Register defines the start address bits 47 to 32 for the slave dmpac_foco_0.cfg_slv region 0 firewall.
  [16:0] start_address_h — Start address bits 47 to 32.
0x1414 dof_rd_mst_isc_region_0_start_address_h — The ISC Region 0 Start Address High Register defines the start address bits 47 to 32 for the master .dof_rd_mst region 0 ISC.
  [16:0] start_address_h — Start address bits 47 to 32.
0x1418 foco_0_cfg_fw_region_0_end_address_l access per field — The FW Region 0 End Address Low Register defines the end address bits 31 to 0 to include for the slave dmpac_foco_0.cfg_slv region 0 firewall.
  fields as hts_cfg_fw_region_0_end_address_l
0x1418 dof_rd_mst_isc_region_0_end_address_l access per field — The ISC Region 0 End Address Low Register defines the end included address bits 31 to 0 for the master .dof_rd_mst region 0 ISC.
  fields as sde_mst_isc_region_0_end_address_l
0x141C foco_0_cfg_fw_region_0_end_address_h — The FW Region 0 End Address High Register defines the end address bits 47 to 32 to include for the slave dmpac_foco_0.cfg_slv region 0 firewall.
  fields as hts_cfg_fw_region_0_end_address_h
0x141C dof_rd_mst_isc_region_0_end_address_h — The ISC Region 0 End Address High Register defines the end address bits 47 to 32 for the master .dof_rd_mst region 0 ISC.
  [16:0] end_address_h — End address bits 47 to 32.
0x1420 dof_rd_mst_isc_region_def_control access per field — The ISC Default Region Control Register defines the control fields for the master .dof_rd_mst region 1 ISC.
  fields as sde_mst_isc_region_def_control
0x1800 STPTCR access per field — STP Trace Control Register
  [1] TSEN rw — Timestamp Enable. This bit is static and should not be changed dynamically. This should be changed before client is enabled.
  [2:1] SYNCEN ro — The value 1 indicates STPASYNC is supported
  [5:1] Compen rw — Compression of Data enable
  [23:1] Data_FIFOfull ro — STPMI2ATB internal Data packet fifo is full
  [24:1] MOD_FIFOfull ro — STPMI2ATB internal MID packet fifo is full
0x1800 foco_1_cfg_fw_region_0_control — The FW Region 0 Control Register defines the control fields for the slave dmpac_foco_1.cfg_slv region 0 firewall.
  fields as hts_cfg_fw_region_0_control
0x1800 dof_mst_isc_region_0_control access per field — The ISC Region 0 Control Register defines the control fields for the master .dof_mst region 0 ISC.
  fields as sde_mst_isc_region_0_control
0x1804 STPTID access per field — STP Trace ID Register
  [7:0] TRACEID rw — Trace ID value. Software may overwrite the value at any time, but this is only recommended for scenarios where top-level configuration errors result in a collision between HW master IDs
{0x1804+4i} foco_1_cfg_fw_region_0_permission_{i} (i=0..2) — The FW Region 0 Permission {i} Register defines the permissions for the slave dmpac_foco_1.cfg_slv region 0 firewall.
  fields as hts_cfg_fw_region_0_permission_0
0x1810 STPASYNC access per field — STP Synchronization Control Register
  [12:1] ExpMode rw — Exponent mode, A value of 1 sets count to 2 to the Nth, where Nth is ((bits 11 : 8)+12). A value of 0 sets Count to N (bits 11 : 0)
  [12:0] Count rw — The number of bytes between Synchronization packets
0x1810 foco_1_cfg_fw_region_0_start_address_l access per field — The FW Region 0 Start Address Low Register defines the start address bits 31 to 0 for the slave dmpac_foco_1.cfg_slv region 0 firewall.
  fields as hts_cfg_fw_region_0_start_address_l
0x1810 dof_mst_isc_region_0_start_address_l — The ISC Region 0 Start Address Low Register defines the start address bits 31 to 0 for the master .dof_mst region 0 ISC.
  fields as sde_mst_isc_region_0_start_address_l
0x1814 STPFFCR access per field — STP Flush Control Register
  [1] AsyncPE rw — Async Priority Enable. 0 indicates ASYNC packet priority is lower than trace. 1 indicates priority escalates on second synchronization request
  [5:1] ForceFlush rw — Write a 1 to force a flush, automatically clears after the operation is complete
  [1:0] AutoFlush rw — Auto flush enable. When set, on every complete data (ATDATA : WIDTH) in the fifo written, data is exported out when ATREADY is asserted. This should be written before client IP enabled
0x1814 foco_1_cfg_fw_region_0_start_address_h — The FW Region 0 Start Address High Register defines the start address bits 47 to 32 for the slave dmpac_foco_1.cfg_slv region 0 firewall.
  [16:0] start_address_h — Start address bits 47 to 32.
0x1814 dof_mst_isc_region_0_start_address_h — The ISC Region 0 Start Address High Register defines the start address bits 47 to 32 for the master .dof_mst region 0 ISC.
  [16:0] start_address_h — Start address bits 47 to 32.
0x1818 STPFEAT1 ro — STP Features 1 Register
  [17:5] STP_MINVER — Functional Minor Version
  [27:5] STP_RTLVER — RTL Version. Reset each time major or minor version is updated
  [4:3] VERSION — STP2.0 Time Stamp, Value of 011 indicates Natural binary timestamp, a value of 100 indicates gray binary timestamps
  [24:3] STP_MAJVER — Functional Major Version. This is the first version of STPMI2ATB
  [22:2] STP_CUSTVER — Custom Version (not used)
  [4:0] Prot — Protocol Revision. Value of 0001 indicates STP 2.0
0x1818 foco_1_cfg_fw_region_0_end_address_l access per field — The FW Region 0 End Address Low Register defines the end address bits 31 to 0 to include for the slave dmpac_foco_1.cfg_slv region 0 firewall.
  fields as hts_cfg_fw_region_0_end_address_l
0x1818 dof_mst_isc_region_0_end_address_l access per field — The ISC Region 0 End Address Low Register defines the end included address bits 31 to 0 for the master .dof_mst region 0 ISC.
  fields as sde_mst_isc_region_0_end_address_l
0x181C foco_1_cfg_fw_region_0_end_address_h — The FW Region 0 End Address High Register defines the end address bits 47 to 32 to include for the slave dmpac_foco_1.cfg_slv region 0 firewall.
  fields as hts_cfg_fw_region_0_end_address_h
0x181C dof_mst_isc_region_0_end_address_h — The ISC Region 0 End Address High Register defines the end address bits 47 to 32 for the master .dof_mst region 0 ISC.
  [16:0] end_address_h — End address bits 47 to 32.
0x1820 dof_mst_isc_region_def_control access per field — The ISC Default Region Control Register defines the control fields for the master .dof_mst region 1 ISC.
  fields as sde_mst_isc_region_def_control
0x1C00 dof_cfg_fw_region_0_control — The FW Region 0 Control Register defines the control fields for the slave ^+dof.cfg_vp region 0 firewall.
  fields as hts_cfg_fw_region_0_control
0x1C00 foco_0_mst_isc_region_0_control access per field — The ISC Region 0 Control Register defines the control fields for the master .foco_0_mst region 0 ISC.
  fields as sde_mst_isc_region_0_control
{0x1C04+4i} dof_cfg_fw_region_0_permission_{i} (i=0..2) — The FW Region 0 Permission {i} Register defines the permissions for the slave ^+dof.cfg_vp region 0 firewall.
  fields as hts_cfg_fw_region_0_permission_0
0x1C10 dof_cfg_fw_region_0_start_address_l access per field — The FW Region 0 Start Address Low Register defines the start address bits 31 to 0 for the slave ^+dof.cfg_vp region 0 firewall.
  fields as hts_cfg_fw_region_0_start_address_l
0x1C10 foco_0_mst_isc_region_0_start_address_l — The ISC Region 0 Start Address Low Register defines the start address bits 31 to 0 for the master .foco_0_mst region 0 ISC.
  fields as sde_mst_isc_region_0_start_address_l
0x1C14 dof_cfg_fw_region_0_start_address_h — The FW Region 0 Start Address High Register defines the start address bits 47 to 32 for the slave ^+dof.cfg_vp region 0 firewall.
  [16:0] start_address_h — Start address bits 47 to 32.
0x1C14 foco_0_mst_isc_region_0_start_address_h — The ISC Region 0 Start Address High Register defines the start address bits 47 to 32 for the master .foco_0_mst region 0 ISC.
  [16:0] start_address_h — Start address bits 47 to 32.
0x1C18 dof_cfg_fw_region_0_end_address_l access per field — The FW Region 0 End Address Low Register defines the end address bits 31 to 0 to include for the slave ^+dof.cfg_vp region 0 firewall.
  fields as hts_cfg_fw_region_0_end_address_l
0x1C18 foco_0_mst_isc_region_0_end_address_l access per field — The ISC Region 0 End Address Low Register defines the end included address bits 31 to 0 for the master .foco_0_mst region 0 ISC.
  fields as sde_mst_isc_region_0_end_address_l
0x1C1C dof_cfg_fw_region_0_end_address_h — The FW Region 0 End Address High Register defines the end address bits 47 to 32 to include for the slave ^+dof.cfg_vp region 0 firewall.
  fields as hts_cfg_fw_region_0_end_address_h
0x1C1C foco_0_mst_isc_region_0_end_address_h — The ISC Region 0 End Address High Register defines the end address bits 47 to 32 for the master .foco_0_mst region 0 ISC.
  [16:0] end_address_h — End address bits 47 to 32.
0x1C20 foco_0_mst_isc_region_def_control access per field — The ISC Default Region Control Register defines the control fields for the master .foco_0_mst region 1 ISC.
  fields as sde_mst_isc_region_def_control
{0x2000+0x2000*i} SRB_MEM{i}_RAM ro (i=0..15) — srb_mem{i}_ram diagnostic read only port, vbusp will stall until RAM is available for read
  [32:0] data — Data read from RAM. RAM is wider than 32bit vbus. MMR reads are byte addresses into RAM where RAM Width is extended/zero padded to next pwr2.
0x2000 sde_cfg_fw_region_0_control — The FW Region 0 Control Register defines the control fields for the slave ^+^+sde.s_vbusp region 0 firewall.
  fields as hts_cfg_fw_region_0_control
0x2000 foco_1_mst_isc_region_0_control access per field — The ISC Region 0 Control Register defines the control fields for the master .foco_1_mst region 0 ISC.
  fields as sde_mst_isc_region_0_control
{0x2004+4i} sde_cfg_fw_region_0_permission_{i} (i=0..2) — The FW Region 0 Permission {i} Register defines the permissions for the slave ^+^+sde.s_vbusp region 0 firewall.
  fields as hts_cfg_fw_region_0_permission_0
0x2010 sde_cfg_fw_region_0_start_address_l access per field — The FW Region 0 Start Address Low Register defines the start address bits 31 to 0 for the slave ^+^+sde.s_vbusp region 0 firewall.
  fields as hts_cfg_fw_region_0_start_address_l
0x2010 foco_1_mst_isc_region_0_start_address_l — The ISC Region 0 Start Address Low Register defines the start address bits 31 to 0 for the master .foco_1_mst region 0 ISC.
  fields as sde_mst_isc_region_0_start_address_l
0x2014 sde_cfg_fw_region_0_start_address_h — The FW Region 0 Start Address High Register defines the start address bits 47 to 32 for the slave ^+^+sde.s_vbusp region 0 firewall.
  [16:0] start_address_h — Start address bits 47 to 32.
0x2014 foco_1_mst_isc_region_0_start_address_h — The ISC Region 0 Start Address High Register defines the start address bits 47 to 32 for the master .foco_1_mst region 0 ISC.
  [16:0] start_address_h — Start address bits 47 to 32.
0x2018 sde_cfg_fw_region_0_end_address_l access per field — The FW Region 0 End Address Low Register defines the end address bits 31 to 0 to include for the slave ^+^+sde.s_vbusp region 0 firewall.
  fields as hts_cfg_fw_region_0_end_address_l
0x2018 foco_1_mst_isc_region_0_end_address_l access per field — The ISC Region 0 End Address Low Register defines the end included address bits 31 to 0 for the master .foco_1_mst region 0 ISC.
  fields as sde_mst_isc_region_0_end_address_l
0x201C sde_cfg_fw_region_0_end_address_h — The FW Region 0 End Address High Register defines the end address bits 47 to 32 to include for the slave ^+^+sde.s_vbusp region 0 firewall.
  fields as hts_cfg_fw_region_0_end_address_h
0x201C foco_1_mst_isc_region_0_end_address_h — The ISC Region 0 End Address High Register defines the end address bits 47 to 32 for the master .foco_1_mst region 0 ISC.
  [16:0] end_address_h — End address bits 47 to 32.
0x2020 foco_1_mst_isc_region_def_control access per field — The ISC Default Region Control Register defines the control fields for the master .foco_1_mst region 1 ISC.
  fields as sde_mst_isc_region_def_control
{0xEF4+0x14*i} DMA{i}_scheduler_control access per field (i=240..245) — Scheduler Control Register
  fields as DMA8_scheduler_control
{0xF04+0x14*i} DMA{i}_cons0_control (i=240..245) — Controlling consumer socket 0 for DMA{i}
  [9:1] prod_select — producer select for DMA{i} cons socket 0
  [1:0] cons_en — '1' -> Consumer socket 0 enable , '0' Disable
{0xE2C+0x14*i} DMA{i}_scheduler_control access per field (i=256..261) — Scheduler Control Register
  fields as DMA8_scheduler_control
{0xE3C+0x14*i} DMA{i}_cons0_control (i=256..261) — Controlling consumer socket 0 for DMA{i}
  fields as DMA240_cons0_control
{0xD64+0x14*i} DMA{i}_scheduler_control access per field (i=272..275) — Scheduler Control Register
  fields as DMA8_scheduler_control
{0xD74+0x14*i} DMA{i}_cons0_control (i=272..275) — Controlling consumer socket 0 for DMA{i}
  fields as DMA240_cons0_control
{0xC74+0x14*i} DMA{i}_scheduler_control access per field (i=288..291) — Scheduler Control Register
  fields as DMA8_scheduler_control
{0xC84+0x14*i} DMA{i}_cons0_control (i=288..291) — Controlling consumer socket 0 for DMA{i}
  fields as DMA240_cons0_control
{0xB84+0x14*i} DMA{i}_scheduler_control access per field (i=304..313) — Scheduler Control Register
  fields as DMA8_scheduler_control
{0xB94+0x14*i} DMA{i}_cons0_control (i=304..313) — Controlling consumer socket 0 for DMA{i}
  fields as DMA240_cons0_control
{0x2400+0x20*i} utc0_slv_cfg_fw_region_{i}_control (i=0..3) — The FW Region {i} Control Register defines the control fields for the slave dru_utc_dmpac0.dru_mmr_cfg region {i} firewall.
  fields as hts_cfg_fw_region_0_control
{0x2404+0x20*i} utc0_slv_cfg_fw_region_{i}_permission_0 (i=0..3) — The FW Region {i} Permission 0 Register defines the permissions for the slave dru_utc_dmpac0.dru_mmr_cfg region {i} firewall.
  fields as hts_cfg_fw_region_0_permission_0
{0x2408+0x20*i} utc0_slv_cfg_fw_region_{i}_permission_1 (i=0..3) — The FW Region {i} Permission 1 Register defines the permissions for the slave dru_utc_dmpac0.dru_mmr_cfg region {i} firewall.
  fields as hts_cfg_fw_region_0_permission_0
0x240C DMA336_scheduler_control access per field — Scheduler Control Register
  [13:8] dma_channel_no rw — DMA channel number for thread scheduler for DMA336
  [7:4] state ro — Current state of DMA336 Scheduler
  [3:1] pipeline_num rw — Pipeline Number of DMA336 Scheduler
  [5:1] strm_en rw — '1' -> Streaming input enable, '0' No streaming input
  [6:1] pause rw — '1' -> pause/suspend scheduler , '0' -> resume scheduler
  [12:1] debug_rdy rw — '0' -> DMA336 Scheduler resources must not be read during halted state. '1'-> DMA336 Scheduler resources are readable during halted state
  [1:0] sch_en rw — scheduler enable; write '1' to enable scheduler
{0x240C+0x20*i} utc0_slv_cfg_fw_region_{i}_permission_2 (i=0..3) — The FW Region {i} Permission 2 Register defines the permissions for the slave dru_utc_dmpac0.dru_mmr_cfg region {i} firewall.
  fields as hts_cfg_fw_region_0_permission_0
{0x2410+0x20*i} utc0_slv_cfg_fw_region_{i}_start_address_l access per field (i=0..3) — The FW Region {i} Start Address Low Register defines the start address bits 31 to 0 for the slave dru_utc_dmpac0.dru_mmr_cfg region {i} firewall.
  fields as hts_cfg_fw_region_0_start_address_l
{0x2414+0x20*i} utc0_slv_cfg_fw_region_{i}_start_address_h (i=0..3) — The FW Region {i} Start Address High Register defines the start address bits 47 to 32 for the slave dru_utc_dmpac0.dru_mmr_cfg region {i} firewall.
  [16:0] start_address_h — Start address bits 47 to 32.
{0x2418+0x20*i} utc0_slv_cfg_fw_region_{i}_end_address_l access per field (i=0..3) — The FW Region {i} End Address Low Register defines the end address bits 31 to 0 to include for the slave dru_utc_dmpac0.dru_mmr_cfg region {i} firewall.
  fields as hts_cfg_fw_region_0_end_address_l
0x241C DMA336_cons0_control — Controlling consumer socket 0 for DMA336
  [9:1] prod_select — producer select for DMA336 cons socket 0
  [1:0] cons_en — '1' -> Consumer socket 0 enable , '0' Disable
{0x241C+0x20*i} utc0_slv_cfg_fw_region_{i}_end_address_h (i=0..3) — The FW Region {i} End Address High Register defines the end address bits 47 to 32 to include for the slave dru_utc_dmpac0.dru_mmr_cfg region {i} firewall.
  fields as hts_cfg_fw_region_0_end_address_h
{0x8A0+0x14*i} DMA{i}_scheduler_control access per field (i=352..355) — Scheduler Control Register
  fields as DMA8_scheduler_control
{0x8B0+0x14*i} DMA{i}_cons0_control (i=352..355) — Controlling consumer socket 0 for DMA{i}
  fields as DMA240_cons0_control
{0x7B0+0x14*i} DMA{i}_scheduler_control access per field (i=368..371) — Scheduler Control Register
  fields as DMA8_scheduler_control
{0x7C0+0x14*i} DMA{i}_cons0_control (i=368..371) — Controlling consumer socket 0 for DMA{i}
  fields as DMA240_cons0_control
0x2650 pipe_dbg_cntl access per field — Pipeline Debug Control register is used by debug software to control pipeline debug behavior
  [17:3] debug_state ro — Current state of Debug activity
  [1] pipe_dbg_dis_1 rw — '1' -> Pipeline1 doesn't respond to debug events, '0' Pipeline1 respond to debug events
  [n:1] pipe_dbg_dis_{n} rw (n=2..5) — '1' -> Pipeline{n} doesn't respond to debug events, '0' Pipeline{n} respond to debug events
  [6:1] pipe_dbg_dis_6 rw — '1' -> Pipeline6 doesn't respond to debug events, '0' Pipeline5 respond to debug events
  [16:1] abort_debug wo — '1' -> Abort Debug activity on debug enabled pipelines, '0' no impact
  [1:0] pipe_dbg_dis_0 rw — '1' -> Pipeline0 doesn't respond to debug events, '0' Pipeline0 respond to debug events
0x2654 dbg_cap ro — Debug Capability register is used by debug software to determine which optional debug modules are present and how many instances of each module exist.
  [4] REV_MAJ — Major Revision
  [8:4] NUM_BPS — The number of breakpoint modules that exist. The registers supporting the breakpoint modules must be implemented consecutively in the memory map.
  [12:4] NUM_WPS — The number of watchpoint modules that exist. The registers supporting the watchpoint modules must be implemented consecutively in the memory map
  [16:4] NUM_CNTRS — The number of counter modules that exist. The registers supporting the counter modules must be implemented consecutively in the memory map.
  [20:2] TRIG_CHNS — Number of Trigger Channels Supported. b00 ------ No channels supported. b01 ------ One channel supported. b10 ------ Two channels supported. Others ---- Reserved.
  [22:1] TRIG_INPUT — b0 - Trigger Inputs are not supported. b1 - Trigger Inputs are supported.
  [23:1] TRIG_OUTPUT — b0 - Trigger Outputs are not supported. b1 - Trigger Outputs are supported.
  [24:1] SYS_EXE_REQ — Whether HWA Core Execution status and control is supported. b0 - Not Supported. b1 - Supported.
  [25:1] DBQ_RESET_SUP — Whether HWA Core reset is supported or not which does not affect debug logic. b0 - Not Supported. b1 - Supported.
  [26:1] DBG_SWBP_SUP — Whether HWA Core supports SWBP or not. b0 - Not Supported. b1 - Supported.
  [27:1] DBG_INDIRECT_SUP — Indicates if the HWA supports an indirect memory access port. v2.0 and above. b0 - Not Supported. b1 - Indirect port supported.
  [28:1] DBG_OWN_SUP — Indicates if the HWA supports an module ownership. v2.0 and above. b0 - Not Supported. b1 - Ownership supported.
  [29:1] DBG_WP_DATA_SUP — Indicates if the WP resources has corresponding data qualification. b0 - Not supported. b1 - Data qualifiers are supported.
  [30:1] DBG_INT_STEP_SUP — Indicates that debug execution control can determine if single step blocks or allows interrupts. b0 No step/interrupt control b1 Step interrupt control via DBG_INT_STEP_IN
  [4:0] REV_MIN — Minor Revision
0x2658 dbg_cntl access per field — Debug Control register is used by debug software to control all of the basic debug functions.
  [16:4] DBG_EMU0_CNTL rw — EMU0 output control. The cross trigger output control. The value in this field determines the behavior of the outputs generated on EMU0. NOTE: The effect of setting any non-zero value is ignored if the HWA Core is currently in HALTED state until the HWA core exits and re-enters HALTED state. DBG_EMUn_CNTL Output Enable Output Pulse Description 0 De-asserted 0 NA No output. Input only 1 Stopping 0 Yes Pulse on halt. If this bit is set when halted then no effect until the HWA re-enters halted state. 2 HWBP 0 Yes Pulse when any HWBP triggers 3 HWWP 0 Yes Pulse when any HWWP triggers 4 Asserted 1 No Drive pin high 5 Asserted 0 No Drive pin low 6-15 - - Reserved
  [1] dbg_restart rw — Debug Restart Status bit.This bit is normally set when the DBG_HALT bit transitions from '1' to '0' when the natural execution state is entered.It is a sticky bit. It may also be set when a synchronous run causes the accelerator to leave halted state. Reading '1' means HWA Core exited halted state (at least temporarily). Reading '0' means HWA Core did not exit halted state. Writing '1' shall clear the bit if set. There is no restriction on when it can be cleared. Writing '0' shall have no effect.
  [2:1] dbg_single_step_en rw — Single Step Execution enable. When this bit is set, the accelerator core shall be halted upon execution of a single instruction. This is after the accelerator core has left the halted state by clearing the DBG_HALT control bit. Writing '1' enables halting when the next instruction following exit from halted state is executed. Writing '0' disables halts via single step. NOTE: 1. When the accelerator core enters its natural execution state, it may or may not execute an instruction and re-enter HALTED state.
  [5:1] DBG_EMU0_EN rw — EMU0 input trigger enable Writing '1' enables halting on the falling edge of the EMU0 input Writing '0' disables halts via EMU0 input
  [7:1] DBG_EXE_STAT ro — The execution status of the module Set to '1' when halted due to debug event Set to '0' when execution resumes
  [10:1] DBG_HALT_STEP ro — Execution halted due to single step completion Set to '1' when the single step completes Set to '0' when execution resumes
  [11:1] DBG_HALT_USER ro — Execution halted due to register update of DBG_HALT Set to '1' when halt due to DBG_HALT update completes Set to '0' when execution resumes
  [12:1] DBG_HALT_EMU0 ro — Execution halted due to trigger in on EMU0 input Set to '1' when halt due to EMU0 input completes Set to '0' when execution resumes
  [26:1] DBG_RESET_OCC rw — Sticky status bit to reflect reset has been generated
  [1:0] dbg_halt rw — Global debug run control. The bit will be read as being set upon entry to HALTED state due to halted state being entered because of SWBP, HWBP, HWWP, EMU0 / 1 trigger or manual halt requested through this control. Writing '1' when read '0' shall cause a halt on the next possible halt boundary.Writing '0' when read '1' returns the system to the natural execution state.A synchronous run hardware request has the same effect.Reading '1' means that the halted state has been reached or been requested by the manual halt mechanism.Reading '0' means that the target is in its natural execution state.NOTE: 1. The natural execution state means the FSM state entered prior to last entry into Halted state. 2. This would be the last application requested FSM state unless the DBG_SYS_EXE_REQ control was used to change it.
0x6000 DRCG_FAST_LR_RAM ro — drcg_fast_lr_ram diagnostic read only port, vbusp will stall until RAM is available for read
  fields as SRB_MEM0_RAM
{0x8000+0x4000*i} LCC_OP{i}_RAM ro (i=0..4) — lcc_op{i}_ram diagnostic read only port, vbusp will stall until RAM is available for read
  fields as SRB_MEM0_RAM
0x1C000 DRCG_DISP_RAM ro — drcg_disp_ram diagnostic read only port, vbusp will stall until RAM is available for read
  [20:12] rsvd — Always read as 0. Writes have no effect.
  [20:0] data — Data read from RAM
0x20000 MF_LINE_RAM ro — mf_line_ram diagnostic read only port, vbusp will stall until RAM is available for read
  [30:2] rsvd — Always read as 0. Writes have no effect.
  [30:0] data — Data read from RAM
0x22000 CSRAMGRD_RAM ro — csRamGrd_ram diagnostic read only port, vbusp will stall until RAM is available for read
  fields as DRCG_DISP_RAM
0x24000 CSRAMIIR_RAM ro — csRamIir_ram diagnostic read only port, vbusp will stall until RAM is available for read
  fields as SRB_MEM0_RAM
0x28000 MFRAM0_RAM ro — mfRam0_ram diagnostic read only port, vbusp will stall until RAM is available for read
  fields as SRB_MEM0_RAM
0x28000 SCA_BRC_RAM ro — sca_brc_ram diagnostic read only port, vbusp will stall until RAM is available for read
  fields as SRB_MEM0_RAM
0x2C000 MFRAM1_RAM ro — mfRam1_ram diagnostic read only port, vbusp will stall until RAM is available for read
  fields as SRB_MEM0_RAM
0x30000 SCA_BPCC_RAM ro — sca_bpcc_ram diagnostic read only port, vbusp will stall until RAM is available for read
  fields as SRB_MEM0_RAM
