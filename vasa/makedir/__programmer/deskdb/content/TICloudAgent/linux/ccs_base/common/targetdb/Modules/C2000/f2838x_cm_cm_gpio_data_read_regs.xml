# f2838x_cm_cm_gpio_data_read_regs register map
Vendor: Texas Instruments
Peripheral module from a debugger description file (folder C2000).
Address unit: 16 bits
Registers are 32-bit, read-only, no defined reset value unless marked. A register's access mark holds for its fields unless they carry their own. Offsets are as the file gives them; lines under a group give offsets from that group; [hi:lo] are bit positions; {n}, {i} and the like mark numbered series; 'fields as' and 'values as' point back to an identical list; <NAME> marks a mode.

## CM_GPIO_DATA_READ_REGS — CM GPIO DATA READ Registers
0x00 GPADAT_R — GPIO A Data Read Register
  [31:0] DATA — GPADAT register value
0x04 GPBDAT_R — GPIO B Data Read Register
  [31:0] DATA — GPBDAT register value
0x08 GPCDAT_R — GPIO C Data Read Register
  [31:0] DATA — GPCDAT register value
0x0C GPDDAT_R — GPIO D Data Read Register
  [31:0] DATA — GPDDAT register value
0x10 GPEDAT_R — GPIO E Data Read Register
  [31:0] DATA — GPEDAT register value
0x14 GPFDAT_R — GPIO F Data Read Register
  [31:0] DATA — GPFDAT register value
0x18 GPGDAT_R — GPIO G Data Read Register
  [31:0] DATA — GPGDAT register value
0x1C GPHDAT_R — GPIO H Data Read Register
  [31:0] DATA — GPHDAT register value
