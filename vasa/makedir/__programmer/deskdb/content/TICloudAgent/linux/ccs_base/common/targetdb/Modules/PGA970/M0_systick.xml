# M0_systick register map
Vendor: Texas Instruments
Peripheral module from a debugger description file (folder PGA970).
Registers are 32-bit, access not given, no defined reset value unless marked. A register's access mark holds for its fields unless they carry their own. Offsets are as the file gives them; lines under a group give offsets from that group; [hi:lo] are bit positions; {n}, {i} and the like mark numbered series; 'fields as' and 'values as' point back to an identical list; <NAME> marks a mode.

## SysTick_Timer — System Timer SysTick Registers
0x10 SYST_CSR — SysTick Control and Status Register
0x14 SYST_RVR — SysTick Reload Value Register
0x18 SYST_CVR — SysTick Current Value Register
