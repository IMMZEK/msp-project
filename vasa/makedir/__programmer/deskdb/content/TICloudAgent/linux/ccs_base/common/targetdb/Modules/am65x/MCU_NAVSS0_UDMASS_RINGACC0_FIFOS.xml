# MCU_NAVSS0_UDMASS_RINGACC0_FIFOS register map
Vendor: Texas Instruments
Peripheral module from a debugger description file (folder am65x).
Registers are 32-bit, read-write, reset 0x0 unless marked. A register's access mark holds for its fields unless they carry their own. Offsets are as the file gives them; lines under a group give offsets from that group; [hi:lo] are bit positions; {n}, {i} and the like mark numbered series; 'fields as' and 'values as' point back to an identical list; <NAME> marks a mode.

## MCU_NAVSS0_UDMASS_RINGACC0_FIFOS
0x00 RINGACC_RINGHEADDATA_j_y — The Ring Head Entry Data Registers contain the data which is to be written or which was read from the ring head. These registers are virtual and non-static (i.e. they are just address locations that are used to access the ring head element for reads or writes. The data is right justified.) Offset = 0h + (j * 1000h) + (y * 4h); where j = 0h to 331h, y = 0h to 7Fh for NAVSS0_UDMASS_RINGACC0_SRC_FIFOS j = 0h to 11Dh, y = 0h to 7Fh for MCU_NAVSS0_UDMASS_RINGACC0_FIFOS
  [31:0] DATA — Block of ring head element data
0x200 RINGACC_RINGTAILDATA_j_y — The Ring Tail Entry Data Registers contain the data which is to be written or which was read from the ring tail. These registers are virtual and non-static (i.e. they are just address locations that are used to access the ring tail element for reads or writes. The data is right justified.) Offset = 200h + (j * 1000h) + (y * 4h); where j = 0h to 331h, y = 0h to 7Fh for NAVSS0_UDMASS_RINGACC0_SRC_FIFOS j = 0h to 11Dh, y = 0h to 7Fh for MCU_NAVSS0_UDMASS_RINGACC0_FIFOS
  [31:0] DATA — Block of ring tail element data
0x400 RINGACC_PEEKHEADDATA_j_y — The Ring Peek Head Entry Data Registers contain the data which is to be read from the ring head without removing the element. These registers are virtual and non-static (i.e. they are just address locations that are used to access the ring head element for reads. Writes are ignored. The data is right justified.) Offset = 400h + (j * 1000h) + (y * 4h); where j = 0h to 331h, y = 0h to 7Fh for NAVSS0_UDMASS_RINGACC0_SRC_FIFOS j = 0h to 11Dh, y = 0h to 7Fh for MCU_NAVSS0_UDMASS_RINGACC0_FIFOS
  [31:0] DATA — Block of ring head element data. Not supported in ring mode.
0x600 RINGACC_PEEKTAILDATA_j_y — The Ring Peek Tail Entry Data Registers contain the data which is to be read from the ring tail without removing the element. These registers are virtual and non-static (i.e. they are just address locations that are used to access the ring tail element for reads. Writes are ignored. The data is right justified.) Offset = 600h + (j * 1000h) + (y * 4h); where j = 0h to 331h, y = 0h to 7Fh for NAVSS0_UDMASS_RINGACC0_SRC_FIFOS j = 0h to 11Dh, y = 0h to 7Fh for MCU_NAVSS0_UDMASS_RINGACC0_FIFOS
  [31:0] DATA — Block of ring tail element data. Not supported in ring mode.
