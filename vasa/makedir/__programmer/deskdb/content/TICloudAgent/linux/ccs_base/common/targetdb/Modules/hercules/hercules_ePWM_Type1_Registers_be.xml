# hercules_ePWM_Type1_Registers_be register map
Vendor: Texas Instruments
Peripheral module from a debugger description file (folder hercules).
Registers are 16-bit, access not given, no defined reset value unless marked. A register's access mark holds for its fields unless they carry their own. Offsets are as the file gives them; lines under a group give offsets from that group; [hi:lo] are bit positions; {n}, {i} and the like mark numbered series; 'fields as' and 'values as' point back to an identical list; <NAME> marks a mode.

## EPWM_REGS — EPWM REGS Registers
0x00 TBSTS — Time Base Status Register
0x02 TBCTL — Time Base Control Register
0x04 TBPHS — Time Base Phase Register
0x08 TBPRD — Time Base Period Register
0x0A TBCTR — Time Base Counter Register
0x0C CMPCTL — Counter Compare Control Register
0x10 CMPA — Counter Compare A Register
0x14 AQCTLA — Action Qualifier Control Register For Output A
0x16 CMPB — Counter Compare B Register
0x18 AQSFRC — Action Qualifier Software Force Register
0x1A AQCTLB — Action Qualifier Control Register For Output B
0x1C DBCTL — Dead-Band Generator Control Register
0x1E AQCSFRC — Action Qualifier Continuous S/W Force Register
0x20 DBFED — Dead-Band Generator Falling Edge Delay Count Register
0x22 DBRED — Dead-Band Generator Rising Edge Delay Count Register
0x24 TZDCSEL — Trip Zone Digital Comparator Select Register
0x26 TZSEL — Trip Zone Select Register
0x28 TZEINT — Trip Zone Enable Interrupt Register
0x2A TZCTL — Trip Zone Control Register
0x2C TZCLR — Trip Zone Clear Register
0x2E TZFLG — Trip Zone Flag Register
0x30 ETSEL — Event Trigger Selection Register
0x32 TZFRC — Trip Zone Force Register
0x34 ETFLG — Event Trigger Flag Register
0x36 ETPS — Event Trigger Pre-Scale Register
0x38 ETFRC — Event Trigger Force Register
0x3A ETCLR — Event Trigger Clear Register
0x3E PCCTL — PWM Chopper Control Register
0x60 DCACTL — Digital Compare A Control Register
0x62 DCTRIPSEL — Digital Compare Trip Select Register
0x64 DCFCTL — Digital Compare Filter Control Register
0x66 DCBCTL — Digital Compare B Control Register
0x68 DCFOFFSET — Digital Compare Filter Offset Register
0x6A DCCAPCTL — Digital Compare Capture Control Register
0x6C DCFWINDOW — Digital Compare Filter Window Register
0x6E DCFOFFSETCNT — Digital Compare Filter Offset Counter Register
0x70 DCCAP — Digital Compare Counter Capture Register
0x72 DCFWINDOWCNT — Digital Compare Filter Window Counter Register
