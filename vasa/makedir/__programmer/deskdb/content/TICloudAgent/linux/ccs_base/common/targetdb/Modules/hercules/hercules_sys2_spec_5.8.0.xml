# hercules_sys2_spec_5.8.0 register map
Vendor: Texas Instruments
Peripheral module from a debugger description file (folder hercules).
Registers are 32-bit, access not given, no defined reset value unless marked. A register's access mark holds for its fields unless they carry their own. Offsets are as the file gives them; lines under a group give offsets from that group; [hi:lo] are bit positions; {n}, {i} and the like mark numbered series; 'fields as' and 'values as' point back to an identical list; <NAME> marks a mode.

## R4_SYS2 — R4 System Registers Second Frame
0x00 PLLCTL3 — PLL Control Register 3
0x08 STCCLKDIV — CPU Logic BIST Clock Divider
0x0C CLKHB_GLBREG — Clock Hibernate Mode Global Enable Register
0x10 CLKHB_RTIDREG — Clocked Hibernate RTI Domain Control Register
0x14 HBCD_STAT — Hibernate Clock Domain Status Register
0x20 CLKTRMI1 — Clock Trim 1 Register
0x3C CLK2CNTRL — Clock 2 Control Register
{0x38+8i} VCLKACON{i} (i=1..3) — Peripheral Asynchronous Clock Configuration {i} Register
0x44 CLK3CNTRL — Clock 3 Control Register
0x54 HCLK1Ctrl — HCLK1 Control Register
0x70 CLKSLIP — Clock Slip Register
0x70 CLK2SLIP — Clock2 Slip Register
0xEC EFC_CTLREG — EFUSE Controller Control Register
0xF0 DIEIDL_REG0 — Die Identification Register Lower Word
0xF4 DIEIDH_REG1 — Die Identification Register Upper Word
0xF8 DIEIDH_REG2 — Die Identification Register Lower Word
0xFC DIEIDH_REG3 — Die Identification Register Upper Word

## Notices in the file
(c) Texas Instruments 2003-2012, All rights reserved.
