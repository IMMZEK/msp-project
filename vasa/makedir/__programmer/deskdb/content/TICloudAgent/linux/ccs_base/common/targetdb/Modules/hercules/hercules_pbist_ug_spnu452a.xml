# hercules_pbist_ug_spnu452a register map
Vendor: Texas Instruments
Peripheral module from a debugger description file (folder hercules).
Registers are 32-bit, access not given, no defined reset value unless marked. A register's access mark holds for its fields unless they carry their own. Offsets are as the file gives them; lines under a group give offsets from that group; [hi:lo] are bit positions; {n}, {i} and the like mark numbered series; 'fields as' and 'values as' point back to an identical list; <NAME> marks a mode.

## Pbist — ProgRammable Built-In Self Test
{0x100+4i} VarAddr{i} (i=0..3) — Variable Address Register {i}
0x110 VarLpCnt0 — Variable Loop Count Register 0
0x114 VarLpCnt1 — Variable Loop Count Register 1
0x118 VarLpCnt2 — Variable Loop Count Register 0
0x11C VarLpCnt3 — Variable Loop Count Register 1
0x120 DD0 — DD0 Data Register
0x124 DE0 — DE0 Data Register
{0x130+4i} ConstAddr{i} (i=0..3) — Constant Address Register {i}
{0x140+4i} ConstLpCnt{i} (i=0..3) — Constant Loop Count Register {i}
{0x150+4i} ConstInc{i} (i=0..3) — Constant Increment Register {i}
0x160 RamT — Ram Configuration
0x164 Dlr — Datalogger
0x168 Cms — ConstLpCntock Mux Select
0x16C Str — ProgRam Control
0x178 Csr — Chip Select
0x17C FDly — Fail Delay
0x180 PAct — PBIST Activate ROM Clock Enable
0x184 IdR — PBIST ID
0x188 Over — PBIST Override
0x190 Fsfr0 — Fail Status Fail - Port 0
0x194 Fsfr1 — Fail Status Fail - Port 1
0x198 Fsrc0 — Fail Status Count - Port 0
0x19C Fsrc1 — Fail Status Count - Port 1
0x1A0 Fsra0 — Fail Status Address - Port 0
0x1A4 Fsra1 — Fail Status Address - Port 1
0x1A8 Fsrdl0 — Fail Status Data - Port 0
0x1B0 Fsrdl1 — Fail Status Data - Port 1
0x1C0 Rom — ROM Mask
0x1C4 Algo — ROM Algorithm Mask
0x1C8 RInfoL — Ram Info Mask Lower
0x1CC RInfoU — Ram Info Mask Upper

## Notices in the file
(c) Texas Instruments 2003-2012, All rights reserved.
