# MSS_DEBUGSS register map
Vendor: Texas Instruments
Peripheral module from a debugger description file (folder awr2544).
Registers are 32-bit, read-write, no defined reset value unless marked. A register's access mark holds for its fields unless they carry their own. Offsets are as the file gives them; lines under a group give offsets from that group; [hi:lo] are bit positions; {n}, {i} and the like mark numbered series; 'fields as' and 'values as' point back to an identical list; <NAME> marks a mode.

## MSS_DEBUGSS
0x00 ONEMCU_APB_BASE ro — Start Address of ROM Table
  [31:0] ONEMCU_APB_BASE — OneMCU APB Space : Start Address of ROM Table
0xFFC ONEMCU_APB_BASE_END ro — End Address of ROM Table
  [31:0] ONEMCU_APB_BASE_END — OneMCU APB Space : Endt Address of ROM Table
0x1000 ONEMCU_CTI_CONTROL — http://infocenter.arm.com/help/topic/com.arm.doc.ddi0314h/Chdjefbi.html http://infocenter.arm.com/help/topic/com.arm.doc.ddi0314h/Chdefejc.html
  [31:0] ONEMCU_CTI_CONTROL — http://infocenter.arm.com/help/topic/com.arm.doc.ddi0480e/CHDGDIHE.html http://infocenter.arm.com/help/topic/com.arm.doc.ddi0480e/CHDHBDIA.html
0x1010 ONEMCU_CTI_INTACK wo
0x1014 ONEMCU_CTI_APPSET
0x1018 ONEMCU_CTI_APPCLEAR wo
0x101C ONEMCU_CTI_APPPULSE wo
{0x1020+4i} ONEMCU_CTI_INEN{i} (i=0..7)
{0x10A0+4i} ONEMCU_CTI_OUTEN{i} (i=0..7)
0x1130 ONEMCU_CTI_TRIGINSTATUS ro
0x1134 ONEMCU_CTI_TRIGOUTSTATUS ro
0x1138 ONEMCU_CTI_CHINSTATUS ro
0x113C ONEMCU_CTI_CHOUTSTATUS ro
0x1140 ONEMCU_CTI_GATE
0x1144 ONEMCU_CTI_ASICCTL
0x1EDC ONEMCU_CTI_ITCHINACK wo
0x1EE0 ONEMCU_CTI_ITTRIGINACK wo
0x1EE4 ONEMCU_CTI_ITCHOUT wo
0x1EE8 ONEMCU_CTI_ITTRIGOUT wo
0x1EEC ONEMCU_CTI_ITCHOUTACK ro
0x1EF0 ONEMCU_CTI_ITTRIGOUTACK ro
0x1EF4 ONEMCU_CTI_ITCHIN ro
0x1EF8 ONEMCU_CTI_ITTRIGIN ro
0x1F00 ONEMCU_CTI_ITCTRL
0x1FA0 ONEMCU_CTI_Claim_Tag_Set
0x1FA4 ONEMCU_CTI_Claim_Tag_Clear
0x1FB0 ONEMCU_CTI_Lock_Access_Register wo
0x1FB4 ONEMCU_CTI_Lock_Status_Register ro
0x1FB8 ONEMCU_CTI_Authentication_Status ro
0x1FC8 ONEMCU_CTI_Device_ID ro
0x1FCC ONEMCU_CTI_Device_Type_Identifier ro
{0x1FC0+4i} ONEMCU_CTI_PeripheralID{i} ro (i=4..7)
{0x1FE0+4i} ONEMCU_CTI_PeripheralID{i} ro (i=0..3)
{0x1FF0+4i} ONEMCU_CTI_Component_ID{i} ro (i=0..3)
0x2000 ONEMCU_TPIU_SPORTSZ ro — Supported port sizes
0x2004 ONEMCU_TPIU_CPORTSZ — Current port size
0x2100 ONEMCU_TPIU_STRIGM ro — Supported trigger modes
0x2104 ONEMCU_TPIU_TRIGCNT — Trigger counter value
0x2108 ONEMCU_TPIU_TRIGMUL — Trigger multiplier
0x2200 ONEMCU_TPIU_STSTPTRN ro — Supported test pattern/modes
0x2204 ONEMCU_TPIU_CTSTPTRN — Current test pattern/mode
0x2208 ONEMCU_TPIU_TPRCNTR — Test pattern repeat counter
0x2300 ONEMCU_TPIU_FFSTS ro — Formatter and flush status
0x2304 ONEMCU_TPIU_FFCTRL — Formatter and flush control
0x2308 ONEMCU_TPIU_FSCNTR — Formatter synchronization counter
0x2400 ONEMCU_TPIU_EXCTLIN ro — EXTCTL In Port
0x2404 ONEMCU_TPIU_EXCTLOUT — EXTCTL Out Port
0x2EE4 ONEMCU_TPIU_ITTRFLINACK wo — Integration Register, ITTRFLINACK
0x2EE8 ONEMCU_TPIU_ITTRFLIN ro — Integration Register, ITTRFLIN
0x2EEC ONEMCU_TPIU_ITATBDATA0 ro — Integration Register, ITATBDATA0
0x2EF0 ONEMCU_TPIU_ITATBCTR2 wo — Integration Register, ITATBCTR2
0x2EF4 ONEMCU_TPIU_ITATBCTR1 ro — Integration Register, ITATBCTR1
0x2EF8 ONEMCU_TPIU_ITATBCTR0 ro — Integration Register, ITATBCTR0
0x2F00 ONEMCU_TPIU_ITCTRL — Integration Mode Control Register
0x2FA0 ONEMCU_TPIU_CLAIMSET — Claim Tag Set
0x2FA4 ONEMCU_TPIU_CLAIMCLR — Claim Tag Clear
0x2FB0 ONEMCU_TPIU_LAR ro — Lock status
0x2FB4 ONEMCU_TPIU_LSR wo — Lock Access
0x2FB8 ONEMCU_TPIU_AUTHSTATUS ro — Authentication status
0x2FC8 ONEMCU_TPIU_DEVID ro — Device ID
0x2FCC ONEMCU_TPIU_DEVTYPE ro — Device type identifier
{0x2FC0+4i} ONEMCU_TPIU_PIDR{i} ro (i=4..7) — Peripheral ID{i}
{0x2FE0+4i} ONEMCU_TPIU_PIDR{i} ro (i=0..3) — Peripheral ID{i}
{0x2FF0+4i} ONEMCU_TPIU_CIDR{i} ro (i=0..3) — Component ID{i}
0x12000 MSS_ATB_IDFILTER0 — ID filtering for ATB master port 0
  [31:0] MSS_ATB_IDFILTER0 — http://infocenter.arm.com/help/topic/com.arm.doc.ddi0480e/CHDFGIED.html http://infocenter.arm.com/help/topic/com.arm.doc.ddi0480e/CHDBDCII.html
0x12004 MSS_ATB_IDFILTER1 — ID filtering for ATB master port 1
0x12EF8 MSS_ATB_ITATBCTR1 ro — Integration Mode ATB Control 1 Register
0x12EFC MSS_ATB_ITATBCTR0 wo — Integration Mode ATB Control 0 Register
0x12F00 MSS_ATB_ITCTRL — Integration Mode Control Register
0x12FA0 MSS_ATB_CLAIMSET — Claim Tag Set Register
0x12FA4 MSS_ATB_CLAIMCLR — Claim Tag Clear Register
0x12FB0 MSS_ATB_LAR wo — Lock Access Register
0x12FB4 MSS_ATB_LSR ro — Lock Status
0x12FB8 MSS_ATB_AUTHSTATUS ro — Authentication Status Register
0x12FC8 MSS_ATB_DEVID ro — Device Configuration Register
0x12FCC MSS_ATB_DEVTYPE ro — Device Type Identifier Register
0x12FD0 MSS_ATB_PIDR4 ro — Peripheral ID4 Register
{0x12FD0+4i} MSS_ATB_RESERVED{i} ro (i=1..3) — Reserved
{0x12FE0+4i} MSS_ATB_PIDR{i} ro (i=0..3) — Peripheral ID{i} Register
{0x12FF0+4i} MSS_ATB_CIDR{i} ro (i=0..3) — Component ID{i} Register
0x13004 ETB_RDP ro — ETBRAMDepthRegister
  [31:0] ETB_RDP — http://infocenter.arm.com/help/topic/com.arm.doc.ddi0480e/CHDIEIAJ.html http://infocenter.arm.com/help/topic/com.arm.doc.ddi0480e/CHDDBEHG.html
0x1300C ETB_STS ro — ETBStatusRegister
0x13010 ETB_RRD ro — ETBRAMReadDataRegister
0x13014 ETB_RRP — ETBRAMReadPointerRegister
0x13018 ETB_RWP — ETBRAMWritePointerRegister
0x1301C ETB_TRG — ETBTriggerCounterRegister
0x13020 ETB_CTL — ETBControlRegister
0x13024 ETB_RWD wo — ETBRAMWriteDataRegister
0x13300 ETB_FFSR ro — ETBFormatterandFlushStatusRegister
0x13304 ETB_FFCR — ETBFormatterandFlushControlRegister
0x13EE0 ETB_ITMISCOP0 wo — IntegrationTestMiscellaneousOutputRegister0
0x13EE4 ETB_ITTRFLINACK wo — IntegrationTestTriggerInandFlushInAcknowledgeRegister
0x13EE8 ETB_ITTRFLIN ro — IntegrationTestTriggerInandFlushInRegister
0x13EEC ETB_ITATBDATA0 ro — IntegrationTestATBDataRegister0
0x13EF0 ETB_ITATBCTR2 wo — IntegrationTestATBControlRegister2
0x13EF4 ETB_ITATBCTR1 ro — IntegrationTestATBControlRegister1
0x13EF8 ETB_ITATBCTR0 ro — IntegrationTestATBControlRegister0
0x13F00 ETB_ITCTRL — IntegrationModeControlRegister
0x13FA0 ETB_CLAIMSET — ClaimTagSetRegister
0x13FA4 ETB_CLAIMCLR — ClaimTagClearRegister
0x13FB0 ETB_LAR wo — LockAccessRegister
0x13FB4 ETB_LSR ro — LockStatusRegister
0x13FB8 ETB_AUTHSTATUS ro — AuthenticationStatusRegister
0x13FC8 ETB_DEVID ro — DeviceConfigurationRegister
0x13FCC ETB_DEVTYPE ro — DeviceTypeIdentifierRegister
0x13FD0 ETB_PIDR4 ro — PeripheralID4Register
{0x13FC4+4i} ETB_RESERVED{i} ro (i=4..6) — Reserved
{0x13FE0+4i} ETB_PIDR{i} ro (i=0..3) — PeripheralID{i}Register
{0x13FF0+4i} ETB_CIDR{i} ro (i=0..3) — ComponentID{i}Register
0x15000 HSM_CM4_ATB_IDFILTER0 — ID filtering for ATB master port 0
  [31:0] HSM_CM4_ATB_IDFILTER0 — http://infocenter.arm.com/help/topic/com.arm.doc.ddi0480e/CHDFGIED.html http://infocenter.arm.com/help/topic/com.arm.doc.ddi0480e/CHDBDCII.html
0x15004 HSM_CM4_ATB_IDFILTER1 — ID filtering for ATB master port 1
0x15EF8 HSM_CM4_ATB_ITATBCTR1 ro — Integration Mode ATB Control 1 Register
0x15EFC HSM_CM4_ATB_ITATBCTR0 wo — Integration Mode ATB Control 0 Register
0x15F00 HSM_CM4_ATB_ITCTRL — Integration Mode Control Register
0x15FA0 HSM_CM4_ATB_CLAIMSET — Claim Tag Set Register
0x15FA4 HSM_CM4_ATB_CLAIMCLR — Claim Tag Clear Register
0x15FB0 HSM_CM4_ATB_LAR wo — Lock Access Register
0x15FB4 HSM_CM4_ATB_LSR ro — Lock Status
0x15FB8 HSM_CM4_ATB_AUTHSTATUS ro — Authentication Status Register
0x15FC8 HSM_CM4_ATB_DEVID ro — Device Configuration Register
0x15FCC HSM_CM4_ATB_DEVTYPE ro — Device Type Identifier Register
0x15FD0 HSM_CM4_ATB_PIDR4 ro — Peripheral ID4 Register
{0x15FD0+4i} HSM_CM4_ATB_RESERVED{i} ro (i=1..3) — Reserved
{0x15FE0+4i} HSM_CM4_ATB_PIDR{i} ro (i=0..3) — Peripheral ID{i} Register
{0x15FF0+4i} HSM_CM4_ATB_CIDR{i} ro (i=0..3) — Component ID{i} Register
0x18000 HSM_CM4_CTI_CONTROL — http://infocenter.arm.com/help/topic/com.arm.doc.ddi0314h/Chdjefbi.html http://infocenter.arm.com/help/topic/com.arm.doc.ddi0314h/Chdefejc.html
  [31:0] HSM_CM4_CTI_CONTROL — http://infocenter.arm.com/help/topic/com.arm.doc.ddi0480e/CHDGDIHE.html http://infocenter.arm.com/help/topic/com.arm.doc.ddi0480e/CHDHBDIA.html
0x18010 HSM_CM4_CTI_INTACK wo
0x18014 HSM_CM4_CTI_APPSET
0x18018 HSM_CM4_CTI_APPCLEAR wo
0x1801C HSM_CM4_CTI_APPPULSE wo
{0x18020+4i} HSM_CM4_CTI_INEN{i} (i=0..7)
{0x180A0+4i} HSM_CM4_CTI_OUTEN{i} (i=0..7)
0x18130 HSM_CM4_CTI_TRIGINSTATUS ro
0x18134 HSM_CM4_CTI_TRIGOUTSTATUS ro
0x18138 HSM_CM4_CTI_CHINSTATUS ro
0x1813C HSM_CM4_CTI_CHOUTSTATUS ro
0x18140 HSM_CM4_CTI_GATE
0x18144 HSM_CM4_CTI_ASICCTL
0x18EDC HSM_CM4_CTI_ITCHINACK wo
0x18EE0 HSM_CM4_CTI_ITTRIGINACK wo
0x18EE4 HSM_CM4_CTI_ITCHOUT wo
0x18EE8 HSM_CM4_CTI_ITTRIGOUT wo
0x18EEC HSM_CM4_CTI_ITCHOUTACK ro
0x18EF0 HSM_CM4_CTI_ITTRIGOUTACK ro
0x18EF4 HSM_CM4_CTI_ITCHIN ro
0x18EF8 HSM_CM4_CTI_ITTRIGIN ro
0x18F00 HSM_CM4_CTI_ITCTRL
0x18FA0 HSM_CM4_CTI_Claim_Tag_Set
0x18FA4 HSM_CM4_CTI_Claim_Tag_Clear
0x18FB0 HSM_CM4_CTI_Lock_Access_Register wo
0x18FB4 HSM_CM4_CTI_Lock_Status_Register ro
0x18FB8 HSM_CM4_CTI_Authentication_Status ro
0x18FC8 HSM_CM4_CTI_Device_ID ro
0x18FCC HSM_CM4_CTI_Device_Type_Identifier ro
{0x18FC0+4i} HSM_CM4_CTI_PeripheralID{i} ro (i=4..7)
{0x18FE0+4i} HSM_CM4_CTI_PeripheralID{i} ro (i=0..3)
{0x18FF0+4i} HSM_CM4_CTI_Component_ID{i} ro (i=0..3)
0x1A000 RSS_APB_DBGDIDR — Debug Identification Register
  [31:0] RSS_APB_DBGDIDR — http://infocenter.arm.com/help/topic/com.arm.doc.ddi0363e/Cegejeeb.html Debug Identification Register
0x1A018 RSS_APB_DBGWFAR — Watchpoint Fault Address Register
0x1A01C RSS_APB_DBGVCR — Vector Catch Register
0x1A024 RSS_APB_DBGECR — Not Implemented
0x1A028 RSS_APB_DBGDSCCR — Debug State Cache Control Register
0x1A080 RSS_APB_DBGDTRRX — Host to Target Data Transfer Register
0x1A084 RSS_APB_DBGITR — Instruction Transfer Register
0x1A088 RSS_APB_DBGDSCR — Debug Status and Control Register
0x1A08C RSS_APB_DBGDTRTX — Target to Host Data Transfer Register
0x1A090 RSS_APB_DBGDRCR — Debug Run Control Register
{0x1A100+4i} RSS_APB_DBGBVR{i} (i=0..7) — Break Point Value Register {i}
{0x1A140+4i} RSS_APB_DBGBCR{i} (i=0..7) — Break Point Control Register {i}
{0x1A180+4i} RSS_APB_DBGWVR{i} (i=0..7) — Watch Point Value Register {i}
{0x1A1C0+4i} RSS_APB_DBGWCR{i} (i=0..7) — Watch Point Control Register {i}
0x1A300 RSS_APB_DBGOSLAR — Not Implemented
0x1A304 RSS_APB_DBGOSLSR — Operating System Lock Status Register
0x1A308 RSS_APB_DBGOSSRR — Not Implemented
0x1A310 RSS_APB_DBGPRCR — Device Power Down and Reset Control Regsiter
0x1A314 RSS_APB_DBGPRSR — Device Power Down and Reset Status Register
0x1AD00 RSS_APB_PROCID_MIDR — Main ID Register
0x1AD04 RSS_APB_PROCID_CTR — Cache Type Register
0x1AD08 RSS_APB_PROCID_TCMTR — TCM Type Register
0x1AD10 RSS_APB_PROCID_MPUIR — MPU Type Register
0x1AD14 RSS_APB_PROCID_MPIDR — Multiprocessor Affinity Register
0x1AD20 RSS_APB_PROCID_PFR0 — Processor Feature Register 0
0x1AD24 RSS_APB_PROCID_PFR1 — Processor Feature Register 1
0x1AD28 RSS_APB_PROCID_DFR0 — Debug Feature Register 0
0x1AD2C RSS_APB_PROCID_AFR0 — Auxiliary Feature Register 0
0x1AD30 RSS_APB_PROCID_MMFR0 — Processor Feature Register 0
{0x1AD30+4i} RSS_APB_PROCID_MMFR{i} (i=1..3) — Memory Model Feature Register {i}
{0x1AD40+4i} RSS_APB_PROCID_ISAR{i} (i=0..5) — ISA Feature Register {i}
0x1AF00 RSS_APB_MR_ITCTRL — Integration Mode Control Registers
0x1AFA0 RSS_APB_MR_CLAIMSET — Claim Tag Set Register
0x1AFA4 RSS_APB_MR_CLAIMCLR — Claim Tag Clear Register
0x1AFB0 RSS_APB_MR_LOCKACCESS — Lock Access Register
0x1AFB4 RSS_APB_MR_LOCKSTATUS — Lock Status Register
0x1AFB8 RSS_APB_MR_AUTHSTATUS — Authentication Status Register
0x1AFC8 RSS_APB_MR_DEVID — Device Identifier
0x1AFCC RSS_APB_MR_DEVTYPE — Device Type Register
0x1AFD0 RSS_APB_PERIP_ID4
{0x1AFE0+4i} RSS_APB_PERIP_ID{i} (i=0..3)
{0x1AFF0+4i} RSS_APB_COMP_ID{i} (i=0..3)
0x30000 MSS_A_APB_DBGDIDR — Debug Identification Register
  [31:0] MSS_APB_DBGDIDR — http://infocenter.arm.com/help/topic/com.arm.doc.ddi0363e/Cegejeeb.html Debug Identification Register
0x30018 MSS_A_APB_DBGWFAR — Watchpoint Fault Address Register
  [31:0] MSS_APB_DBGWFAR
0x3001C MSS_A_APB_DBGVCR — Vector Catch Register
  [31:0] MSS_APB_DBGVCR
0x30024 MSS_A_APB_DBGECR — Not Implemented
  [31:0] MSS_APB_DBGECR
0x30028 MSS_A_APB_DBGDSCCR — Debug State Cache Control Register
  [31:0] MSS_APB_DBGDSCCR
0x30080 MSS_A_APB_DBGDTRRX — Host to Target Data Transfer Register
  [31:0] MSS_APB_DBGDTRRX
0x30084 MSS_A_APB_DBGITR — Instruction Transfer Register
  [31:0] MSS_APB_DBGITR
0x30088 MSS_A_APB_DBGDSCR — Debug Status and Control Register
  [31:0] MSS_APB_DBGDSCR
0x3008C MSS_A_APB_DBGDTRTX — Target to Host Data Transfer Register
  [31:0] MSS_APB_DBGDTRTX
0x30090 MSS_A_APB_DBGDRCR — Debug Run Control Register
  [31:0] MSS_APB_DBGDRCR
{0x30100+4i} MSS_A_APB_DBGBVR{i} (i=0..7) — Break Point Value Register {i}
  [31:0] MSS_APB_DBGBVR{i}
{0x30140+4i} MSS_A_APB_DBGBCR{i} (i=0..7) — Break Point Control Register {i}
  [31:0] MSS_APB_DBGBCR{i}
{0x30180+4i} MSS_A_APB_DBGWVR{i} (i=0..7) — Watch Point Value Register {i}
  [31:0] MSS_APB_DBGWVR{i}
{0x301C0+4i} MSS_A_APB_DBGWCR{i} (i=0..7) — Watch Point Control Register {i}
  [31:0] MSS_APB_DBGWCR{i}
0x30300 MSS_A_APB_DBGOSLAR — Not Implemented
  [31:0] MSS_APB_DBGOSLAR
0x30304 MSS_A_APB_DBGOSLSR — Operating System Lock Status Register
  [31:0] MSS_APB_DBGOSLSR
0x30308 MSS_A_APB_DBGOSSRR — Not Implemented
  [31:0] MSS_APB_DBGOSSRR
0x30310 MSS_A_APB_DBGPRCR — Device Power Down and Reset Control Regsiter
  [31:0] MSS_APB_DBGPRCR
0x30314 MSS_A_APB_DBGPRSR — Device Power Down and Reset Status Register
  [31:0] MSS_APB_DBGPRSR
0x30D00 MSS_A_APB_PROCID_MIDR — Main ID Register
  [31:0] MSS_APB_PROCID_MIDR
0x30D04 MSS_A_APB_PROCID_CTR — Cache Type Register
  [31:0] MSS_APB_PROCID_CTR
0x30D08 MSS_A_APB_PROCID_TCMTR — TCM Type Register
  [31:0] MSS_APB_PROCID_TCMTR
0x30D10 MSS_A_APB_PROCID_MPUIR — MPU Type Register
  [31:0] MSS_APB_PROCID_MPUIR
0x30D14 MSS_A_APB_PROCID_MPIDR — Multiprocessor Affinity Register
  [31:0] MSS_APB_PROCID_MPIDR
0x30D20 MSS_A_APB_PROCID_PFR0 — Processor Feature Register 0
  [31:0] MSS_APB_PROCID_PFR0
0x30D24 MSS_A_APB_PROCID_PFR1 — Processor Feature Register 1
  [31:0] MSS_APB_PROCID_PFR1
0x30D28 MSS_A_APB_PROCID_DFR0 — Debug Feature Register 0
  [31:0] MSS_APB_PROCID_DFR0
0x30D2C MSS_A_APB_PROCID_AFR0 — Auxiliary Feature Register 0
  [31:0] MSS_APB_PROCID_AFR0
0x30D30 MSS_A_APB_PROCID_MMFR0 — Processor Feature Register 0
  [31:0] MSS_APB_PROCID_MMFR0
{0x30D30+4i} MSS_A_APB_PROCID_MMFR{i} (i=1..3) — Memory Model Feature Register {i}
  [31:0] MSS_APB_PROCID_MMFR{i}
{0x30D40+4i} MSS_A_APB_PROCID_ISAR{i} (i=0..5) — ISA Feature Register {i}
  [31:0] MSS_APB_PROCID_ISAR{i}
0x30F00 MSS_A_APB_MR_ITCTRL — Integration Mode Control Registers
  [31:0] MSS_APB_MR_ITCTRL
0x30FA0 MSS_A_APB_MR_CLAIMSET — Claim Tag Set Register
  [31:0] MSS_APB_MR_CLAIMSET
0x30FA4 MSS_A_APB_MR_CLAIMCLR — Claim Tag Clear Register
  [31:0] MSS_APB_MR_CLAIMCLR
0x30FB0 MSS_A_APB_MR_LOCKACCESS — Lock Access Register
  [31:0] MSS_APB_MR_LOCKACCESS
0x30FB4 MSS_A_APB_MR_LOCKSTATUS — Lock Status Register
  [31:0] MSS_APB_MR_LOCKSTATUS
0x30FB8 MSS_A_APB_MR_AUTHSTATUS — Authentication Status Register
  [31:0] MSS_APB_MR_AUTHSTATUS
0x30FC8 MSS_A_APB_MR_DEVID — Device Identifier
  [31:0] MSS_APB_MR_DEVID
0x30FCC MSS_A_APB_MR_DEVTYPE — Device Type Register
  [31:0] MSS_APB_MR_DEVTYPE
0x30FD0 MSS_A_APB_PERIP_ID4
  [31:0] MSS_APB_PERIP_ID4
{0x30FE0+4i} MSS_A_APB_PERIP_ID{i} (i=0..3)
  [31:0] MSS_APB_PERIP_ID{i}
{0x30FF0+4i} MSS_A_APB_COMP_ID{i} (i=0..3)
  [31:0] MSS_APB_COMP_ID{i}
0x38000 MSS_A_CTI_CONTROL — http://infocenter.arm.com/help/topic/com.arm.doc.ddi0314h/Chdjefbi.html http://infocenter.arm.com/help/topic/com.arm.doc.ddi0314h/Chdefejc.html
  [31:0] MSS_CTI_CONTROL — http://infocenter.arm.com/help/topic/com.arm.doc.ddi0480e/CHDGDIHE.html http://infocenter.arm.com/help/topic/com.arm.doc.ddi0480e/CHDHBDIA.html
0x38010 MSS_A_CTI_INTACK wo
  [31:0] MSS_CTI_INTACK
0x38014 MSS_A_CTI_APPSET
  [31:0] MSS_CTI_APPSET
0x38018 MSS_A_CTI_APPCLEAR wo
  [31:0] MSS_CTI_APPCLEAR
0x3801C MSS_A_CTI_APPPULSE wo
  [31:0] MSS_CTI_APPPULSE
{0x38020+4i} MSS_A_CTI_INEN{i} (i=0..7)
  [31:0] MSS_CTI_INEN{i}
{0x380A0+4i} MSS_A_CTI_OUTEN{i} (i=0..7)
  [31:0] MSS_CTI_OUTEN{i}
0x38130 MSS_A_CTI_TRIGINSTATUS ro
  [31:0] MSS_CTI_TRIGINSTATUS
0x38134 MSS_A_CTI_TRIGOUTSTATUS ro
  [31:0] MSS_CTI_TRIGOUTSTATUS
0x38138 MSS_A_CTI_CHINSTATUS ro
  [31:0] MSS_CTI_CHINSTATUS
0x3813C MSS_A_CTI_CHOUTSTATUS ro
  [31:0] MSS_CTI_CHOUTSTATUS
0x38140 MSS_A_CTI_GATE
  [31:0] MSS_CTI_GATE
0x38144 MSS_A_CTI_ASICCTL
  [31:0] MSS_CTI_ASICCTL
0x38EDC MSS_A_CTI_ITCHINACK wo
  [31:0] MSS_CTI_ITCHINACK
0x38EE0 MSS_A_CTI_ITTRIGINACK wo
  [31:0] MSS_CTI_ITTRIGINACK
0x38EE4 MSS_A_CTI_ITCHOUT wo
  [31:0] MSS_CTI_ITCHOUT
0x38EE8 MSS_A_CTI_ITTRIGOUT wo
  [31:0] MSS_CTI_ITTRIGOUT
0x38EEC MSS_A_CTI_ITCHOUTACK ro
  [31:0] MSS_CTI_ITCHOUTACK
0x38EF0 MSS_A_CTI_ITTRIGOUTACK ro
  [31:0] MSS_CTI_ITTRIGOUTACK
0x38EF4 MSS_A_CTI_ITCHIN ro
  [31:0] MSS_CTI_ITCHIN
0x38EF8 MSS_A_CTI_ITTRIGIN ro
  [31:0] MSS_CTI_ITTRIGIN
0x38F00 MSS_A_CTI_ITCTRL
  [31:0] MSS_CTI_ITCTRL
0x38FA0 MSS_A_CTI_Claim_Tag_Set
  [31:0] MSS_CTI_Claim_Tag_Set
0x38FA4 MSS_A_CTI_Claim_Tag_Clear
  [31:0] MSS_CTI_Claim_Tag_Clear
0x38FB0 MSS_A_CTI_Lock_Access_Register wo
  [31:0] MSS_CTI_Lock_Access_Register
0x38FB4 MSS_A_CTI_Lock_Status_Register ro
  [31:0] MSS_CTI_Lock_Status_Register
0x38FB8 MSS_A_CTI_Authentication_Status ro
  [31:0] MSS_CTI_Authentication_Status
0x38FC8 MSS_A_CTI_Device_ID ro
  [31:0] MSS_CTI_Device_ID
0x38FCC MSS_A_CTI_Device_Type_Identifier ro
  [31:0] MSS_CTI_Device_Type_Identifier
{0x38FC0+4i} MSS_A_CTI_PeripheralID{i} ro (i=4..7)
  [31:0] MSS_CTI_PeripheralID{i}
{0x38FE0+4i} MSS_A_CTI_PeripheralID{i} ro (i=0..3)
  [31:0] MSS_CTI_PeripheralID{i}
{0x38FF0+4i} MSS_A_CTI_Component_ID{i} ro (i=0..3)
  [31:0] MSS_CTI_Component_ID{i}
0x3C000 MSS_A_ETM_CR
  [31:0] MSS_ETM_CR — http://infocenter.arm.com/help/index.jsp?topic=/com.arm.doc.ihi0014q/Chdfiagc.html http://infocenter.arm.com/help/topic/com.arm.doc.ihi0014q/I84249.html
0x3C004 MSS_A_ETM_CCR ro
  [31:0] MSS_ETM_CCR
0x3C008 MSS_A_ETM_TRIGGER
  [31:0] MSS_ETM_TRIGGER
0x3C00C MSS_A_ETM_ASICCTLR
  [31:0] MSS_ETM_ASICCTLR
0x3C010 MSS_A_ETM_SR
  [31:0] MSS_ETM_SR
0x3C014 MSS_A_ETM_SCR ro
  [31:0] MSS_ETM_SCR
0x3C018 MSS_A_ETM_TSSCR
  [31:0] MSS_ETM_TSSCR
0x3C01C MSS_A_ETM_TECR2
  [31:0] MSS_ETM_TECR2
0x3C020 MSS_A_ETM_TEEVR
  [31:0] MSS_ETM_TEEVR
0x3C024 MSS_A_ETM_TECR1
  [31:0] MSS_ETM_TECR1
0x3C028 MSS_A_ETM_FFRR
  [31:0] MSS_ETM_FFRR
0x3C02C MSS_A_ETM_FFLR
  [31:0] MSS_ETM_FFLR
0x3C030 MSS_A_ETM_VDEVR
  [31:0] MSS_ETM_VDEVR
{0x3C030+4i} MSS_A_ETM_VDCR{i} (i=1..3)
  [31:0] MSS_ETM_VDCR{i}
{0x3C03C+4i} MSS_A_ETM_ACVR{i} (i=1..16)
  [31:0] MSS_ETM_ACVR{i}
{0x3C07C+4i} MSS_A_ETM_ACTR{i} (i=1..16)
  [31:0] MSS_ETM_ACTR{i}
{0x3C0B8+8i} MSS_A_ETM_DCVR{i} (i=1..8)
  [31:0] MSS_ETM_DCVR{i}
{0x3C0F8+8i} MSS_A_ETM_DCMR{i} (i=1..8)
  [31:0] MSS_ETM_DCMR{i}
{0x3C13C+4i} MSS_A_ETM_CNTRLDVR{i} (i=1..4)
  [31:0] MSS_ETM_CNTRLDVR{i}
{0x3C14C+4i} MSS_A_ETM_CNTENR{i} (i=1..4)
  [31:0] MSS_ETM_CNTENR{i}
{0x3C15C+4i} MSS_A_ETM_CNTRLDEVR{i} (i=1..4)
  [31:0] MSS_ETM_CNTRLDEVR{i}
{0x3C16C+4i} MSS_A_ETM_CNTVR{i} (i=1..4)
  [31:0] MSS_ETM_CNTVR{i}
0x3C180 MSS_A_ETM_SQ12EVR
  [31:0] MSS_ETM_SQ12EVR
0x3C184 MSS_A_ETM_SQ21EVR
  [31:0] MSS_ETM_SQ21EVR
0x3C188 MSS_A_ETM_SQ23EVR
  [31:0] MSS_ETM_SQ23EVR
0x3C18C MSS_A_ETM_SQ31EVR
  [31:0] MSS_ETM_SQ31EVR
0x3C190 MSS_A_ETM_SQ32EVR
  [31:0] MSS_ETM_SQ32EVR
0x3C194 MSS_A_ETM_SQ13EVR
  [31:0] MSS_ETM_SQ13EVR
0x3C19C MSS_A_ETM_SQR
  [31:0] MSS_ETM_SQR
{0x3C19C+4i} MSS_A_ETM_EXTOUTEVR{i} (i=1..4)
  [31:0] MSS_ETM_EXTOUTEVR{i}
{0x3C1AC+4i} MSS_A_ETM_CIDCVR{i} (i=1..3)
  [31:0] MSS_ETM_CIDCVR{i}
0x3C1BC MSS_A_ETM_CIDCMR
  [31:0] MSS_ETM_CIDCMR
0x3C1E0 MSS_A_ETM_SYNCFR
  [31:0] MSS_ETM_SYNCFR
0x3C1E4 MSS_A_ETM_IDR ro
  [31:0] MSS_ETM_IDR
0x3C1E8 MSS_A_ETM_CCER ro
  [31:0] MSS_ETM_CCER
0x3C1EC MSS_A_ETM_EXTINSELR
  [31:0] MSS_ETM_EXTINSELR
0x3C200 MSS_A_ETM_TRACEIDR
  [31:0] MSS_ETM_TRACEIDR
0x3C314 MSS_A_ETM_PDSR ro
  [31:0] MSS_ETM_PDSR
0x3CED8 MSS_A_ETM_ITETMIF ro
  [31:0] MSS_ETM_ITETMIF
0x3CEDC MSS_A_ETM_ITMISCOUT wo
  [31:0] MSS_ETM_ITMISCOUT
0x3CEE0 MSS_A_ETM_ITMISCIN ro
  [31:0] MSS_ETM_ITMISCIN
0x3CEE4 MSS_A_ETM_ITTRIGGERACK ro
  [31:0] MSS_ETM_ITTRIGGERACK
0x3CEE8 MSS_A_ETM_ITTRIGGERREQ wo
  [31:0] MSS_ETM_ITTRIGGERREQ
0x3CEEC MSS_A_ETM_ITATBDATA0 wo
  [31:0] MSS_ETM_ITATBDATA0
0x3CEF0 MSS_A_ETM_ITATBCTR2 ro
  [31:0] MSS_ETM_ITATBCTR2
0x3CEF4 MSS_A_ETM_ITATBCTR1 wo
  [31:0] MSS_ETM_ITATBCTR1
0x3CEF8 MSS_A_ETM_ITATBCTR0 wo
  [31:0] MSS_ETM_ITATBCTR0
0x3CF00 MSS_A_ETM_ITCTRL
  [31:0] MSS_ETM_ITCTRL
0x3CFA0 MSS_A_ETM_CLAIMSET
  [31:0] MSS_ETM_CLAIMSET
0x3CFA4 MSS_A_ETM_CLAIMCLR
  [31:0] MSS_ETM_CLAIMCLR
0x3CFB0 MSS_A_ETM_LAR wo
  [31:0] MSS_ETM_LAR
0x3CFB4 MSS_A_ETM_LSR ro
  [31:0] MSS_ETM_LSR
0x3CFB8 MSS_A_ETM_AUTHSTATUS ro
  [31:0] MSS_ETM_AUTHSTATUS
0x3CFC8 MSS_A_ETM_DEVID ro
  [31:0] MSS_ETM_DEVID
0x3CFCC MSS_A_ETM_DEVTYPE ro
  [31:0] MSS_ETM_DEVTYPE
{0x3CFC0+4i} MSS_A_ETM_PIDR{i} ro (i=4..7)
  [31:0] MSS_ETM_PIDR{i}
{0x3CFE0+4i} MSS_A_ETM_PIDR{i} ro (i=0..3)
  [31:0] MSS_ETM_PIDR{i}
{0x3CFF0+4i} MSS_A_ETM_CIDR{i} ro (i=0..3)
  [31:0] MSS_ETM_CIDR{i}
