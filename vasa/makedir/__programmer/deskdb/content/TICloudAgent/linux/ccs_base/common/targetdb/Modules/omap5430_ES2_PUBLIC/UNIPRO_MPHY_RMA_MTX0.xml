# UNIPRO_MPHY_RMA_MTX0 register map
Vendor: Texas Instruments
Peripheral module from a debugger description file (folder omap5430_ES2_PUBLIC).
Registers are 32-bit, read-write, reset 0x0 unless marked. A register's access mark holds for its fields unless they carry their own. Offsets are as the file gives them; lines under a group give offsets from that group; [hi:lo] are bit positions; {n}, {i} and the like mark numbered series; 'fields as' and 'values as' point back to an identical list; <NAME> marks a mode.

## UNIPRO_MPHY_RMA_MTX0
0x00 UNIPRO_MPHY_ATTRIBUTE_0_3 — Note: These are not physical registers within UniPro, but are address ranges to be used for accessing M-PHY attributes.
  [31:0] VALUE
0x7C UNIPRO_MPHY_ATTRIBUTE_124_127 — Note: These are not physical registers within UniPro, but are address ranges to be used for accessing M-PHY attributes.
  [31:0] VALUE
