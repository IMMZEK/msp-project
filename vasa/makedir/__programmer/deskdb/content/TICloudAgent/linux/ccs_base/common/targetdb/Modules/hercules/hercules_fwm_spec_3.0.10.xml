# hercules_fwm_spec_3.0.10 register map
Vendor: Texas Instruments
Peripheral module from a debugger description file (folder hercules).
Registers are 32-bit, access not given, no defined reset value unless marked. A register's access mark holds for its fields unless they carry their own. Offsets are as the file gives them; lines under a group give offsets from that group; [hi:lo] are bit positions; {n}, {i} and the like mark numbered series; 'fields as' and 'values as' point back to an identical list; <NAME> marks a mode.

## Fwm — Flash Wrapper Module
0x00 FRdCntl — Read Control Register
0x04 FSpRd — Special Read Control Register
0x08 FEdacCtrl1 — Error Correction Control Register1
0x0C FEdacCtrl2 — Error Correction Control Register2
0x10 FCorErrCnt — Error Correction Counter Register
0x14 FCorErrAddr — Correctable Error Address
0x18 FCorErrPos — Correctable Error Position Register
0x1C FEdacStat — Error Status Register
0x20 FUncErrAddr — Un-correctable Error Address
0x24 FEdacSDis — Error Detection Sector Disable
0x28 FPprimAddrTag — Primary Address Tag Register
0x2C FReduAddrTag — Redundant Address Tag Register
0x30 FBnkProt — Bank Protection Register
0x34 FBnkSec — Bank Sector Enable Register
0x38 FBusy — Bank Busy Register
0x3C FBnkAcc — Bank Access Control Register
0x40 FBnkFallback — Bank Fallback Power Register
0x44 FBnkPmpRdy — Bank/Pump Ready Register
0x48 FPmpAcc1 — Pump Access Control Register 1
0x4C FPmpAcc2 — Pump Access Control Register 2
0x50 FMdlAcc — Module Access Control Register
0x54 FMdlStat — Module Status Register
0x58 FEmuDatMsw — EEPROM Emulation Data MSW Register
0x5C FEmuDatLsw — EEPROM Emulation Data LSW Register
0x60 FEmuEcc — EEPROM Emulation ECC Register
0x64 FLock — Flash Lock Register
0x68 FEmuAddr — EEPROM Emulation Address
0x6C FDiagCtrl — Diagnostic Control Register
0x70 FRawDataH — Uncorrected Raw Data High
0x74 FRawDataL — Uncorrected Raw Data Low
0x78 FRawEcc — Uncorrected Raw ECC
0x7C FParOvr — Parity Override
0xC0 FEdacSDis2 — Error Detection Sector Disable Register 2

## Notices in the file
(c) Texas Instruments 2003-2012, All rights reserved.
