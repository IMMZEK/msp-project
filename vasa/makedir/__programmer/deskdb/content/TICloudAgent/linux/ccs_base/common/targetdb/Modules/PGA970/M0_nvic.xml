# M0_nvic register map
Vendor: Texas Instruments
Peripheral module from a debugger description file (folder PGA970).
Registers are 32-bit, access not given, no defined reset value unless marked. A register's access mark holds for its fields unless they carry their own. Offsets are as the file gives them; lines under a group give offsets from that group; [hi:lo] are bit positions; {n}, {i} and the like mark numbered series; 'fields as' and 'values as' point back to an identical list; <NAME> marks a mode.

## M0_Interrupt — M0 Interrupt Registers
0x100 ISER — Interrupt Set-Enable Register
0x180 ICER — Interrupt Clear-Enable Register
0x200 ISPR — Interrupt Set-Pending Register
0x280 ICPR — Interrupt Clear-Pending Register
0x400 IPR0 — Interrupt Priority Register
0x404 IPR1 — Interrupt Priority Register
