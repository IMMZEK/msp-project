# apps_config register map
Vendor: Texas Instruments
Peripheral module from a debugger description file (folder cc32).
Registers are 32-bit, read-write, no defined reset value unless marked. A register's access mark holds for its fields unless they carry their own. Offsets are as the file gives them; lines under a group give offsets from that group; [hi:lo] are bit positions; {n}, {i} and the like mark numbered series; 'fields as' and 'values as' point back to an identical list; <NAME> marks a mode.

## apps_config
0x00 PATCH_TRAP_ADDR_REG access not given — Patch trap address Register array
0x78 PATCH_TRAP_EN_REG
  [29:0] PATCH_TRAP_EN — When PATCH_TRAP_EN[n] is set bus fault is generated for the address PATCH_TRAP_ADD[n][31:0] from Idcode bus. The exception routine should take care to jump to the location where the patch correspond to this address is kept.
0x7C FAULT_STATUS_REG
  [5:1] PATCH_ERR_INDEX — This field shows because of which patch trap address the bus_fault is generated. If the PATCH_ERR bit is set, then it means the bus fault is generated because of PATCH_TRAP_ADDR_REG[2^PATCH_ERR_INDEX]
0x80 MEMSS_WR_ERR_CLR_REG access not given
0x84 MEMSS_WR_ERR_ADDR_REG access not given
0x8C DMA_DONE_INT_MASK
  [15:12] ADC_WR_DMA_DONE_INT_MASK — 1= disable corresponding interrupt;0 = interrupt enabled bit 14: ADC channel 7 interrupt enable/disable bit 13: ADC channel 5 interrupt enable/disable bit 12: ADC channel 3 interrupt enable/disable bit 11: ADC channel 1 interrupt enable/disable
0x90 DMA_DONE_INT_MASK_SET
  [15:12] ADC_WR_DMA_DONE_INT_MASK_SET — write 1 to set mask of the corresponding DMA DONE IRQ;0 = no effect bit 14: ADC channel 7 DMA Done IRQ bit 13: ADC channel 5 DMA Done IRQ bit 12: ADC channel 3 DMA Done IRQ bit 11: ADC channel 1 DMA Done IRQ
0x94 DMA_DONE_INT_MASK_CLR
  [15:12] ADC_WR_DMA_DONE_INT_MASK_CLR — write 1 to clear mask of the corresponding DMA DONE IRQ;0 = no effect bit 14: ADC channel 7 DMA Done IRQ mask bit 13: ADC channel 5 DMA Done IRQ mask bit 12: ADC channel 3 DMA Done IRQ mask bit 11: ADC channel 1 DMA Done IRQ mask
0x98 DMA_DONE_INT_STS_CLR access not given
0x9C DMA_DONE_INT_ACK
  [15:12] ADC_WR_DMA_DONE_INT_ACK — write 1 to clear corresponding interrupt; 0 = no effect; bit 14: ADC channel 7 DMA Done IRQ bit 13: ADC channel 5 DMA Done IRQ bit 12: ADC channel 3 DMA Done IRQ bit 11: ADC channel 1 DMA Done IRQ
0xA0 DMA_DONE_INT_STS_MASKED
  [15:12] ADC_WR_DMA_DONE_INT_STS_MASKED — 1= corresponding interrupt is active and not masked. read is non-destructive;0 = corresponding interrupt is inactive or masked by DMA_DONE_INT mask bit 14: ADC channel 7 DMA Done IRQ bit 13: ADC channel 5 DMA Done IRQ bit 12: ADC channel 3 DMA Done IRQ bit 11: ADC channel 1 DMA Done IRQ
0xA4 DMA_DONE_INT_STS_RAW
  [15:12] ADC_WR_DMA_DONE_INT_STS_RAW — 1= corresponding interrupt is active. read is non-destructive;0 = corresponding interrupt is inactive bit 14: ADC channel 7 DMA Done IRQ bit 13: ADC channel 5 DMA Done IRQ bit 12: ADC channel 3 DMA Done IRQ bit 11: ADC channel 1 DMA Done IRQ
0xA8 FAULT_STATUS_CLR_REG access not given
0xAC RESERVD_REG_0 access not given
0xB0 GPT_TRIG_SEL
  [7:0] GPT_TRIG_SEL — This bit is implemented for GPT trigger mode select. GPT IP support 2 modes: RTC mode and external trigger. When this bit is set to logic '1': enable external trigger mode for APPS GPT CP0 and CP1 pin. bit 0: when set '1' enable external GPT trigger 0 on GPIO0 CP0 pin else RTC mode is selected. bit 1: when set '1' enable external GPT trigger 1 on GPIO0 CP1 pin else RTC mode is selected. bit 2: when set '1' enable external GPT trigger 2 on GPIO1 CP0 pin else RTC mode is selected. bit 3: when set '1' enable external GPT trigger 3 on GPIO1 CP1 pin else RTC mode is selected. bit 4: when set '1' enable external GPT trigger 4 on GPIO2 CP0 pin else RTC mode is selected. bit 5: when set '1' enable external GPT trigger 5 on GPIO2 CP1 pin else RTC mode is selected. bit 6: when set '1' enable external GPT trigger 6 on GPIO3 CP0 pin else RTC mode is selected. bit 7: when set '1' enable external GPT trigger 7 on GPIO3 CP1 pin else RTC mode is selected.
0xB4 TOP_DIE_SPARE_DIN_REG
  [2:0] D2D_SPARE_DIN — Capture data from d2d_spare pads
0xB8 TOP_DIE_SPARE_DOUT_REG
  [2:0] D2D_SPARE_DOUT — Send data to d2d_spare pads - eventually this will get registered in top die
