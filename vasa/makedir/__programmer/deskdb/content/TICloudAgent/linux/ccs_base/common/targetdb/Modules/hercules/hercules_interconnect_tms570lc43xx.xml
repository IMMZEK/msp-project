# hercules_interconnect_tms570lc43xx register map
Vendor: Texas Instruments
Peripheral module from a debugger description file (folder hercules).
Registers are 32-bit, access not given, no defined reset value unless marked. A register's access mark holds for its fields unless they carry their own. Offsets are as the file gives them; lines under a group give offsets from that group; [hi:lo] are bit positions; {n}, {i} and the like mark numbered series; 'fields as' and 'values as' point back to an identical list; <NAME> marks a mode.

## interconnect_tms570lc43xx — CPU Subsystem Interconnect for Conqueror device
0x00 StcStat — Interconnect selftest status register
0x04 StcCtrl — Interconnect selftest control register
0x08 ParityErrStat — Parity Error Status
0x0C TransErrStat — Transaction Error Status
0x10 TransIdErrStat — Transaction ID Error Status
0x14 TransSigErrStat — Transaction Signature Error Status
0x18 TransTypErrStat — Transaction Type Error Status
0x1C ErrUserParity — Error User Parity
0x20 SerrUnexpMid — MasterID mistmatch status register
0x24 SerrAddrDecode — Address mismatch status register
0x28 SerrUserParity — Parity on address status register

## Notices in the file
(c) Texas Instruments 2003-2012, All rights reserved.
