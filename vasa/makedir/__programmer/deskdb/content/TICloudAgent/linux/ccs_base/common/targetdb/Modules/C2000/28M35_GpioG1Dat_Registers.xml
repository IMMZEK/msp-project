# 28M35_GpioG1Dat_Registers register map
Vendor: Texas Instruments
Peripheral module from a debugger description file (folder C2000).
Address unit: 16 bits
Registers are 32-bit, access not given, no defined reset value unless marked. A register's access mark holds for its fields unless they carry their own. Offsets are as the file gives them; lines under a group give offsets from that group; [hi:lo] are bit positions; {n}, {i} and the like mark numbered series; 'fields as' and 'values as' point back to an identical list; <NAME> marks a mode.

## GPIOG1_DATA_REGS — GPIOG1 DATA REGS Registers
0x00 GPADAT — GPIO A Data Register (GPIO0 to 31)
0x02 GPASET — GPIO A Data Set Register (GPIO0 to 31)
0x04 GPACLEAR — GPIO A Data Clear Register (GPIO0 to 31)
0x06 GPATOGGLE — GPIO A Data Toggle Register (GPIO0 to 31)
0x08 GPBDAT — GPIO B Data Register (GPIO32 to 63)
0x0A GPBSET — GPIO B Data Set Register (GPIO32 to 63)
0x0C GPBCLEAR — GPIO B Data Clear Register (GPIO32 to 63)
0x0E GPBTOGGLE — GPIO B Data Toggle Register (GPIO32 to 63)
0x10 GPCDAT — GPIO C Data Register (GPIO68 to 71)
0x12 GPCSET — GPIO C Data Set Register (GPIO68 to 71)
0x14 GPCCLEAR — GPIO C Data Clear Register (GPIO32 to 63)
0x16 GPCTOGGLE — GPIO C Data Toggle Register (GPIO32 to 63)
