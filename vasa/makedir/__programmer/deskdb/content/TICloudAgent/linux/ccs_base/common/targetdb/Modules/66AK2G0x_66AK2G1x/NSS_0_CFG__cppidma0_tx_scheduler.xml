# NSS_0_CFG__cppidma0_tx_scheduler register map
Vendor: Texas Instruments
Peripheral module from a debugger description file (folder 66AK2G0x_66AK2G1x).
Registers are 32-bit, access per field, reset 0x0 unless marked. A register's access mark holds for its fields unless they carry their own. Offsets are as the file gives them; lines under a group give offsets from that group; [hi:lo] are bit positions; {n}, {i} and the like mark numbered series; 'fields as' and 'values as' point back to an identical list; <NAME> marks a mode.

## NSS_0_CFG__cppidma0_tx_scheduler
{0x0+4i} CDMA_TX_CHANNEL_SCHEDULER_CONFIG_REG_{i} (i=0..7)
  [1:0] PRIORITY rw — Tx scheduling priority:
