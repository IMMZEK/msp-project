# hercules_esm_spec_1.2.0 register map
Vendor: Texas Instruments
Peripheral module from a debugger description file (folder hercules).
Registers are 32-bit, access not given, no defined reset value unless marked. A register's access mark holds for its fields unless they carry their own. Offsets are as the file gives them; lines under a group give offsets from that group; [hi:lo] are bit positions; {n}, {i} and the like mark numbered series; 'fields as' and 'values as' point back to an identical list; <NAME> marks a mode.

## Esm — Error Signaling Module
0x00 IflErrPinSet1 — Influence Error Pin Set/Status Register 1
0x04 IflErrPinClr1 — Influence Error Pin Clear/Status Register 1
0x08 IntEnaSet1 — Interrupt Enable Set/Status Register 1
0x0C IntEnaClr1 — Interrupt Enable Clear/Status Register 1
0x10 IntLvlSet1 — Interrupt Level Set/Status Register 1
0x14 IntLvlClr1 — Interrupt Level Clear/Status Register 1
{0x14+4i} Stat{i} (i=1..3) — Status Register {i}
0x24 ErrPinStat — Error Pin Status Register
0x28 IntOffstHgh — Interrupt Offset High Register
0x2C IntOffstLow — Interrupt Offset Low Register
0x30 LtCnt — Low-Time Counter Register
0x34 LtCntPre — Low-Time Counter Preload Register
0x38 ErrKey — Error Key Register
0x3C ShdwStat2 — Status Shadow Register
0x40 IflErrPinSet4 — Influence Error Pin Set/Status Register 4
0x44 IflErrPinClr4 — Influence Error Pin Clear/Status Register 4
0x48 IntEnaSet4 — Interrupt Enable Set/Status Register 4
0x4C IntEnaClr4 — Interrupt Enable Clear/Status Register 4
0x50 IntLvlSet4 — Interrupt Level Set/Status Register 4
0x54 IntLvlClr4 — Interrupt Level Clear/Status Register 4
{0x48+4i} Stat{i} (i=4..6) — Status Register {i}
0x64 ShdwStat5 — Status Shadow Register5
0x80 IflErrPinSet7 — Influence Error Pin Set/Status Register 7
0x84 IflErrPinClr7 — Influence Error Pin Clear/Status Register 7
0x88 IntEnaSet7 — Interrupt Enable Set/Status Register 7
0x8C IntEnaClr7 — Interrupt Enable Clear/Status Register 7
0x90 IntLvlSet7 — Interrupt Level Set/Status Register 7
0x94 IntLvlClr7 — Interrupt Level Clear/Status Register 7
{0x7C+4i} Stat{i} (i=7..9) — Status Register {i}
0xA4 ShdwStat8 — Status Shadow Register8
0xC0 IflErrPinSet10 — Influence Error Pin Set/Status Register 10
0xC4 IflErrPinClr10 — Influence Error Pin Clear/Status Register 10
0xC8 IntEnaSet10 — Interrupt Enable Set/Status Register 10
0xCC IntEnaClr10 — Interrupt Enable Clear/Status Register 10
0xD0 IntLvlSet10 — Interrupt Level Set/Status Register 10
0xD4 IntLvlClr10 — Interrupt Level Clear/Status Register 10
{0xB0+4i} Stat{i} (i=10..12) — Status Register {i}
0xE4 ShdwStat11 — Status Shadow Register11

## Notices in the file
(c) Texas Instruments 2003-2012, All rights reserved.
