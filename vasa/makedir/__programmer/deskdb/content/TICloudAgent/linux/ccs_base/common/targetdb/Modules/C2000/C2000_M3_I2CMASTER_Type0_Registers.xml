# C2000_M3_I2CMASTER_Type0_Registers register map
Vendor: Texas Instruments
Peripheral module from a debugger description file (folder C2000).
Address unit: 16 bits
Registers are 32-bit, access not given, no defined reset value unless marked. A register's access mark holds for its fields unless they carry their own. Offsets are as the file gives them; lines under a group give offsets from that group; [hi:lo] are bit positions; {n}, {i} and the like mark numbered series; 'fields as' and 'values as' point back to an identical list; <NAME> marks a mode.

## I2C_MASTER_REGS — I2C MASTER REGS Registers
0x00 I2CMSA — I2C Master Slave Address
0x04 I2CMCS — I2C Master Control/Status
0x08 I2CMDR — I2C Master Data
0x0C I2CMTPR — I2C Master Timer Period
0x10 I2CMIMR — I2C Master Interrupt Mask
0x14 I2CMRIS — I2C Master Raw Interrupt Status
0x18 I2CMMIS — I2C Master Masked Interrupt Status
0x1C I2CMICR — I2C Master Interrupt Clear
0x20 I2CMCR — I2C Master Configuration
