# ddr_emif register map
Vendor: Texas Instruments
Peripheral module from a debugger description file (folder Keystone2).
Registers are 32-bit, access not given, no defined reset value unless marked. A register's access mark holds for its fields unless they carry their own. Offsets are as the file gives them; lines under a group give offsets from that group; [hi:lo] are bit positions; {n}, {i} and the like mark numbered series; 'fields as' and 'values as' point back to an identical list; <NAME> marks a mode.

## DDR_EMIF_B
0x00 emif_mod_id_rev
0x04 status
0x08 sdram_config
0x10 sdram_ref_ctrl
{0x14+4i} sdram_tim_{i} (i=1..3)
0x28 sdram_tim_4
0x38 pwr_mgmt_ctrl
0x54 vbusm_config
0x58 vbusm_cfg_val_1
0x5C vbusm_cfg_val_2
0x60 iodft_tlgc
0x64 iodft_ctrl_misr_rslt
0x68 iodft_addr_misr_rslt
{0x68+4i} iodft_data_misr_rslt_{i} (i=1..5)
0x80 perf_cnt_1
0x84 perf_cnt_2
0x88 perf_cnt_cfg
0x8C perf_cnt_sel
0x90 perf_cnt_tim
0xA4 irqstatus_raw_sys
0xAC irqstatus_sys
0xB4 irqenable_set_sys
0xBC irqenable_clr_sys
0xC8 zq_config
0xD0 vbusm_err_log
0x100 pri_cos_map
0x104 mstid_cos_1_map
0x108 mstid_cos_2_map
0x110 ecc_ctrl
0x114 ecc_addr_rng_1
0x118 ecc_addr_rng_2
0x120 rd_wr_exec_thrsh
0x130 emif4fv_1b_ecc_err_cnt
0x134 emif4fv_1b_ecc_err_thrsh
0x138 emif4fv_1b_ecc_err_dist_1
0x13C emif4fv_1b_ecc_err_addr_log
0x140 emif4fv_2b_ecc_err_addr_log
0x144 emif4fv_1b_ecc_err_dist_2
