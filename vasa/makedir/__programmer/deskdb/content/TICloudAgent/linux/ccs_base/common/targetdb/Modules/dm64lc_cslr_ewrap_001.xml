# dm64lc_cslr_ewrap_001 register map
Vendor: Texas Instruments
Peripheral module from a debugger description file.
Registers are 32-bit, access not given, reset 0x0 unless marked. A register's access mark holds for its fields unless they carry their own. Offsets are as the file gives them; lines under a group give offsets from that group; [hi:lo] are bit positions; {n}, {i} and the like mark numbered series; 'fields as' and 'values as' point back to an identical list; <NAME> marks a mode.

## EWRAP — EMAC Control Module (spec version: 1.06)
0x04 EWCTL — EMAC Wrapper Control Register
  [0] INTEN rw — Controls the EMAC/MDIO interrupt generation to the CPU
    0=DISABLE (EMAC and MDIO interrupts are disabled); 1=ENABLE (EMAC and MDIO interrupts are enabled)
0x08 EWINTTCNT — EMAC Control Module Interrupt Timer Count Register
  [16:0] EWINTTCNT rw — Interrupt timer count
