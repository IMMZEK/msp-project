# hercules_rtp_spec_2.1.6 register map
Vendor: Texas Instruments
Peripheral module from a debugger description file (folder hercules).
Registers are 32-bit, access not given, no defined reset value unless marked. A register's access mark holds for its fields unless they carry their own. Offsets are as the file gives them; lines under a group give offsets from that group; [hi:lo] are bit positions; {n}, {i} and the like mark numbered series; 'fields as' and 'values as' point back to an identical list; <NAME> marks a mode.

## Rtp — Ram Trace Port
0x00 GlbCtrl — Global Control Register
0x04 TrEna — Trace Enable Register
0x08 Gsr — Global Status Register
{0x4+8i} Ram{i}Reg1 (i=1..3) — Ram {i} Trace Region 1 Register
{0x8+8i} Ram{i}Reg2 (i=1..3) — Ram {i} Trace Region 2 Register
0x24 PerReg1 — Peripheral Trace Region 1 Register
0x28 PerReg2 — Peripheral Trace Region 2 Register
0x2C DdmW — Direct Data Mode Write Register
0x34 Fun — Pin Control 0
0x38 Dir — Pin Control 1
0x3C DIn — Pin Control 2
0x40 DOut — Pin Control 3
0x44 DSet — Pin Control 4
0x48 DClr — Pin Control 5
0x4C PDr — Pin Control 6
0x50 PDis — Pin Control 7
0x54 PSel — Pin Control 8
0x58 IoDftCtrl — IODFT CONTROL

## Notices in the file
(c) Texas Instruments 2003-2012, All rights reserved.
