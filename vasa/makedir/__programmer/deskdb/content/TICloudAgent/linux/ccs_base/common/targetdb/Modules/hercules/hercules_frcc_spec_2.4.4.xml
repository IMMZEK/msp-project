# hercules_frcc_spec_2.4.4 register map
Vendor: Texas Instruments
Peripheral module from a debugger description file (folder hercules).
Registers are 32-bit, access not given, no defined reset value unless marked. A register's access mark holds for its fields unless they carry their own. Offsets are as the file gives them; lines under a group give offsets from that group; [hi:lo] are bit positions; {n}, {i} and the like mark numbered series; 'fields as' and 'values as' point back to an identical list; <NAME> marks a mode.

## FlexRay
0x00 ECCCTRL — ECC Control Register
0x04 ECCDSTAT — ECC Diagnostic Status Register
0x08 ECCTEST
0x0C SBESTAT — Single Bit Error Register
0x10 TEST1 — Test register 1
0x14 TEST2 — Test register 2
0x1C LCK — Lock register
0x20 EIR — Error interrupt register
0x24 SIR — Status interrupt register
0x28 EILS — Error interrupt line select
0x2C SILS — Status interrupt line select
0x30 EIES — Error interrupt enable set
0x34 EIER — Error interrupt enable reset
0x38 SIES — Status interrupt enable set
0x3C SIER — Status interrupt enable reset
0x40 ILE — Interrupt line enable
0x44 T0C — Timer 0 configuration
0x48 T1C — Timer 1 configuration
0x4C STPW1 — Stop watch register1
0x50 STPW2 — Stop watch register2
{0x7C+4i} SUCC{i} (i=1..3) — SUC configuration register {i}
0x8C NEMC — NEM configuration register
0x90 PRTC1 — PRT configuration register 1
0x94 PRTC2 — PRT configuration register 2
0x98 MHDC — MHD configuration register
{0x9C+4i} GTUC{i} (i=1..11) — GTU configuration register {i}
0x100 CCSV — communication controller status vector
0x104 CCEV — communication controller error vector
0x110 SCV — Slot counter value
0x114 MTCCV — Macrotick and cycle counter
0x118 RCV — Rate correction value
0x11C OCV — Offset correction value
0x120 SFS — Sync frame status
0x124 SWNIT — Symbol window and NIT status
0x128 ACS — Aggregated channel status
{0x12C+4i} ESID{i} (i=1..15) — Even sync ID [1-15]
{0x16C+4i} OSID{i} (i=1..15) — Odd sync ID [1-15]
{0x1AC+4i} NMV{i} (i=1..3) — Network management vector [1-3]
0x300 MRC — Message RAM configuration
0x304 FRF — FIFO rejection filter
0x308 FRFM — FIFO rejection filter mask
0x30C FCIM — FIFO Critical Level
0x310 MHDS — Message handler status
0x314 LDTS — Last dynamic transmit slot
0x318 FSR — FIFO status register
0x31C MHDF — Message handler constraint flags
{0x31C+4i} TXRQ{i} (i=1..4) — Transmission request {i}
{0x32C+4i} NDAT{i} (i=1..4) — New data {i}
{0x33C+4i} MBSC{i} (i=1..4) — Message buffer status changed {i}
0x3F0 CREL — Core release register
0x3F4 ENDN — Endian register
{0x3FC+4i} WRDS{i} (i=1..64) — Write data section [1-64]
{0x4FC+4i} WRHS{i} (i=1..3) — Write header section {i}
0x510 IBCM — Input buffer command mask
0x514 IBCR — Input buffer command request
{0x5FC+4i} RDDS{i} (i=1..64) — Read data section [1-64]
{0x6FC+4i} RDHS{i} (i=1..3) — Read header section {i}
0x70C MBS — Message buffer status
0x710 OBCM — Output buffer command mask
0x714 OBCR — Output buffer command request

## Notices in the file
(c) Texas Instruments 2007-2011, All rights reserved.
