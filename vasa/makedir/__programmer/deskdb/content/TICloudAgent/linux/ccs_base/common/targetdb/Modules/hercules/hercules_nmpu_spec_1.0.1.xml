# hercules_nmpu_spec_1.0.1 register map
Vendor: Texas Instruments
Peripheral module from a debugger description file (folder hercules).
Registers are 32-bit, access not given, no defined reset value unless marked. A register's access mark holds for its fields unless they carry their own. Offsets are as the file gives them; lines under a group give offsets from that group; [hi:lo] are bit positions; {n}, {i} and the like mark numbered series; 'fields as' and 'values as' point back to an identical list; <NAME> marks a mode.

## NMPU — Enhanced Memory Protection Unit
0x00 MpuRev — MPU Revision ID Register
0x04 MpuLock
0x08 MpuDiagCtrl — MPU Diagnostic Control Register
0x0C MpuDiagAddr — MPU Diagnostic Address Register
0x10 MpuErrStat — MPU Error Status Register
0x14 MpuErrAddr — MPU Error Address Register
0x18 MpuIAM — MPU Input Address Mask Register
0x1C MpuGPCtrl — MPU General Purpose Control Register
{0x1C+4i} MpuCtrl{i} (i=1..3) — MPU Control Register{i}
0x2C MpuType
0x30 MpuRegBase — MPU Region Base Address Register
0x34 MpuRegSEna — MPU Region Size and Enable Register
0x38 MpuRegAcr — MPU Region Access Control Register
0x3C MpuRegNum — MPU Region Number Register
0x40 MpuRegAM — MPU Region Address Mask Register
0x44 MpuRegTA — MPU Region Translation Address Register
0x48 MpuRegMT — MPU Region Mode Translation Register
0x4C UerrAddr11 — Uncorrectable Error Address Register 11

## Notices in the file
(c) Texas Instruments 2003-2012, All rights reserved.
