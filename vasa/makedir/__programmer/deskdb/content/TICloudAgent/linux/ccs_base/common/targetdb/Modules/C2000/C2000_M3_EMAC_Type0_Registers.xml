# C2000_M3_EMAC_Type0_Registers register map
Vendor: Texas Instruments
Peripheral module from a debugger description file (folder C2000).
Address unit: 16 bits
Registers are 32-bit, access not given, no defined reset value unless marked. A register's access mark holds for its fields unless they carry their own. Offsets are as the file gives them; lines under a group give offsets from that group; [hi:lo] are bit positions; {n}, {i} and the like mark numbered series; 'fields as' and 'values as' point back to an identical list; <NAME> marks a mode.

## EMAC_REGS — EMAC REGS Registers
0x00 MACRIS_ACK — EMAC Raw Interrupt Status \ Acknowledge
0x04 MACIM — EMAC Interrupt Mask
0x08 MACRCTL — EMAC Receive Control
0x0C MACTCTL — EMAC Transmit Control
0x10 MACDATA — EMAC Data
0x14 MACIA0 — EMAC Individual Adddress 0
0x18 MACIA1 — EMAC Individual Adddress 1
0x1C MACTHR — EMAC Threshold
0x20 MACMCTL — EMAC Management Control
0x24 MACMDV — EMAC Management Divider
0x2C MACMTXD — EMAC Management Transmit Data
0x30 MACMRXD — EMAC Management Receive Data
0x34 MACNP — EMAC Number of Packets
0x38 MACTR — EMAC Transmission Request
0x3C MACTS — EMAC Timer Support
