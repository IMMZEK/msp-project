# DDR2_3_PHY register map
Vendor: Texas Instruments
Peripheral module from a debugger description file (folder am335x).
Registers are 32-bit, access per field, no defined reset value unless marked. A register's access mark holds for its fields unless they carry their own. Offsets are as the file gives them; lines under a group give offsets from that group; [hi:lo] are bit positions; {n}, {i} and the like mark numbered series; 'fields as' and 'values as' point back to an identical list; <NAME> marks a mode.

## DDR2_3_mDDR_PHY
{0x1C+0x34*i} CMD{i}_REG_PHY_CTRL_SLAVE_RATIO_0 (i=0..2)
  [9:0] CMD_SLAVE_RATIO rw — Ratio value for address/command launch timing in DDR PHY macro. This is the fraction of a clock cycle represented by the shift to be applied to the read DQS in units of 256ths. In other words, the full-cycle tap value from the master DLL will be scaled by this number over 256 to get the delay value for the slave delay line.
{0x28+0x34*i} CMD{i}_REG_PHY_DLL_LOCK_DIFF_0 (i=0..2)
  [3:0] DLL_LOCK_DIFF rw — The max number of delay line taps variation allowed while maintaining the master DLL lock.This is calculated as total jitter/ delay line tap size, where total jitter is half of (incoming clock jitter (pp) + delay line jitter (pp)).
{0x2C+0x34*i} CMD{i}_REG_PHY_INVERT_CLKOUT_0 (i=0..2)
  [0] INVERT_CLK_SEL rw — Inverts the polarity of DRAM clock.
0xC8 DATA0_REG_PHY_RD_DQS_SLAVE_RATIO_0
  [9:0] RD_DQS_SLAVE_RATIO_CS0 rw — Ratio value for Read DQS slave DLL for CS0. This is the fraction of a clock cycle represented by the shift to be applied to the read DQS in units of 256ths. In other words, the full-cycle tap value from the master DLL will be scaled by this number over 256 to get the delay value for the slave delay line.
0xDC DATA0_REG_PHY_WR_DQS_SLAVE_RATIO_0
  [9:0] _WR_DQS_SLAVE_RATIO_CS0 rw — Ratio value for Write DQS slave DLL for CS0. This is the fraction of a clock cycle represented by the shift to be applied to the write DQS in units of 256ths. In other words, the full-cycle tap value from the master DLL will be scaled by this number over 256 to get the delay value for the slave delay line.
0xF0 DATA0_REG_PHY_WRLVL_INIT_RATIO_0
  [9:0] WRLVL_INIT_RATIO_CS0 rw — The user programmable init ratio used by Write Leveling FSM when DATA0/1_REG_PHY_WRLVL_INIT_MODE_0 register value set to 1
0xF8 DATA0_REG_PHY_WRLVL_INIT_MODE_0
  [0] WRLVL_INIT_MODE_SEL rw — The user programmable init ratio selection mode for Write Leveling FSM.
0xFC DATA0_REG_PHY_GATELVL_INIT_RATIO_0
  [9:0] GATELVL_INIT_RATIO_CS0 rw — The user programmable init ratio used by DQS Gate Training FSM when DATA0/1/_REG_PHY_GATELVL_INIT_MODE_0 register value set to 1.
0x104 DATA0_REG_PHY_GATELVL_INIT_MODE_0
  [0] GATELVL_INIT_MODE_SEL rw — User programmable init ratio selection mode for DQS Gate Training FSM.
0x108 DATA0_REG_PHY_FIFO_WE_SLAVE_RATIO_0
  [9:0] RD_DQS_GATE_SLAVE_RATIO_CS0 rw — Ratio value for fifo we for CS0.
0x11C DATA0_REG_PHY_DQ_OFFSET_0 access not given
0x120 DATA0_REG_PHY_WR_DATA_SLAVE_RATIO_0
  [9:0] WR_DATA_SLAVE_RATIO_CS0 rw — Ratio value for write data slave DLL for CS0. This is the fraction of a clock cycle represented by the shift to be applied to the write DQ muxes in units of 256ths. In other words, the full-cycle tap value from the master DLL will be scaled by this number over 256 to get the delay value for the slave delay line.
0x134 DATA0_REG_PHY_USE_RANK0_DELAYS
  [0] PHY_USE_RANK0_DELAYS_0 rw — Delay Selection
0x138 DATA0_REG_PHY_DLL_LOCK_DIFF_0 access not given
0x16C DATA1_REG_PHY_RD_DQS_SLAVE_RATIO_0
  fields as DATA0_REG_PHY_RD_DQS_SLAVE_RATIO_0
0x180 DATA1_REG_PHY_WR_DQS_SLAVE_RATIO_0
  fields as DATA0_REG_PHY_WR_DQS_SLAVE_RATIO_0
0x194 DATA1_REG_PHY_WRLVL_INIT_RATIO_0
  fields as DATA0_REG_PHY_WRLVL_INIT_RATIO_0
0x19C DATA1_REG_PHY_WRLVL_INIT_MODE_0
  fields as DATA0_REG_PHY_WRLVL_INIT_MODE_0
0x1A0 DATA1_REG_PHY_GATELVL_INIT_RATIO_0
  fields as DATA0_REG_PHY_GATELVL_INIT_RATIO_0
0x1A8 DATA1_REG_PHY_GATELVL_INIT_MODE_0
  fields as DATA0_REG_PHY_GATELVL_INIT_MODE_0
0x1AC DATA1_REG_PHY_FIFO_WE_SLAVE_RATIO_0
  fields as DATA0_REG_PHY_FIFO_WE_SLAVE_RATIO_0
0x1C0 DATA1_REG_PHY_DQ_OFFSET_1 access not given
0x1C4 DATA1_REG_PHY_WR_DATA_SLAVE_RATIO_0
  fields as DATA0_REG_PHY_WR_DATA_SLAVE_RATIO_0
0x1D8 DATA1_REG_PHY_USE_RANK0_DELAYS
  [0] PHY_USE_RANK0_DELAYS_0 rw — Delay Selection
0x1DC DATA1_REG_PHY_DLL_LOCK_DIFF_0 access not given
