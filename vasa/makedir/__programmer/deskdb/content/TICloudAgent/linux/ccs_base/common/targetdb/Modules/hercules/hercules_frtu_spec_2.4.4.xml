# hercules_frtu_spec_2.4.4 register map
Vendor: Texas Instruments
Peripheral module from a debugger description file (folder hercules).
Registers are 32-bit, access not given, no defined reset value unless marked. A register's access mark holds for its fields unless they carry their own. Offsets are as the file gives them; lines under a group give offsets from that group; [hi:lo] are bit positions; {n}, {i} and the like mark numbered series; 'fields as' and 'values as' point back to an identical list; <NAME> marks a mode.

## FlexRayTU — Flexray Transfer Unit
0x00 PICC — Product Identification Communication Controller
0x04 GSN — Global Static Number
0x10 GCS — Global Control Set
0x14 GCR — Global Control Reset
0x18 TSCB — Transfer Status
0x1C LTBCC — Last Transferred Buffer to Communication Controller
0x20 LTBSM — Last Transferred Buffer to System Memory
0x24 TBA — Transfer Base Address
0x28 NTBA — Next Transfer Base Address
0x2C BAMS — Base Address of Mirrored Status
0x30 SAMP — Start Address of Memory Protection
0x34 EAMP — End Address of Memory Protection
{0x3C+4i} TSMO{i} (i=1..4) — Transfer to System Memory Occurred {i}
{0x4C+4i} TCCO{i} (i=1..4) — Transfer to Communication Controller Occurred {i}
0x60 TOOFF — Transfer Occurred Offset
0x6C TSBESTAT — TCR ECC single Bit Error Status
0x70 PEADR — ECC Error Address
0x74 TEIR — Transfer Error InterRupt
0x78 TEIRES — Transfer Error InterRupt Enable Set
0x7C TEIRER — Transfer Error InterRupt Enable Reset
{0x78+8i} TTSMS{i} (i=1..4) — Trigger Transfer to System Memory Set {i}
{0x7C+8i} TTSMR{i} (i=1..4) — Trigger Transfer to System Memory Reset {i}
{0x98+8i} TTCCS{i} (i=1..4) — Trigger Transfer to Communication Controller Set {i}
{0x9C+8i} TTCCR{i} (i=1..4) — Trigger Transfer to Communication Controller Reset {i}
{0xB8+8i} ETESMS{i} (i=1..4) — Enable Transfer on Event to System Memory Set {i}
{0xBC+8i} ETESMR{i} (i=1..4) — Enable Transfer on Event to System Memory Reset {i}
{0xD8+8i} CESMS{i} (i=1..4) — Clear on Event to System Memory Set {i}
{0xDC+8i} CESMR{i} (i=1..4) — Clear on Event to System Memory Reset {i}
{0xF8+8i} TSMIES{i} (i=1..4) — Transfer to System Memory Interrupt Enable Set {i}
{0xFC+8i} TSMIER{i} (i=1..4) — Transfer to System Memory Interrupt Enable Reset {i}
{0x118+8i} TCCIES{i} (i=1..4) — Transfer to Communication Controller Interrupt Enable Set {i}
{0x11C+8i} TCCIER{i} (i=1..4) — Transfer to Communication Controller Interrupt Enable Reset {i}

## Notices in the file
(c) Texas Instruments 2003-2012, All rights reserved.
