# f28p65x_hrpwmcal_regs register map
Vendor: Texas Instruments
Peripheral module from a debugger description file (folder C2000).
Address unit: 16 bits
Registers are 16-bit, read-write, no defined reset value unless marked. A register's access mark holds for its fields unless they carry their own. Offsets are as the file gives them; lines under a group give offsets from that group; [hi:lo] are bit positions; {n}, {i} and the like mark numbered series; 'fields as' and 'values as' point back to an identical list; <NAME> marks a mode.

## HRPWMCAL_REGS — HRPWMCAL Registers
0x21 HRPWR — HRPWM Power Register
  [15] CALPWRON — Calibration Power On
0x26 HRMSTEP — HRPWM MEP Step Register
  [7:0] HRMSTEP — High Resolution Micro Step Value
