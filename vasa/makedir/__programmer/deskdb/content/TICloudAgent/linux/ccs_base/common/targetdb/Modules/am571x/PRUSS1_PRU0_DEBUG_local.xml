# PRUSS1_PRU0_DEBUG_local register map
Vendor: Texas Instruments
Peripheral module from a debugger description file (folder am571x).
Registers are 32-bit, read-write, reset 0x0 unless marked. A register's access mark holds for its fields unless they carry their own. Offsets are as the file gives them; lines under a group give offsets from that group; [hi:lo] are bit positions; {n}, {i} and the like mark numbered series; 'fields as' and 'values as' point back to an identical list; <NAME> marks a mode.

## PRUSS1_PRU0_DEBUG
{0x0+4i} PRUSS_DBG_GPREG{i} (i=0..31) — DEBUG PRU GENERAL PURPOSE REGISTER {i}. This register allows an external agent to debug the PRU while it is disabled. Reading or writing to these registers will have the same effect as a read or write to these registers from an internal instruction in the PRU. For R30, this includes generation of the pulse outputs whenever the register is written.
  [31:0] GP_REG{i} — PRU Internal GP Register n: Reading / writing this field directly inspects/modifies the corresponding internal register in the PRU internal regfile
0x80 PRUSS_DBG_CT_REG0 ro reset 0x20000 — DEBUG PRU CONSTANTS TABLE ENTRY 0. This register allows an external agent to debug the PRU while it is disabled. Since some of the constants table entries may actually depend on system inputs / and or the internal state of the PRU, these registers are provided to allow an external agent to easily determine the state of the constants table.
  [31:0] CT_REG0 — PRU Internal Constants Table Entry n: Reading this field directly inspects the corresponding entry in the PRU internal constants table.
0x84 PRUSS_DBG_CT_REG1 ro reset 0x48040000 — DEBUG PRU CONSTANTS TABLE ENTRY 1. This register allows an external agent to debug the PRU while it is disabled. Since some of the constants table entries may actually depend on system inputs / and or the internal state of the PRU, these registers are provided to allow an external agent to easily determine the state of the constants table.
  [31:0] CT_REG1 — PRU Internal Constants Table Entry n: Reading this field directly inspects the corresponding entry in the PRU internal constants table.
0x88 PRUSS_DBG_CT_REG2 ro reset 0x4802A000 — DEBUG PRU CONSTANTS TABLE ENTRY 2. This register allows an external agent to debug the PRU while it is disabled. Since some of the constants table entries may actually depend on system inputs / and or the internal state of the PRU, these registers are provided to allow an external agent to easily determine the state of the constants table.
  [31:0] CT_REG2 — PRU Internal Constants Table Entry n: Reading this field directly inspects the corresponding entry in the PRU internal constants table.
0x8C PRUSS_DBG_CT_REG3 ro reset 0x30000 — DEBUG PRU CONSTANTS TABLE ENTRY 3. This register allows an external agent to debug the PRU while it is disabled. Since some of the constants table entries may actually depend on system inputs / and or the internal state of the PRU, these registers are provided to allow an external agent to easily determine the state of the constants table.
  [31:0] CT_REG3 — PRU Internal Constants Table Entry n: Reading this field directly inspects the corresponding entry in the PRU internal constants table.
0x90 PRUSS_DBG_CT_REG4 ro reset 0x26000 — DEBUG PRU CONSTANTS TABLE ENTRY 4. This register allows an external agent to debug the PRU while it is disabled. Since some of the constants table entries may actually depend on system inputs / and or the internal state of the PRU, these registers are provided to allow an external agent to easily determine the state of the constants table.
  [31:0] CT_REG4 — PRU Internal Constants Table Entry n: Reading this field directly inspects the corresponding entry in the PRU internal constants table.
0x94 PRUSS_DBG_CT_REG5 ro reset 0x48060000 — DEBUG PRU CONSTANTS TABLE ENTRY 5. This register allows an external agent to debug the PRU while it is disabled. Since some of the constants table entries may actually depend on system inputs / and or the internal state of the PRU, these registers are provided to allow an external agent to easily determine the state of the constants table.
  [31:0] CT_REG5 — PRU Internal Constants Table Entry n: Reading this field directly inspects the corresponding entry in the PRU internal constants table.
0x98 PRUSS_DBG_CT_REG6 ro reset 0x48030000 — DEBUG PRU CONSTANTS TABLE ENTRY 6. This register allows an external agent to debug the PRU while it is disabled. Since some of the constants table entries may actually depend on system inputs / and or the internal state of the PRU, these registers are provided to allow an external agent to easily determine the state of the constants table.
  [31:0] CT_REG6 — PRU Internal Constants Table Entry n: Reading this field directly inspects the corresponding entry in the PRU internal constants table.
0x9C PRUSS_DBG_CT_REG7 ro reset 0x28000 — DEBUG PRU CONSTANTS TABLE ENTRY 7. This register allows an external agent to debug the PRU while it is disabled. Since some of the constants table entries may actually depend on system inputs / and or the internal state of the PRU, these registers are provided to allow an external agent to easily determine the state of the constants table.
  [31:0] CT_REG7 — PRU Internal Constants Table Entry n: Reading this field directly inspects the corresponding entry in the PRU internal constants table.
0xA0 PRUSS_DBG_CT_REG8 ro reset 0x46000000 — DEBUG PRU CONSTANTS TABLE ENTRY 8. This register allows an external agent to debug the PRU while it is disabled. Since some of the constants table entries may actually depend on system inputs / and or the internal state of the PRU, these registers are provided to allow an external agent to easily determine the state of the constants table.
  [31:0] CT_REG8 — PRU Internal Constants Table Entry n: Reading this field directly inspects the corresponding entry in the PRU internal constants table.
0xA4 PRUSS_DBG_CT_REG9 ro reset 0x4A100000 — DEBUG PRU CONSTANTS TABLE ENTRY 9. This register allows an external agent to debug the PRU while it is disabled. Since some of the constants table entries may actually depend on system inputs / and or the internal state of the PRU, these registers are provided to allow an external agent to easily determine the state of the constants table.
  [31:0] CT_REG9 — PRU Internal Constants Table Entry n: Reading this field directly inspects the corresponding entry in the PRU internal constants table.
0xA8 PRUSS_DBG_CT_REG10 ro reset 0x48318000 — DEBUG PRU CONSTANTS TABLE ENTRY 10. This register allows an external agent to debug the PRU while it is disabled. Since some of the constants table entries may actually depend on system inputs / and or the internal state of the PRU, these registers are provided to allow an external agent to easily determine the state of the constants table.
  [31:0] CT_REG10 — PRU Internal Constants Table Entry n: Reading this field directly inspects the corresponding entry in the PRU internal constants table.
0xAC PRUSS_DBG_CT_REG11 ro reset 0x48022000 — DEBUG PRU CONSTANTS TABLE ENTRY 11. This register allows an external agent to debug the PRU while it is disabled. Since some of the constants table entries may actually depend on system inputs / and or the internal state of the PRU, these registers are provided to allow an external agent to easily determine the state of the constants table.
  [31:0] CT_REG11 — PRU Internal Constants Table Entry n: Reading this field directly inspects the corresponding entry in the PRU internal constants table.
0xB0 PRUSS_DBG_CT_REG12 ro reset 0x48024000 — DEBUG PRU CONSTANTS TABLE ENTRY 12. This register allows an external agent to debug the PRU while it is disabled. Since some of the constants table entries may actually depend on system inputs / and or the internal state of the PRU, these registers are provided to allow an external agent to easily determine the state of the constants table.
  [31:0] CT_REG12 — PRU Internal Constants Table Entry n: Reading this field directly inspects the corresponding entry in the PRU internal constants table.
0xB4 PRUSS_DBG_CT_REG13 ro reset 0x48310000 — DEBUG PRU CONSTANTS TABLE ENTRY 13. This register allows an external agent to debug the PRU while it is disabled. Since some of the constants table entries may actually depend on system inputs / and or the internal state of the PRU, these registers are provided to allow an external agent to easily determine the state of the constants table.
  [31:0] CT_REG13 — PRU Internal Constants Table Entry n: Reading this field directly inspects the corresponding entry in the PRU internal constants table.
0xB8 PRUSS_DBG_CT_REG14 ro reset 0x481CC000 — DEBUG PRU CONSTANTS TABLE ENTRY 14. This register allows an external agent to debug the PRU while it is disabled. Since some of the constants table entries may actually depend on system inputs / and or the internal state of the PRU, these registers are provided to allow an external agent to easily determine the state of the constants table.
  [31:0] CT_REG14 — PRU Internal Constants Table Entry n: Reading this field directly inspects the corresponding entry in the PRU internal constants table.
0xBC PRUSS_DBG_CT_REG15 ro reset 0x481D0000 — DEBUG PRU CONSTANTS TABLE ENTRY 15. This register allows an external agent to debug the PRU while it is disabled. Since some of the constants table entries may actually depend on system inputs / and or the internal state of the PRU, these registers are provided to allow an external agent to easily determine the state of the constants table.
  [31:0] CT_REG15 — PRU Internal Constants Table Entry n: Reading this field directly inspects the corresponding entry in the PRU internal constants table.
0xC0 PRUSS_DBG_CT_REG16 ro reset 0x481A0000 — DEBUG PRU CONSTANTS TABLE ENTRY 16. This register allows an external agent to debug the PRU while it is disabled. Since some of the constants table entries may actually depend on system inputs / and or the internal state of the PRU, these registers are provided to allow an external agent to easily determine the state of the constants table.
  [31:0] CT_REG16 — PRU Internal Constants Table Entry n: Reading this field directly inspects the corresponding entry in the PRU internal constants table.
0xC4 PRUSS_DBG_CT_REG17 ro reset 0x4819C000 — DEBUG PRU CONSTANTS TABLE ENTRY 17. This register allows an external agent to debug the PRU while it is disabled. Since some of the constants table entries may actually depend on system inputs / and or the internal state of the PRU, these registers are provided to allow an external agent to easily determine the state of the constants table.
  [31:0] CT_REG17 — PRU Internal Constants Table Entry n: Reading this field directly inspects the corresponding entry in the PRU internal constants table.
0xC8 PRUSS_DBG_CT_REG18 ro reset 0x48300000 — DEBUG PRU CONSTANTS TABLE ENTRY 18. This register allows an external agent to debug the PRU while it is disabled. Since some of the constants table entries may actually depend on system inputs / and or the internal state of the PRU, these registers are provided to allow an external agent to easily determine the state of the constants table.
  [31:0] CT_REG18 — PRU Internal Constants Table Entry n: Reading this field directly inspects the corresponding entry in the PRU internal constants table.
0xCC PRUSS_DBG_CT_REG19 ro reset 0x48302000 — DEBUG PRU CONSTANTS TABLE ENTRY 19. This register allows an external agent to debug the PRU while it is disabled. Since some of the constants table entries may actually depend on system inputs / and or the internal state of the PRU, these registers are provided to allow an external agent to easily determine the state of the constants table.
  [31:0] CT_REG19 — PRU Internal Constants Table Entry n: Reading this field directly inspects the corresponding entry in the PRU internal constants table.
0xD0 PRUSS_DBG_CT_REG20 ro reset 0x48304000 — DEBUG PRU CONSTANTS TABLE ENTRY 20. This register allows an external agent to debug the PRU while it is disabled. Since some of the constants table entries may actually depend on system inputs / and or the internal state of the PRU, these registers are provided to allow an external agent to easily determine the state of the constants table.
  [31:0] CT_REG20 — PRU Internal Constants Table Entry n: Reading this field directly inspects the corresponding entry in the PRU internal constants table.
0xD4 PRUSS_DBG_CT_REG21 ro reset 0x32400 — DEBUG PRU CONSTANTS TABLE ENTRY 21. This register allows an external agent to debug the PRU while it is disabled. Since some of the constants table entries may actually depend on system inputs / and or the internal state of the PRU, these registers are provided to allow an external agent to easily determine the state of the constants table.
  [31:0] CT_REG21 — PRU Internal Constants Table Entry n: Reading this field directly inspects the corresponding entry in the PRU internal constants table.
0xD8 PRUSS_DBG_CT_REG22 ro reset 0x480C8000 — DEBUG PRU CONSTANTS TABLE ENTRY 22. This register allows an external agent to debug the PRU while it is disabled. Since some of the constants table entries may actually depend on system inputs / and or the internal state of the PRU, these registers are provided to allow an external agent to easily determine the state of the constants table.
  [31:0] CT_REG22 — PRU Internal Constants Table Entry n: Reading this field directly inspects the corresponding entry in the PRU internal constants table.
0xDC PRUSS_DBG_CT_REG23 ro reset 0x480CA000 — DEBUG PRU CONSTANTS TABLE ENTRY 23. This register allows an external agent to debug the PRU while it is disabled. Since some of the constants table entries may actually depend on system inputs / and or the internal state of the PRU, these registers are provided to allow an external agent to easily determine the state of the constants table.
  [31:0] CT_REG23 — PRU Internal Constants Table Entry n: Reading this field directly inspects the corresponding entry in the PRU internal constants table.
0xE0 PRUSS_DBG_CT_REG24 ro — DEBUG PRU CONSTANTS TABLE ENTRY 24. This register allows an external agent to debug the PRU while it is disabled. Since some of the constants table entries may actually depend on system inputs / and or the internal state of the PRU, these registers are provided to allow an external agent to easily determine the state of the constants table.
  [31:0] CT_REG24 — PRU Internal Constants Table Entry n: Reading this field directly inspects the corresponding entry in the PRU internal constants table. This entry is partially programmable through the c24_blk_index in the PRU Control register. The reset value for this Constant Table Entry is 0x00000n00, n=c24_blk_index[3:0].
0xE4 PRUSS_DBG_CT_REG25 ro — DEBUG PRU CONSTANTS TABLE ENTRY 25. This register allows an external agent to debug the PRU while it is disabled. Since some of the constants table entries may actually depend on system inputs / and or the internal state of the PRU, these registers are provided to allow an external agent to easily determine the state of the constants table.
  [31:0] CT_REG25 — PRU Internal Constants Table Entry n: Reading this field directly inspects the corresponding entry in the PRU internal constants table. This entry is partially programmable through the c25_blk_index in the PRU Control register. The reset value for this Constant Table Entry is 0x00002n00, n=c25_blk_index[3:0].
0xE8 PRUSS_DBG_CT_REG26 ro — DEBUG PRU CONSTANTS TABLE ENTRY 26. This register allows an external agent to debug the PRU while it is disabled. Since some of the constants table entries may actually depend on system inputs / and or the internal state of the PRU, these registers are provided to allow an external agent to easily determine the state of the constants table.
  [31:0] CT_REG26 — PRU Internal Constants Table Entry n: Reading this field directly inspects the corresponding entry in the PRU internal constants table. This entry is partially programmable through the c26_blk_index in the PRU Control register. The reset value for this Constant Table Entry is 0x0002En00, n=c26_blk_index[3:0].
0xEC PRUSS_DBG_CT_REG27 ro — DEBUG PRU CONSTANTS TABLE ENTRY 27. This register allows an external agent to debug the PRU while it is disabled. Since some of the constants table entries may actually depend on system inputs / and or the internal state of the PRU, these registers are provided to allow an external agent to easily determine the state of the constants table.
  [31:0] CT_REG27 — PRU Internal Constants Table Entry n: Reading this field directly inspects the corresponding entry in the PRU internal constants table. This entry is partially programmable through the c27_blk_index in the PRU Control register. The reset value for this Constant Table Entry is 0x00032n00, n=c27_blk_index[3:0].
0xF0 PRUSS_DBG_CT_REG28 ro — DEBUG PRU CONSTANTS TABLE ENTRY 28. This register allows an external agent to debug the PRU while it is disabled. Since some of the constants table entries may actually depend on system inputs / and or the internal state of the PRU, these registers are provided to allow an external agent to easily determine the state of the constants table.
  [31:0] CT_REG28 — PRU Internal Constants Table Entry n: Reading this field directly inspects the corresponding entry in the PRU internal constants table. This entry is partially programmable through the c28_pointer in the PRU Control register. The reset value for this Constant Table Entry is 0x00nnnn00, nnnn=c28_pointer[15:0].
0xF4 PRUSS_DBG_CT_REG29 ro — DEBUG PRU CONSTANTS TABLE ENTRY 29. This register allows an external agent to debug the PRU while it is disabled. Since some of the constants table entries may actually depend on system inputs / and or the internal state of the PRU, these registers are provided to allow an external agent to easily determine the state of the constants table.
  [31:0] CT_REG29 — PRU Internal Constants Table Entry n: Reading this field directly inspects the corresponding entry in the PRU internal constants table. This entry is partially programmable through the c29_pointer in the PRU Control register. The reset value for this Constant Table Entry is 0x49nnnn00, nnnn=c29_pointer[15:0].
0xF8 PRUSS_DBG_CT_REG30 ro — DEBUG PRU CONSTANTS TABLE ENTRY 30. This register allows an external agent to debug the PRU while it is disabled. Since some of the constants table entries may actually depend on system inputs / and or the internal state of the PRU, these registers are provided to allow an external agent to easily determine the state of the constants table.
  [31:0] CT_REG30 — PRU Internal Constants Table Entry n: Reading this field directly inspects the corresponding entry in the PRU internal constants table. This entry is partially programmable through the c30_pointer in the PRU Control register. The reset value for this Constant Table Entry is 0x40nnnn00, nnnn=c30_pointer[15:0].
0xFC PRUSS_DBG_CT_REG31 ro — DEBUG PRU CONSTANTS TABLE ENTRY 31. This register allows an external agent to debug the PRU while it is disabled. Since some of the constants table entries may actually depend on system inputs / and or the internal state of the PRU, these registers are provided to allow an external agent to easily determine the state of the constants table.
  [31:0] CT_REG31 — PRU Internal Constants Table Entry n: Reading this field directly inspects the corresponding entry in the PRU internal constants table. This entry is partially programmable through the c31_pointer in the PRU Control register. The reset value for this Constant Table Entry is 0x80nnnn00, nnnn=c31_pointer[15:0].
