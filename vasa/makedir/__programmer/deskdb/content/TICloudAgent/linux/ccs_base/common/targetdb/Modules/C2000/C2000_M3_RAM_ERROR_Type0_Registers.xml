# C2000_M3_RAM_ERROR_Type0_Registers register map
Vendor: Texas Instruments
Peripheral module from a debugger description file (folder C2000).
Address unit: 16 bits
Registers are 32-bit, access not given, no defined reset value unless marked. A register's access mark holds for its fields unless they carry their own. Offsets are as the file gives them; lines under a group give offsets from that group; [hi:lo] are bit positions; {n}, {i} and the like mark numbered series; 'fields as' and 'values as' point back to an identical list; <NAME> marks a mode.

## RAM_ERR_REGS — RAM ERR REGS Registers
0x00 MCUNCWEADDR — M3 CPU Uncorrectable Write Error Address Register
0x04 MDUNCWEADDR — M3 μDMA Uncorrectable Write Error Address Register
0x08 MCUNCREADDR — M3 CPU Uncorrectable Read Error Address Register
0x0C MDUNCREADDR — M3 μDMA Uncorrectable Read Error Address Register
0x10 MCPUCREADDR — M3 CPU Corrected Read Error Address Register
0x14 MDMACREADDR — M3 μDMA Corrected Read Error Address Register
0x20 MUEFLG — M3 Uncorrectable Error Flag Register
0x24 MUEFRC — M3 Uncorrectable Error Force Register
0x28 MUECLR — M3 Uncorrectable Error Flag Clear Register
0x2C MCECNTR — M3 Corrected Error Counter Register
0x30 MCETRES — M3 Corrected Error Threshold Register
0x38 MCEFLG — M3 Corrected Error Threshold Exceeded Flag Register
0x3C MCEFRC — M3 Corrected Error Threshold Exceeded Force Register
0x40 MCECLR — M3 Corrected Error Threshold Exceeded Flag Clear Register
0x44 MCEIE — M3 Single Error Interrupt Enable Register
0x50 MNMAVFLG — Non-Master Access Violation Flag Register
0x58 MNMAVCLR — Non-Master Access Violation Flag Clear Register
0x60 MMAVFLG — Master Access Violation Flag Register
0x68 MMAVCLR — Master Access Violation Flag Clear Register
0x70 MNMWRAVADDR — Non-Master CPU Write Access Violation Address Register
0x74 MNMDMAWRAVADDR — Non-Master DMA Write Access Violation Address Register
0x78 MNMFAVADDR — Non-Master CPU Fetch Access Violation Address Register
0x80 MMWRAVADDR — Master CPU Write Access Violation Address Register
0x84 MMDMAWRAVADDR — Master DMA Write Access Violation Address Register
0x88 MMFAVADDR — Master CPU Fetch Access Violation Address Register
