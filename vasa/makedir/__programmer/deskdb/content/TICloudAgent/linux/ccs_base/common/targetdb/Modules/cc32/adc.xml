# adc register map
Vendor: Texas Instruments
Peripheral module from a debugger description file (folder cc32).
Registers are 32-bit, access not given, no defined reset value unless marked. A register's access mark holds for its fields unless they carry their own. Offsets are as the file gives them; lines under a group give offsets from that group; [hi:lo] are bit positions; {n}, {i} and the like mark numbered series; 'fields as' and 'values as' point back to an identical list; <NAME> marks a mode.

## adc
0x00 CTRL — ADC control register.
{0x4+4i} CH{i}_GAIN (i=0..7) — Channel {i} gain setting
{0x24+4i} CH{i}_IRQ_EN (i=0..7) — Channel {i} interrupt enable register
0x44 CH0_IRQ_STATUS — Channel 0 interrupt status register
0x48 CH1_IRQ_STATUS — Channel 1 interrupt status register
0x4C CH2_IRQ_STATUS
0x50 CH3_IRQ_STATUS — Channel 3 interrupt status register
0x54 CH4_IRQ_STATUS — Channel 4 interrupt status register
0x58 CH5_IRQ_STATUS
0x5C CH6_IRQ_STATUS — Channel 6 interrupt status register
0x60 CH7_IRQ_STATUS — Channel 7 interrupt status register
0x64 DMA_MODE_EN — DMA mode enable register
0x68 TIMER_CONFIGURATION — ADC timer configuration register
0x70 TIMER_CURRENT_COUNT — ADC timer current count register
{0x74+4i} CHANNEL{i}FIFODATA (i=0..7) — CH{i} FIFO DATA register
0x94 CH0_FIFO_LVL — channel 0 FIFO Level register
0x98 CH1_FIFO_LVL — Channel 1 interrupt status register
0x9C CH2_FIFO_LVL
0xA0 CH3_FIFO_LVL — Channel 3 interrupt status register
0xA4 CH4_FIFO_LVL — Channel 4 interrupt status register
0xA8 CH5_FIFO_LVL
0xAC CH6_FIFO_LVL — Channel 6 interrupt status register
0xB0 CH7_FIFO_LVL — Channel 7 interrupt status register
0xB8 CH_ENABLE
