# hercules_mcrc_spec_0.1.0 register map
Vendor: Texas Instruments
Peripheral module from a debugger description file (folder hercules).
Registers are 32-bit, access not given, no defined reset value unless marked. A register's access mark holds for its fields unless they carry their own. Offsets are as the file gives them; lines under a group give offsets from that group; [hi:lo] are bit positions; {n}, {i} and the like mark numbered series; 'fields as' and 'values as' point back to an identical list; <NAME> marks a mode.

## Crc — Cyclic Redundancy Check
{0x0+8i} Ctrl{i} (i=0..2) — CRC Global Control Register {i}
0x60 PsaSigL1 — Channel 1 PSA signature low register
0x64 PsaSigH1 — Channel 1 PSA signature high register
0x70 PsaSecSigL1 — PSA Sector Signature Low Register 1
0x74 PsaSecSigH1 — PSA Sector Signature High Register 1
0x78 RawDataL1 — Raw Data Low Register 1
0x7C RawDataH1 — Raw Data High Register 1

## Notices in the file
(c) Texas Instruments 2003-2012, All rights reserved.
